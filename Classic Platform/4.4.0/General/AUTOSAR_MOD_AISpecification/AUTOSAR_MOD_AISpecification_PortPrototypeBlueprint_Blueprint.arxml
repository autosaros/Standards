[part 2 of 4: package /AUTOSAR/AISpecification/PortPrototypeBlueprints_Blueprint]
AUTOSAR XML (schema 00046)
package /AUTOSAR/AISpecification/PortPrototypeBlueprints_Blueprint  (continued)
  2221 x port prototype blueprint:  (continued)
    EngNMax: interface=EngNMax1  # Maximum Allowed Engine Speed | Maximum permitted engine speed for engine protection, must not be exceeded by shifting | default value after reset: max value
    EngNMin: interface=EngNMin1  # Minimum Allowed Engine Speed | Minimum engine speed from engine control point of view E.g. engine idle speed to be arbitrated by Powertrain coordinator (PTC) with all other requested engine speeds.(Air Conditioner (A/C), alternator, transmission, ...) | signal is sent with initialisation
    EngPAmbAir: interface=EngPAmbAir1  # Engine Ambient Air Pressure | Engine ambient air pressure
    EngRunngDirSt: interface=EngRunngDirSt1  # Engine: Engine Running Direction State | Engine running direction state. | Rotation direction of the combustion engine. Used, for example, for engine stop/start systems. Sign of the engine running direction: If the vehicle is moving in forward direction, and the drivetrain is closed, and a forward gear is engaged, then the engine running direction is positive. During initialization, the engine sends the value "0". 0 = undefined running direction, no direction information available 1 = positive running direction 2 = negative running direction 3 = invalid running direction due to error References to other signals: TrsmCluNReq TrsmTiCluNReq Data format for typical network representation for series projects: Uint2 Unit: [-] Type: Enum 0 = undefined running direction, no direction information available 1 = positive 2 = negative 3 = invalid due to error Cycle Time: 10 ms (max.) for internal calculation and bus communication. Typical Provider: Powertrain Typical Receiver: Transmission
    EngSpd: interface=EngN1  # Engine Speed | The actual rotational speed of the engine crankshaft. | E.g. evaluated from a segment synchronous source.
    EngSpdGrdt: interface=EngNGrdt1  # Engine Speed Gradient | Actual engine speed gradient
    EngStrtRem: interface=EngStrtRemReq1  # Remote Engine Start | Information to start the engine from a remote control
    EngT: interface=EngT1  # Engine: Engine Temperature | Consolidated engine temperature. | For engines with water cooling systems, the signal shows the coolant temperature. Data format for typical network representation for series projects: Uint8 Unit: degC Type: linear Resolution: 1 Offset: -40 Physically used range: Hex Lower/Upper Limit: 0h / FDh Physical Lower/Upper Limit: -40 / 213 Special values outside the physically used range: FEh = Init FFh = Error, Signal content invalid Cycle Time: 100 ms (max.) for internal calculation and bus communication. Typical Provider: Powertrain Typical Receiver: Transmission
    EngTqCluMin: interface=EngTqCluMin1  # Minimum Engine Torque at Clutch | Minimum engine torque at clutch level of not fired engine at current engine speed. | Minimum engine torque at clutch considers following contributors if present 1) internal engine torque losses like friction, pumping, mechanical driven water pump etc. 2) losses with influence on torque at clutch caused by alternator, airconditioning, power steering etc. Loss differences from engine to engine and variable torque losses over life cycle have to be considered. Usually this signal corresponds to the drag torque of the combustion engine at current speed. Data format for typical network representation for series projects: Uint12 Unit: Nm Type: linear Resolution: 1 Offset: -2048 Physically used range: Hex Lower/Upper Limit: 0h / FFDh Physical Lower/Upper Limit: -2048 / 2045 Special values outside the physically used range: FFEh = Init FFFh = Error, Signal content invalid Cycle Time: 10 ms (max.) for Control Unit internal calculation and Bus communication. Typical Provider: Powertrain Typical Receiver: Transmission
    EngTqCrksft: interface=EngTqCrksft1  # Engine: Torque at Crankshaft | Indicated torque of combustion engine plus internal engine torque losses. The effect of inertia on the torque is not considered. | Torque at crankshaft considers the following contributors, if present: 1) Indicated torque of combustion engine, calculated on the basis of injection timing and injected fuel, ignition angle and air mass. 2) Internal engine torque losses such as friction, pumping, mechanical driven water pump, etc. Ancillary torque losses caused by the alternator, air(space)conditioning, power steering, etc., are not considered. The effect of inertia on the torque is not considered. Loss differences from engine to engine and variable torque losses over the life cycle must be considered. The signal includes all torque requests from the accelerator pedal, cruise control, speed limiter, etc., and all interventions, e.g., torque and speed interventions. Example of implementation: The torque is a cylinder average, not a time average, via two crankshaft revolutions of all cylinders, in consideration of the current operating parameters. The operating parameters include the engine temperature, ignition timing and air mass measured or calculated, lambda, fuel cut level, fuel quantity, injection timing, knock control adaption, geographic altitude and others. Data format for typical network representation for series projects: Uint12 Unit: Nm Type: linear Resolution: 1 Offset: -2048 Physically used range: Hex Lower/Upper Limit: 0h / FFDh Physical Lower/Upper Limit: -2048 / 2045 Special values outside the physically used range: FFEh = Init FFFh = Error, Signal content invalid Cycle Time: 10 ms (max.) for internal calculation and bus communication. Typical Provider: Powertrain Typical Receiver: Transmission
    EngTqCrksftMax: interface=EngTqCrksftMax1  # Maximum Engine Torque at Crankshaft | The maximum torque at crankshaft at the current engine speed and actual air mass (both gasoline and diesel), including the static power limitation of the engine (e.g. calibrated restrictions for engine protection) | Example of realization: The maximum torque is realized by fast and slow path [e.g. with the earliest possible ignition angle at current lambda (gasoline in homogeneous mode) or the maximum fuel mass and injection timing (diesel)] including average knocking (average of cylinders), smoke limitation.The signal is valid if the engine speed is higher than a certain engine speed threshold. This threshold depends on the engine (e.g. about 500 rpm for four cylinder engines). Below this limit the accuracy of this value may decrease significantly. For hybrid stop/start strategy the engine speed of the fired engine should always be above the speed threshold. Default value after reset is zero
    EngTqCrksftMaxEngNCur: interface=EngTqCrksftMaxEngNCur1  # Engine: Maximum Torque at Crankshaft at Current Speed | Maximum possible torque at crankshaft at current speed with maximum possible air mass at current ambient pressure and air temperature, including static power limitation of the engine. | Theoretical full load engine torque at crankshaft at current engine speed. Maximally charged for turbo systems. The static power limitation contains, e.g., restrictions for protection and static smoke limitation. Permanent knock limitation is considered, knock control is not considered. Data format for typical network representation for series projects: Uint12 Unit: Nm Type: linear Resolution: 1 Offset: -2048 Physically used range: Hex Lower/Upper Limit: 0h / FFDh Physical Lower/Upper Limit: -2048 / 2045 Special values outside the physically used range: FFEh = Init FFFh = Error, Signal content invalid Cycle Time: 10 ms (max.) for internal calculation and bus communication. Typical Provider: Powertrain Typical Receiver: Transmission
    EngTqCrksftMaxFast: interface=EngTqCrksftMaxFast1  # Maximum Engine Torque at Crankshaft Fast Path | Maximum engine torque at crankshaft fast path including current engine speed, the actual air mass (both gasoline and diesel) and the static power limitation of the engine (e.g. calibrated restrictions for engine protection). This signal is relevant for torque requests realized by fast path. | Example of realization: The maximum torque is realized by fast path [e.g. with the earliest possible ignition angle at current lambda (gasoline in homogeneous mode) or the maximum fuel mass and optimum injection timing concerning torque (diesel)] , including average knocking (average of cylinders), smoke limitation.
    EngTqCrksftMaxOptmCdn: interface=EngTqCrksftMaxOptmCdn1  # Maximum Engine Torque at Crankshaft at Optimum Conditions | The maximum torque at crankshaft at the current engine speed, maximum air mass, current ambient pressure and air temperature (both gasoline and diesel), including the static power limitation of the engine (e.g. calibrated restrictions for engine protection). Calculated for ideal conditions. | Example of Realization: The maximum torque is realized by fast and slow path [e.g. with the earliest possible ignition angle at optimum lambda concerning torque (gasoline) or the maximum fuel mass and injection timing (diesel)]. Smoke limitation is included in the signal. Average knocking is not considered (without knock control), but the pre-calibrated knocking limitation.The signal is valid if the engine speed is higher than a certain engine speed threshold. This threshold depends on the engine (e.g. about 500 rpm for four cylinder engines). Below this limit the accuracy of this value may decrease significantly. For hybrid stop/start strategy the engine speed of the fired engine should always be above the speed threshold. Default value after reset is zero
    EngTqCrksftMaxProtn: interface=EngTqCrksftMaxProtn1  # Maximum Allowed Torque at Crankshaft for Engine Protection | Maximum crankshaft torque including engine protection. If no protection function is active, the value of this interface will be the upper limit of the chosen data type. | Example of realization: Including catalyst protection, over heating, intake air system protection and fail safe etc.signal is sent with initialisation
    EngTqCrksftMaxSpdCur: interface=EngTqCrksftMaxSpdCur1  # Engine: Maximum Torque at Crankshaft at Current Speed | Maximum possible torque at crankshaft at current speed with maximum possible air mass at current ambient pressure and air temperature, including static power limitation of the engine. | Theoretical full load engine torque at crankshaft at actual engine speed. Maximally charged for turbo systems. Static power limitation contains e.g. restrictions for protection and static smoke limitation. Permanent knock limitation is considered, knock control not. Data format for typical network representation for series projects: Uint12 Unit: Nm Type: linear Resolution: 1 Offset: -2048 Physically used range: Hex Lower/Upper Limit: 0h / FFDh Physical Lower/Upper Limit: -2048 / 2045 Special values outside the physically used range: FFEh = Init FFFh = Error, Signal content invalid Cycle Time: 10 ms (max.) for Control Unit internal calculation and Bus communication. Typical Provider: Powertrain Typical Receiver: Transmission
    EngTqCrksftMin: interface=EngTqCrksftMin1  # Engine: Minimum Engine Torque at Crankshaft Considering Engine Internal Torque Losses | Minimum engine torque at crankshaft level of not fired engine at current engine speed. | The minimum engine torque at crankshaft considers the internal engine torque losses such as friction, pumping, mechanical driven water pump, etc. Loss differences from engine to engine and variable torque losses over the life cycle must be considered. Usually, this signal corresponds to the drag torque of the combustion engine at current speed. Data format for typical network representation for series projects: Uint12 Unit: Nm Type: linear Resolution: 1 Offset: -2048 Physically used range: Hex Lower/Upper Limit: 0h / FFDh Physical Lower/Upper Limit: -2048 / 2045 Special values outside the physically used range: FFEh = Init FFFh = Error, Signal content invalid Cycle Time: 10 ms (max.) for internal calculation and bus communication. Typical Provider: Powertrain Typical Receiver: Transmission
    EngTqCrksftMinBasc: interface=EngTqCrksftMinBasc1  # Minimum Engine Torque at Crankshaft for Powertrain Realized by Slow Path | The minimum torque at crankshaft at the current engine speed and the minimum air mass (both gasoline and diesel) not including spark retard (gasoline) and fuel cut off | Example of realization: The minimum torque is realized by slow path [e.g. normal ignition timing for the minimum mass air at current lambda (gasoline homogeneous) or the minimum fuel mass and injection timing (diesel)] For diesel engines this interface is possibly equivalent to the torque losses, because minimum fuel mass could be zero. Otherwise minimum torque for fired engine'The signal is valid if the engine speed is higher than a certain engine speed threshold. This threshold depends on the engine (e.g. about 500 rpm for four cylinder engines). Below this limit the accuracy of this value may decrease significantly. For hybrid stop/start strategy the engine speed of the fired engine should always be above the speed threshold. Default value after reset is zero'
    EngTqCrksftMinFast: interface=EngTqCrksftMinFast1  # Engine: Minimum Torque at Crankshaft Fast Path | Minimum torque at crankshaft of combustion engine at latest possible ignition angle. Calculated at current engine speed with current air mass, current ambient pressure and current air temperature. | Signal is relevant for gasoline engines only. The latest possible ignition angle, also called "max. ignition retard", depends on exhaust temperature, catalyst protection, etc. A torque decrease request from the transmission down to this torque level should only be implemented by ignition retard and not by cylinder cut off. For diesel engines, this signal depends on the minimum fuel mass, which is usually is zero. In parallel hybrid projects, this is the minimum torque the combustion engine can implement. Data format for typical network representation for series projects: Uint12 Unit: Nm Type: linear Resolution: 1 Offset: -2048 Physically used range: Hex Lower/Upper Limit: 0h / FFDh Physical Lower/Upper Limit: -2048 / 2045 Special values outside the physically used range: FFEh = Init FFFh = Error, Signal content invalid Cycle Time: 10 ms (max.) for internal calculation and bus communication. Typical Provider: Powertrain Typical Receiver: Transmission
    EngTqCrksftMinWoCutOff: interface=EngTqCrksftMinWoCutOff1  # Minimum Engine Torque at Crankshaft for Powertrain Realized by Slow and Fast Path | The minimum torque at crankshaft at the current engine speed and the minimum air mass (both gasoline and diesel) including spark retard (gasoline), not including fuel cut off | Example of realization: The minimum torque is realized by slow and fast path [e.g. considering a certain spark retard for the minimum air mass at current lambda (gasoline homogeneous) or the minimum fuel mass and injection timing (diesel)]. The possible amount of spark retard can be defined depending on the application, e.g. according to drive ability criteria. For diesel engines this interface is possibly equivalent to the torque losses, because minimum fuel mass could be zero. Otherwise minimum torque for fired engine'The signal is valid if the engine speed is higher than a certain engine speed threshold. This threshold depends on the engine (e.g. about 500 rpm for four cylinder engines). Below this limit the accuracy of this value may decrease significantly. For hybrid stop/start strategy the engine speed of the fired engine should always be above the speed threshold. Default value after reset is zero'
    EngTqCrksftRedByAncllryLoss: interface=EngTqCrksftRedByAncllryLoss1  # Engine: Torque at Crankshaft Reduced by Ancillary Losses | Torque at crankshaft reduced by ancillary losses. | Indicated engine torque calculated on the basis of injection timing and injected fuel, ignition angle and air mass, plus 1) Internal engine torque losses such as friction, pumping, mechanical driven water pump, etc. 2) Ancillary torque losses with an effect on torque at crankshaft caused by i.a., alternator, air(space)conditioning, power steering. The effect of inertia on the torque is not considered. In series, loss differences from engine to engine and variable torque losses over the life cycle must be considered. Data format for typical network representation for series projects: Uint12 Unit: Nm Type: linear Resolution: 1 Offset: -2048 Physically used range: Hex Lower/Upper Limit: 0h / FFDh Physical Lower/Upper Limit: -2048 / 2045 Special values outside the physically used range: FFEh = Init FFFh = Error, Signal content invalid Cycle Time: 10 ms (max.) for internal calculation and bus communication. Typical Provider: Powertrain Typical Receiver: Transmission
    EngTqCrksftRedByAncllryLossMin: interface=EngTqCrksftRedByAncllryLossMin1  # Engine: Minimum Torque at Crankshaft Reduced by Ancillary Losses | Minimum engine torque at crankshaft of not fired engine at current engine speed decreased by ancillary losses. | The minimum engine torque at crankshaft considers the following contributors, if present: 1) Internal engine torque losses such as friction, pumping, mechanical driven water pump, etc. 2) Ancillary torque losses with an effect on torque at crankshaft caused by i.a., alternator, air(space)conditioning, power steering etc. In series, loss differences from engine to engine and variable torque losses over the life cycle must be considered. Usually, this signal corresponds to the drag torque of the combustion engine at current speed. The signal delivers the torque necessary to start the engine at standstill and throughout the engine start. It also includes the torque to overcome sticking friction, as well as compression effects depending on the crankshaft angle. Data format for typical network representation for series projects: Uint12 Unit: Nm Type: linear Resolution: 1 Offset: -2048 Physically used range: Hex Lower/Upper Limit: 0h / FFDh Physical Lower/Upper Limit: -2048 / 2045 Special values outside the physically used range: FFEh = Init FFFh = Error, Signal content invalid Cycle Time: 10 ms (max.) for internal calculation and bus communication. Typical Provider: Powertrain Typical Receiver: Transmission
    EngTqDecAtCluReqByEscFast: interface=EngTqDecAtCluReqByEscFast1  # Engine Torque Decrease at Clutch Request by ESC Fast | Decreasing engine torque at clutch requested by Electronic Stability Control below the driver input torque including virtual driver request. Fast refers to the immediate / instant torque request, typically achieved by ignition timing.
    EngTqDecAtCluReqByEscSlow: interface=EngTqDecAtCluReqByEscSlow1  # Engine Torque Decrease at Clutch Request by ESC Slow | Decreasing engine torque at clutch requested by Electronic Stability Control below the driver input torque including virtual driver request. Slow refers to the longer term or torque reserve request, usually the input to throttle control.
    EngTqDynJ: interface=EngTqDynJ1  # Engine Dynamic Moment of Inertia | Inertia torque of combustion engine at clutch level. Definition of the sign: Increasing speed creates a negative sign, decreasing speed creates a positive sign. | The signal contains the dynamic torque created by the inertia which increases or decreases the torque at clutch. The engine internal inertia and the inertia of the ancillaries up to the clutch have to be considered. Data format for typical network representation for series projects: Uint12 Unit: Nm Type: linear Resolution: 1 Offset: -2048 Physically used range: Hex Lower/Upper Limit: 0h / FFDh Physical Lower/Upper Limit: -2048 / 2045 Special values outside the physically used range: FFEh = Init FFFh = Error, Signal content invalid Cycle Time: 10 ms (max.) for Control Unit internal calculation and Bus communication. Typical Provider: Powertrain Typical Receiver: Transmission
    EngTqIncAtCluReqByEsc: interface=EngTqIncAtCluReqByEsc1  # Engine Torque Increase at Clutch Request by ESC Slow | Increasing engine torque requested by Electronic Stability Control over the driver input torque including virtual driver. If the engine has a slow (usually by throttle control) and fast path (typically by ignition timing) this signal is used for increasing on both torque paths.
    EngTqJCrksft: interface=EngTqJCrksft1  # Engine: Engine Torque of Inertia at Crankshaft | Inertia torque of combustion engine at clutch level. Definition of the sign: An increasing speed produces a negative sign; a decreasing speed produces a positive sign. | The signal contains the dynamic torque caused by the inertia, which increases or decreases the torque at clutch. The engine internal inertia and the inertia of the ancillaries up to the clutch must be considered. Data format for typical network representation for series projects: Uint12 Unit: Nm Type: linear Resolution: 1 Offset: -2048 Physically used range: Hex Lower/Upper Limit: 0h / FFDh Physical Lower/Upper Limit: -2048 / 2045 Special values outside the physically used range: FFEh = Init FFFh = Error, Signal content invalid Cycle Time: 10 ms (max.) for internal calculation and bus communication. Typical Provider: Powertrain Typical Receiver: Transmission
    EngTqResvPt: interface=EngTqResvPt1  # Torque Reserve Request from Engine to Powertrain | Reserved torque request to be coordinated by the Powertrain coordinator (PTC). This reserved torque could be realized either by the combustion engine or by another torque source (e.g. electric motor in a hybrid system). It does not include reserved torque requests which will be coordinated inside the combustion engine, e.g. torque reserve for catalyst heating or torque reserve to realize a change in the engine operation mode. | Default value after reset is zero
    EngTqResvReqPt: interface=EngTqResvReqPt1  # Torque Reserve Request from Engine to Powertrain | Reserved torque request to be coordinated by the Powertrain coordinator (PTC). This reserved torque could be realized either by the combustion engine or by another torque source (e.g. electric motor in a hybrid system). It does not include reserved torque requests which will be coordinated inside the combustion engine, e.g. torque reserve for catalyst heating or torque reserve to realize a change in the engine operation mode. | Default value after reset is zero.
    EngTracCtrlIntvg: interface=EngTracCtrlIntvg1  # Engine Traction Control Intervening | Engine traction control is intervening (TRUE) when a torque reduction at the wheels is requested. Traction control is not intervening (indicated by FALSE) when a torque reduction at the wheels is not requested.
    EpbActrFltSt: interface=EpbActrFltSt1  # EPB Actuator Fault Status | Failure status of the parking brake actuators
    EpbActrFltSts: interface=EpbActrFltSts1  # EPB Actuator Fault Status | Failure status of the parking brake actuators
    EpbActrMod: interface=EpbActrMod1  # EPB Actuator Mode | Indication of the action executed by the parking brake actuator or its status.
    EpbActrTq: interface=EpbActrTq1  # EPB Actuator Torque | Brake torque applied by Electric Parking Brake actuator. | Based on nominal brake parameters (constant pads friction) and (estimated or measured) brake pressures (clamp forces).
    EpbActvn: interface=EpbActvn1  # EPB Activation | Activation or deactivation of the Electric Parking Brake by the driver.
    EpbBtnCtrlSt: interface=EpbBtnCtrlSt1  # EPB Button Control Status | Status of Electric Parking Brake (EPB) control button
    EpbBtnCtrlSts: interface=EpbBtnCtrlSts1  # EPB Button Control Status | Status of Electric Parking Brake (EPB) control button
    EpbDrvrActvnIndcn: interface=EpbDrvrActvnIndcn1  # EPB Driver Activation Indication | Indication to the cockpit (HMI) that the driver has applied/released the parking brake.
    EscCtrlIndcn: interface=EscCtrlIndcn1  # ESC Control Indication | Electronic Stability Control (ESC) controller is intervening.
    EscFlgNoFuCutOff: interface=NoFuCutOffReq1  # Request "No Fuel Cut Off" by Electronic Stability Control (ESC) | Suppress engine fuel cut off - 0: no suppression of fuel cut off - 1: suppression of fuel cut off
    EscReqPasMod: interface=EscReqPasMod1  # ESC Request Passive Mode | Request to switch the Electronic Stability Control (ESC) system to a passive mode.
    EscSt: interface=EscSt1  # Electronic Stability Control (ESC) Status | Status of activation/ deactivation of Electronic Stability Control (ESC)
    EscStIndcn: interface=EscStIndcn1  # ESC Status Indication | Electronic Stability Control (ESC) is turned on.
    EscStShiftPrevnStaby: interface=GearShiftPrevn1  # Electronic Stability Control (ESC): State of Shift Prevention for Stability Reasons | Avoid change of gear for stability reasons.
    EscSts: interface=EscSts1  # Electronic Stability Control (ESC) Status | Status of activation/ deactivation of Electronic Stability Control (ESC)
    EscStsIndcn: interface=EscStsIndcn1  # ESC Status Indication | Electronic Stability Control (ESC) is turned on.
    EscTqCluPtMaxFast: interface=EngTqDecAtCluReqByEscFast1  # Maximum Powertrain Clutch Torque Requested by Electronic Stability Control (ESC) Fast Path | Reducing engine torque requested by Electronic stability control below the driver input torque including virtual driver request. Fast refers to the immediate / instant torque request, typically achieved by ignition timing.
    EscTqCluPtMaxSlow: interface=EngTqDecAtCluReqByEscSlow1  # Maximum Powertrain Clutch Torque Requested by Electronic Stability Control (ESC) Slow Path | Reducing engine torque requested by Electronic stability control below the driver input torque including virtual driver request. Slow refers to the longer term or torque reserve request, usually the input to throttle control.
    EscTqCluPtMin: interface=EngTqIncAtCluReqByEsc1  # Minimum Powertrain Clutch Torque Requested by Electronic Stability Control (ESC) | Increasing engine torque requested by Electronic Stability Control over the driver input torque including virtual driver. If the engine has a slow (usually by throttle control) and fast path (typically by ignition timing) this signal is used for increasing on both torque paths.
    EscTqWhlPtMaxFast: interface=PtTqTotAtWhls1  # Maximum Powertrain Wheel Torque Requested by Electronic Stability Control (ESC) Fast Path | Wheel torque (to all the driven wheels) after coordination among several stability systems (traction control, stability control, and yaw rate control) to be generated by the powertrain. This is the maximum torque to be delivered by the powertrain, e.g. a torque decrease request [absolute] for ASC (Acceleration Slip Control) (to prevent wheel spin). If the maximum request is less than the minimum request the priority must be clearly defined. If no request is active, the value of this interface will be the upper limit of the chosen data type. | Must be initialised to the upper limit of the chosen data type.
    EscTqWhlPtMaxSlow: interface=PtTqTotAtWhls1  # Maximum Powertrain Wheel Torque Requested by Electronic Stability Control (ESC) Slow Path | Anticipated wheel torque (to all the driven wheels) after coordination among several stability systems (traction control, stability control, and yaw rate control) to be generated by the powertrain. This is the maximum torque to be delivered by the powertrain, e.g. a torque decrease request [absolute] for ASC (Acceleration Slip Control) (to prevent wheel spin). If the maximum request is less than the minimum request the priority must be clearly defined. If no request is active, the value of this interface will be the upper limit of the chosen data type. | Must be initialised to the upper limit of the chosen data type.
    EscTqWhlPtMinFast: interface=PtTqTotAtWhls1  # Minimum Powertrain Wheel Torque Requested by Electronic Stability Control (ESC) Fast Path | Wheel torque (to all the driven wheels) after coordination among several stability systems (traction control, stability control, and yaw rate control) to be generated by the powertrain. This is the minimum torque to be delivered by the powertrain, e.g. a torque increase request [absolute] for MSR (engine drag torque control (also known as "Motorschleppmomentregelung")) (to prevent wheel lock up). If the maximum request is less than the minimum request the priority must be clearly defined. If no request is active, the value of this interface will be the lower limit of the chosen data type. | Must be initialised to the lower limit of the chosen data type.
    EscTqWhlPtMinSlow: interface=PtTqTotAtWhls1  # Minimum Powertrain Wheel Torque Requested by Electronic Stability Control (ESC) Slow Path | Anticipated wheel torque (to all the driven wheels) after coordination among several stability systems (traction control, stability control, and yaw rate control) to be generated by the powertrain. This is the minimum torque to be delivered by the powertrain, e.g. a torque increase request [absolute] for MSR (engine drag torque control (also known as "Motorschleppmomentregelung")). If the maximum request is less than the minimum request the priority is the maximum request (which in the case is the lower value!) If no request is active, the value of this interface will be the lower limit of the chosen data type. | Must be initialised to the lower limit of the chosen data type.
    EscVMax: interface=VehSpd1  # Maximum Vehicle Speed Due to Electronic Stability Control (ESC) | Maximum vehicle speed requested by chassis for safety vehicle speed limitation. Arbitrated with a minimum function in powertrain domain, together with similar requests from other domains. Limit vehicle speed in case of brake system deterioration
    EscVWhlInd: interface=WhlSpdCircuml1  # Electronic Stability Control (ESC): Vector of Individual Speed of Wheels | Vector of 4 scalars in the order front left, front right, rear left, rear right. These scalars are the product of the individual angular velocities with the nominal (or static) rolling radius. The nominal (or static) rolling radius is representative of each vehicle, and is a value such that the standard circumferential wheel speed is very close to the vehicle longitudinal speed of the vehicle. If signal is not provided (optional) the radius must be available as a parameter
    ExtrLiBriActvn: interface=ExtrLiBriCmd1  # Activation Of Exterior Light Source | Request the brightness of a light actuator. The percentage value (independent of light actuator type and environment e.g. voltage of electrical system) depends on the functionality that the light source shall be switched on for (e.g. low beam used for daytime running light, or replacement of a defect lamp). | 100 percent means full power of the light actuator.
    ExtrLiBriActvnOfBeamHiLe: interface=ExtrLiBriCmd1  # Activation of Exterior Light Source | Request the brightness of a light actuator. The percentage value (independent of light actuator type and environment e.g. voltage of electrical system) depends on the functionality that the light source shall be switched on for (e.g. low beam used for daytime running light, or replacement of a defect lamp). | 100 percent means full power of the light actuator.
    ExtrLiBriActvnOfBeamHiRi: interface=ExtrLiBriCmd1  # Activation of Exterior Light Source | Request the brightness of a light actuator. The percentage value (independent of light actuator type and environment e.g. voltage of electrical system) depends on the functionality that the light source shall be switched on for (e.g. low beam used for daytime running light, or replacement of a defect lamp). | 100 percent means full power of the light actuator.
    ExtrLiBriActvnOfBeamLoLe: interface=ExtrLiBriCmd1  # Activation of Exterior Light Source | Request the brightness of a light actuator. The percentage value (independent of light actuator type and environment e.g. voltage of electrical system) depends on the functionality that the light source shall be switched on for (e.g. low beam used for daytime running light, or replacement of a defect lamp). | 100 percent means full power of the light actuator.
    ExtrLiBriActvnOfBeamLoRi: interface=ExtrLiBriCmd1  # Activation of Exterior Light Source | Request the brightness of a light actuator. The percentage value (independent of light actuator type and environment e.g. voltage of electrical system) depends on the functionality that the light source shall be switched on for (e.g. low beam used for daytime running light, or replacement of a defect lamp). | 100 percent means full power of the light actuator.
    ExtrLiBriActvnOfBrkLiLe: interface=ExtrLiBriCmd1  # Activation of Exterior Light Source | Request the brightness of a light actuator. The percentage value (independent of light actuator type and environment e.g. voltage of electrical system) depends on the functionality that the light source shall be switched on for (e.g. low beam used for daytime running light, or replacement of a defect lamp). | 100 percent means full power of the light actuator.
    ExtrLiBriActvnOfBrkLiRi: interface=ExtrLiBriCmd1  # Activation of Exterior Light Source | Request the brightness of a light actuator. The percentage value (independent of light actuator type and environment e.g. voltage of electrical system) depends on the functionality that the light source shall be switched on for (e.g. low beam used for daytime running light, or replacement of a defect lamp). | 100 percent means full power of the light actuator.
    ExtrLiBriActvnOfBrkLiTrlrLe: interface=ExtrLiBriCmd1  # Activation of Exterior Light Source | Request the brightness of a light actuator. The percentage value (independent of light actuator type and environment e.g. voltage of electrical system) depends on the functionality that the light source shall be switched on for (e.g. low beam used for daytime running light, or replacement of a defect lamp). | 100 percent means full power of the light actuator.
    ExtrLiBriActvnOfBrkLiTrlrRi: interface=ExtrLiBriCmd1  # Activation of Exterior Light Source | Request the brightness of a light actuator. The percentage value (independent of light actuator type and environment e.g. voltage of electrical system) depends on the functionality that the light source shall be switched on for (e.g. low beam used for daytime running light, or replacement of a defect lamp). | 100 percent means full power of the light actuator.
    ExtrLiBriActvnOfCornrMkrCenLe: interface=ExtrLiBriCmd1  # Activation of Exterior Light Source | Request the brightness of a light actuator. The percentage value (independent of light actuator type and environment e.g. voltage of electrical system) depends on the functionality that the light source shall be switched on for (e.g. low beam used for daytime running light, or replacement of a defect lamp). | 100 percent means full power of the light actuator.
    ExtrLiBriActvnOfCornrMkrCenRi: interface=ExtrLiBriCmd1  # Activation of Exterior Light Source | Request the brightness of a light actuator. The percentage value (independent of light actuator type and environment e.g. voltage of electrical system) depends on the functionality that the light source shall be switched on for (e.g. low beam used for daytime running light, or replacement of a defect lamp). | 100 percent means full power of the light actuator.
    ExtrLiBriActvnOfCornrMkrFrntLe: interface=ExtrLiBriCmd1  # Activation of Exterior Light Source | Request the brightness of a light actuator. The percentage value (independent of light actuator type and environment e.g. voltage of electrical system) depends on the functionality that the light source shall be switched on for (e.g. low beam used for daytime running light, or replacement of a defect lamp). | 100 percent means full power of the light actuator.
    ExtrLiBriActvnOfCornrMkrFrntRi: interface=ExtrLiBriCmd1  # Activation of Exterior Light Source | Request the brightness of a light actuator. The percentage value (independent of light actuator type and environment e.g. voltage of electrical system) depends on the functionality that the light source shall be switched on for (e.g. low beam used for daytime running light, or replacement of a defect lamp). | 100 percent means full power of the light actuator.
    ExtrLiBriActvnOfCornrMkrReLe: interface=ExtrLiBriCmd1  # Activation of Exterior Light Source | Request the brightness of a light actuator. The percentage value (independent of light actuator type and environment e.g. voltage of electrical system) depends on the functionality that the light source shall be switched on for (e.g. low beam used for daytime running light, or replacement of a defect lamp). | 100 percent means full power of the light actuator.
    ExtrLiBriActvnOfCornrMkrReRi: interface=ExtrLiBriCmd1  # Activation of Exterior Light Source | Request the brightness of a light actuator. The percentage value (independent of light actuator type and environment e.g. voltage of electrical system) depends on the functionality that the light source shall be switched on for (e.g. low beam used for daytime running light, or replacement of a defect lamp). | 100 percent means full power of the light actuator.
    ExtrLiBriActvnOfFogLiFrntLe: interface=ExtrLiBriCmd1  # Activation of Exterior Light Source | Request the brightness of a light actuator. The percentage value (independent of light actuator type and environment e.g. voltage of electrical system) depends on the functionality that the light source shall be switched on for (e.g. low beam used for daytime running light, or replacement of a defect lamp). | 100 percent means full power of the light actuator.
    ExtrLiBriActvnOfFogLiFrntRi: interface=ExtrLiBriCmd1  # Activation of Exterior Light Source | Request the brightness of a light actuator. The percentage value (independent of light actuator type and environment e.g. voltage of electrical system) depends on the functionality that the light source shall be switched on for (e.g. low beam used for daytime running light, or replacement of a defect lamp). | 100 percent means full power of the light actuator.
    ExtrLiBriActvnOfFogLiReLe: interface=ExtrLiBriCmd1  # Activation of Exterior Light Source | Request the brightness of a light actuator. The percentage value (independent of light actuator type and environment e.g. voltage of electrical system) depends on the functionality that the light source shall be switched on for (e.g. low beam used for daytime running light, or replacement of a defect lamp). | 100 percent means full power of the light actuator.
    ExtrLiBriActvnOfFogLiReRi: interface=ExtrLiBriCmd1  # Activation of Exterior Light Source | Request the brightness of a light actuator. The percentage value (independent of light actuator type and environment e.g. voltage of electrical system) depends on the functionality that the light source shall be switched on for (e.g. low beam used for daytime running light, or replacement of a defect lamp). | 100 percent means full power of the light actuator.
    ExtrLiBriActvnOfFogLiTrlrLe: interface=ExtrLiBriCmd1  # Activation of Exterior Light Source | Request the brightness of a light actuator. The percentage value (independent of light actuator type and environment e.g. voltage of electrical system) depends on the functionality that the light source shall be switched on for (e.g. low beam used for daytime running light, or replacement of a defect lamp). | 100 percent means full power of the light actuator.
    ExtrLiBriActvnOfFogLiTrlrRi: interface=ExtrLiBriCmd1  # Activation of Exterior Light Source | Request the brightness of a light actuator. The percentage value (independent of light actuator type and environment e.g. voltage of electrical system) depends on the functionality that the light source shall be switched on for (e.g. low beam used for daytime running light, or replacement of a defect lamp). | 100 percent means full power of the light actuator.
    ExtrLiBriActvnOfIndcrFrntLe: interface=ExtrLiBriCmd1  # Activation of Exterior Light Source | Request the brightness of a light actuator. The percentage value (independent of light actuator type and environment e.g. voltage of electrical system) depends on the functionality that the light source shall be switched on for (e.g. low beam used for daytime running light, or replacement of a defect lamp). | 100 percent means full power of the light actuator.
    ExtrLiBriActvnOfIndcrFrntRi: interface=ExtrLiBriCmd1  # Activation of Exterior Light Source | Request the brightness of a light actuator. The percentage value (independent of light actuator type and environment e.g. voltage of electrical system) depends on the functionality that the light source shall be switched on for (e.g. low beam used for daytime running light, or replacement of a defect lamp). | 100 percent means full power of the light actuator.
    ExtrLiBriActvnOfIndcrReLe: interface=ExtrLiBriCmd1  # Activation of Exterior Light Source | Request the brightness of a light actuator. The percentage value (independent of light actuator type and environment e.g. voltage of electrical system) depends on the functionality that the light source shall be switched on for (e.g. low beam used for daytime running light, or replacement of a defect lamp). | 100 percent means full power of the light actuator.
    ExtrLiBriActvnOfIndcrReRi: interface=ExtrLiBriCmd1  # Activation of Exterior Light Source | Request the brightness of a light actuator. The percentage value (independent of light actuator type and environment e.g. voltage of electrical system) depends on the functionality that the light source shall be switched on for (e.g. low beam used for daytime running light, or replacement of a defect lamp). | 100 percent means full power of the light actuator.
    ExtrLiBriActvnOfIndcrSideLe: interface=ExtrLiBriCmd1  # Activation of Exterior Light Source | Request the brightness of a light actuator. The percentage value (independent of light actuator type and environment e.g. voltage of electrical system) depends on the functionality that the light source shall be switched on for (e.g. low beam used for daytime running light, or replacement of a defect lamp). | 100 percent means full power of the light actuator.
    ExtrLiBriActvnOfIndcrSideRi: interface=ExtrLiBriCmd1  # Activation of Exterior Light Source | Request the brightness of a light actuator. The percentage value (independent of light actuator type and environment e.g. voltage of electrical system) depends on the functionality that the light source shall be switched on for (e.g. low beam used for daytime running light, or replacement of a defect lamp). | 100 percent means full power of the light actuator.
    ExtrLiBriActvnOfIndcrTrlrLe: interface=ExtrLiBriCmd1  # Activation of Exterior Light Source | Request the brightness of a light actuator. The percentage value (independent of light actuator type and environment e.g. voltage of electrical system) depends on the functionality that the light source shall be switched on for (e.g. low beam used for daytime running light, or replacement of a defect lamp). | 100 percent means full power of the light actuator.
    ExtrLiBriActvnOfIndcrTrlrRi: interface=ExtrLiBriCmd1  # Activation of Exterior Light Source | Request the brightness of a light actuator. The percentage value (independent of light actuator type and environment e.g. voltage of electrical system) depends on the functionality that the light source shall be switched on for (e.g. low beam used for daytime running light, or replacement of a defect lamp). | 100 percent means full power of the light actuator.
    ExtrLiBriActvnOfLampForStopOfBrkLiCenHiMntd: interface=ExtrLiBriCmd1  # Activation of Exterior Light Source | Request the brightness of a light actuator. The percentage value (independent of light actuator type and environment e.g. voltage of electrical system) depends on the functionality that the light source shall be switched on for (e.g. low beam used for daytime running light, or replacement of a defect lamp). | 100 percent means full power of the light actuator.
    ExtrLiBriActvnOfLiDaytiRunngFrntLe: interface=ExtrLiBriCmd1  # Activation of Exterior Light Source | Request the brightness of a light actuator. The percentage value (independent of light actuator type and environment e.g. voltage of electrical system) depends on the functionality that the light source shall be switched on for (e.g. low beam used for daytime running light, or replacement of a defect lamp). | 100 percent means full power of the light actuator.
    ExtrLiBriActvnOfLiDaytiRunngFrntRi: interface=ExtrLiBriCmd1  # Activation of Exterior Light Source | Request the brightness of a light actuator. The percentage value (independent of light actuator type and environment e.g. voltage of electrical system) depends on the functionality that the light source shall be switched on for (e.g. low beam used for daytime running light, or replacement of a defect lamp). | 100 percent means full power of the light actuator.
    ExtrLiBriActvnOfLiLeForRvsg: interface=ExtrLiBriCmd1  # Activation of Exterior Light Source | Request the brightness of a light actuator. The percentage value (independent of light actuator type and environment e.g. voltage of electrical system) depends on the functionality that the light source shall be switched on for (e.g. low beam used for daytime running light, or replacement of a defect lamp). | 100 percent means full power of the light actuator.
    ExtrLiBriActvnOfLiRiForRvsg: interface=ExtrLiBriCmd1  # Activation of Exterior Light Source | Request the brightness of a light actuator. The percentage value (independent of light actuator type and environment e.g. voltage of electrical system) depends on the functionality that the light source shall be switched on for (e.g. low beam used for daytime running light, or replacement of a defect lamp). | 100 percent means full power of the light actuator.
    ExtrLiBriActvnOfLiTrlrPlateNr: interface=ExtrLiBriCmd1  # Activation of Exterior Light Source | Request the brightness of a light actuator. The percentage value (independent of light actuator type and environment e.g. voltage of electrical system) depends on the functionality that the light source shall be switched on for (e.g. low beam used for daytime running light, or replacement of a defect lamp). | 100 percent means full power of the light actuator.
    ExtrLiBriActvnOfLiVehPlateNr: interface=ExtrLiBriCmd1  # Activation of Exterior Light Source | Request the brightness of a light actuator. The percentage value (independent of light actuator type and environment e.g. voltage of electrical system) depends on the functionality that the light source shall be switched on for (e.g. low beam used for daytime running light, or replacement of a defect lamp). | 100 percent means full power of the light actuator.
    ExtrLiBriActvnOfPrkgLiFrntLe: interface=ExtrLiBriCmd1  # Activation of Exterior Light Source | Request the brightness of a light actuator. The percentage value (independent of light actuator type and environment e.g. voltage of electrical system) depends on the functionality that the light source shall be switched on for (e.g. low beam used for daytime running light, or replacement of a defect lamp). | 100 percent means full power of the light actuator.
    ExtrLiBriActvnOfPrkgLiFrntRi: interface=ExtrLiBriCmd1  # Activation of Exterior Light Source | Request the brightness of a light actuator. The percentage value (independent of light actuator type and environment e.g. voltage of electrical system) depends on the functionality that the light source shall be switched on for (e.g. low beam used for daytime running light, or replacement of a defect lamp). | 100 percent means full power of the light actuator.
    ExtrLiBriActvnOfPrkgLiReLe: interface=ExtrLiBriCmd1  # Activation of Exterior Light Source | Request the brightness of a light actuator. The percentage value (independent of light actuator type and environment e.g. voltage of electrical system) depends on the functionality that the light source shall be switched on for (e.g. low beam used for daytime running light, or replacement of a defect lamp). | 100 percent means full power of the light actuator.
    ExtrLiBriActvnOfPrkgLiReRi: interface=ExtrLiBriCmd1  # Activation of Exterior Light Source | Request the brightness of a light actuator. The percentage value (independent of light actuator type and environment e.g. voltage of electrical system) depends on the functionality that the light source shall be switched on for (e.g. low beam used for daytime running light, or replacement of a defect lamp). | 100 percent means full power of the light actuator.
    ExtrLiBriActvnOfPrkgLiTrlrLe: interface=ExtrLiBriCmd1  # Activation of Exterior Light Source | Request the brightness of a light actuator. The percentage value (independent of light actuator type and environment e.g. voltage of electrical system) depends on the functionality that the light source shall be switched on for (e.g. low beam used for daytime running light, or replacement of a defect lamp). | 100 percent means full power of the light actuator.
    ExtrLiBriActvnOfPrkgLiTrlrRi: interface=ExtrLiBriCmd1  # Activation of Exterior Light Source | Request the brightness of a light actuator. The percentage value (independent of light actuator type and environment e.g. voltage of electrical system) depends on the functionality that the light source shall be switched on for (e.g. low beam used for daytime running light, or replacement of a defect lamp). | 100 percent means full power of the light actuator.
    ExtrLiBriActvnOfPuddleLiFrntLe: interface=ExtrLiBriCmd1  # Activation of Exterior Light Source | Request the brightness of a light actuator. The percentage value (independent of light actuator type and environment e.g. voltage of electrical system) depends on the functionality that the light source shall be switched on for (e.g. low beam used for daytime running light, or replacement of a defect lamp). | 100 percent means full power of the light actuator.
    ExtrLiBriActvnOfPuddleLiFrntRi: interface=ExtrLiBriCmd1  # Activation of Exterior Light Source | Request the brightness of a light actuator. The percentage value (independent of light actuator type and environment e.g. voltage of electrical system) depends on the functionality that the light source shall be switched on for (e.g. low beam used for daytime running light, or replacement of a defect lamp). | 100 percent means full power of the light actuator.
    ExtrLiBriActvnOfPuddleLiReLe: interface=ExtrLiBriCmd1  # Activation of Exterior Light Source | Request the brightness of a light actuator. The percentage value (independent of light actuator type and environment e.g. voltage of electrical system) depends on the functionality that the light source shall be switched on for (e.g. low beam used for daytime running light, or replacement of a defect lamp). | 100 percent means full power of the light actuator.
    ExtrLiBriActvnOfPuddleLiReRi: interface=ExtrLiBriCmd1  # Activation of Exterior Light Source | Request the brightness of a light actuator. The percentage value (independent of light actuator type and environment e.g. voltage of electrical system) depends on the functionality that the light source shall be switched on for (e.g. low beam used for daytime running light, or replacement of a defect lamp). | 100 percent means full power of the light actuator.
    ExtrLiBriActvnOfSideMkrCenLe: interface=ExtrLiBriCmd1  # Activation of Exterior Light Source | Request the brightness of a light actuator. The percentage value (independent of light actuator type and environment e.g. voltage of electrical system) depends on the functionality that the light source shall be switched on for (e.g. low beam used for daytime running light, or replacement of a defect lamp). | 100 percent means full power of the light actuator.
    ExtrLiBriActvnOfSideMkrCenRi: interface=ExtrLiBriCmd1  # Activation of Exterior Light Source | Request the brightness of a light actuator. The percentage value (independent of light actuator type and environment e.g. voltage of electrical system) depends on the functionality that the light source shall be switched on for (e.g. low beam used for daytime running light, or replacement of a defect lamp). | 100 percent means full power of the light actuator.
    ExtrLiBriActvnOfSideMkrFrntLe: interface=ExtrLiBriCmd1  # Activation of Exterior Light Source | Request the brightness of a light actuator. The percentage value (independent of light actuator type and environment e.g. voltage of electrical system) depends on the functionality that the light source shall be switched on for (e.g. low beam used for daytime running light, or replacement of a defect lamp). | 100 percent means full power of the light actuator.
    ExtrLiBriActvnOfSideMkrFrntRi: interface=ExtrLiBriCmd1  # Activation of Exterior Light Source | Request the brightness of a light actuator. The percentage value (independent of light actuator type and environment e.g. voltage of electrical system) depends on the functionality that the light source shall be switched on for (e.g. low beam used for daytime running light, or replacement of a defect lamp). | 100 percent means full power of the light actuator.
    ExtrLiBriActvnOfSideMkrReLe: interface=ExtrLiBriCmd1  # Activation of Exterior Light Source | Request the brightness of a light actuator. The percentage value (independent of light actuator type and environment e.g. voltage of electrical system) depends on the functionality that the light source shall be switched on for (e.g. low beam used for daytime running light, or replacement of a defect lamp). | 100 percent means full power of the light actuator.
    ExtrLiBriActvnOfSideMkrReRi: interface=ExtrLiBriCmd1  # Activation of Exterior Light Source | Request the brightness of a light actuator. The percentage value (independent of light actuator type and environment e.g. voltage of electrical system) depends on the functionality that the light source shall be switched on for (e.g. low beam used for daytime running light, or replacement of a defect lamp). | 100 percent means full power of the light actuator.
    ExtrLiBriActvnOfTrlrLiLeForRvsg: interface=ExtrLiBriCmd1  # Activation of Exterior Light Source | Request the brightness of a light actuator. The percentage value (independent of light actuator type and environment e.g. voltage of electrical system) depends on the functionality that the light source shall be switched on for (e.g. low beam used for daytime running light, or replacement of a defect lamp). | 100 percent means full power of the light actuator.
    ExtrLiBriActvnOfTrlrLiRiForRvsg: interface=ExtrLiBriCmd1  # Activation of Exterior Light Source | Request the brightness of a light actuator. The percentage value (independent of light actuator type and environment e.g. voltage of electrical system) depends on the functionality that the light source shall be switched on for (e.g. low beam used for daytime running light, or replacement of a defect lamp). | 100 percent means full power of the light actuator.
    FanSt: interface=FanSt1  # Fan State | Activation state of climatisation or ventilation
    FbAlrmAcoust: interface=AlrmAcoustCmd1  # Acoustical Feedback Alarm | Acoustical Feedback from the alarm device
    FbPanicAlrmAcoust: interface=PanicAlrmAcoustCmd1  # Acoustical Feedback Panic Alarm | Acoustical Feedback from the panic alarm device
    FbPanicAlrmVis: interface=PanicAlrmVisCmd1  # Visual Feedback Panic Alarm | Visual Feedback from the panic alarm device
    FlashBeam: interface=LiExtCmd1  # Flash Beam | This port provides Flash beam command
    FlashBeamIndcn: interface=ExtrLiDisp1  # Flash Beam Indication | This port provides Indication to the instrument cluster about the Flash beam on/off status
    FlashBeamOut: interface=LiExtCmd1  # Flash Beam Output | This port provides Flash beam command
    FltOfSeatClima: interface=FltStOfSeatClima1  # Seat Climatisation Fault From Actuator
    FobId: interface=Authn1  # Fob Identifier | Identifier of the Fob, for validation by Immobilizer.
    FobIdReq: interface=Authn1  # Fob Identifier Request | Request for Fob identifier from Immobilizer.
    FogFrnt: interface=LiExtCmd1  # Front Fog Light | This port provides command to turn on/off front fog lights
    FogFrntOut: interface=LiExtCmd1  # Front Fog Light Output | This port provides command to turn on/off front fog lights
    FogIndcnFrnt: interface=ExtrLiDisp1  # Front Fog Light Indication | This port provides Indication to the instrument cluster about the Front fog lights on/off status
    FogIndcnRe: interface=ExtrLiDisp1  # Rear Fog Light Indication | This port provides Indication to the instrument cluster about the Rear fog lights on/off status
    FogRe: interface=LiExtCmd1  # Rear Fog Light | This port provides command to turn on/off rear fog lights
    FogReOut: interface=LiExtCmd1  # Rear Fog Light Output | This port provides command to turn on/off rear fog lights
    FricCoeffEstimd: interface=FricCoeffEstimd1  # Friction Coefficient Estimated | Estimated used road friction coefficient.
    FricCoeffEstimd1: interface=FricCoeff1  # Friction Coefficient Estimated | Estimated used road friction coefficient.
    GbxCtrsftActv: interface=TrsmFlgCtrsftActv1  # Gearbox: Countershaft Active | Indicates whether the gear is in low range mode, e.g. for sport utility vehicles (SUV) or Offroad-vehicles with countershaft gearboxes (high range / low range). - 0: countershaft inactive (standard condition) - 1: countershaft active
    GearParkEngd: interface=TrsmFlgParkLockEngd1  # Gear Park Engaged | Status of gearbox on engaged parking lock (P-drive) of the Automatic Transmission (AT). 0 : not engaged 1 : engaged
    GearParkReq: interface=GearParkReq1  # Gear Park Request | Parking lock request from Stand Still Manager to automatic transmission to set parking position.
    GearRatAct: interface=TrsmRatGearAct1  # Gear Ratio Actual | Actual gear ratio The gear ratio being currently engaged in the gear box.
    GearShiftDwnReqFromDrvr: interface=GearShiftDwnReqFromDrvr1  # Gear shift down request by driver
    GearShiftPrevnCmftReqByAcc: interface=GearShiftPrevn1  # Gear Shift Prevention Comfort Request by ACC | Avoid change of gear for comfort reasons requested by Adaptive Cruise Control (ACC) to be arbitrated by Vehicle Longitudinal Control (VLC).
    GearShiftPrevnCmftReqByVlc: interface=GearShiftPrevn1  # Gear Shift Prevention Comfort Request by Vehicle Longitudinal Control (VLC) | Request to avoid change of gear for comfort reasons: Request to avoid shifting request includes aspects from traffic point of view. Final decision remains in the actuator control. Acceleration request tolerance band has higher priority than the gear shift prevention comfort. | This request should be sent synchronously with maximum and minimum torque request.
    GearShiftPrevnStaby: interface=GearShiftPrevn1  # Gear Shift Prevention Stability | Command to avoid change of gear for stability reasons.
    GearShiftUpReqFromDrvr: interface=GearShiftUpReqFromDrvr1  # Gear shift up request by driver
    GlvBoxHmi: interface=TogReq1  # Glove Box HMI | User request to lock / unlock the glovebox
    GlvBoxLockSt: interface=LockSt1  # Glove Box Lock State | Locking state of the glove box
    GlvBoxLockgCmd: interface=LockCmd1  # Glove Box Locking Command | Command to lock the glove box
    GlvBoxLtchRels: interface=DiagcLtchRels1  # Glove Box Latch Release | Diagnostic request to the sensor component to release/unlock the latch of the glovebox
    GlvBoxLtchRelsTog: interface=DiagcTog1  # Glove Box Latch Release Toggle | Diagnostic request to the sensor component to request a "Toggle-Function" of the latch of the glovebox
    GlvBoxSt: interface=OpendClsdSt1  # Glove Box State | Information related to the glove box, it indicates whether the glove box is opened or closed
    HdlampLvlgMan: interface=LvlgReq1  # Headlamp Manual Leveling | Port to request the position of a headlamp leveling actuator. 100% means most upward position (of the headlamps). 0% means most downward position (e.g. low beam adjusted maximum down to the road).
    HdlampLvlgRef: interface=LvlgCmd1  # Headlamp Leveling Command | This port commands the position of a headlamp leveling actuator.
    HdlampWshngFromHmi: interface=WshngReq1  # Head Lamp Washing from HMI | Carries a user request to activate the washing of headlamps. This demand is provided by the Human Machine Interface (HMI) of the vehicle
    HeatFltOfDrvrSeat: interface=FltStOfSeatClima1  # Heating Fault from Actuator | Seat Heating Fault From Actuator
    HeatFltOfPassSeat: interface=FltStOfSeatClima1  # Heating Fault from Actuator | Seat Heating Fault From Actuator
    HeatFltOfSeatReLe: interface=FltStOfSeatClima1  # Heating Fault from Actuator | Seat Heating Fault From Actuator
    HeatFltOfSeatReRi: interface=FltStOfSeatClima1  # Heating Fault from Actuator | Seat Heating Fault From Actuator
    HeatSeatFlt: interface=FltStOfSeatClima1  # Heating Seat Fault from Actuator | Seat Heating Fault From Actuator
    HeatgCmdToActrOfSeatHeatg: interface=SeatClimaCmd1  # Heating Command to Actuator of Seat Heating | Heating command To Actuator Of a Seat
    HldOnDmdSt: interface=HldOnDmdSt1  # Hold on Demand Status | Failure status of the Hold On Demand function
    HldOnDmdSts: interface=HldOnDmdSts1  # Hold on Demand Status | Failure status of the Hold On Demand function
    HndbrkSwt: interface=HndbrkSwt1  # Handbrake Switch | Indication that the handbrake switch is applied.
    HndlgBalCoeff: interface=HndlgBalCoeff1  # Handling Balance Coefficient | Estimated full active suspension handling balance coefficient defined as deviation from defined understeering characteristics. Ranging from maximum applicable understeering to maximum applicable oversteering
    HomeCmngAndHomeLvngOut: interface=LiExtCmd1  # Coming Home Leaving Home Output | This port provides command to activate coming home/leaving home lights
    HomeCmngAndHomeLvngReq: interface=HomeCmngAndHomeLvngReq1  # Coming Home Leaving Home | Request to start coming home/leaving home.
    HoopRollCmd: interface=HoopRollCmd1  # Roll Hoop Command | Command for roll hoop
    HoopRollSt: interface=HoopRollSt1  # Roll Hoop Status | Status of roll hoop actuator
    HoopRollSts: interface=HoopRollSts1  # Roll Hoop Status | Status of roll hoop actuator
    HornActvn: interface=HornCmd1  # Horn Activation Command | Command to activate or deactivate the horn actuator
    HornDispDfct: interface=DispDfct1  # Horn Defect Display | Information on defect related to the horn control
    HornReqFromHmi: interface=HornReq1  # Horn Request from HMI | Request for horn. This request comes from the HMI
    HornSt: interface=HornSt1  # Horn Status | Fault state of the horn actuator
    HornSts: interface=HornSts1  # Horn Status | Fault state of the horn actuator
    HtlMod: interface=HtlModReq1  # Hotel Mode | Request to activate or deactivate the hotel mode. Hotel mode is a subset of the customer mode, example: minimum access to the vehicle without any access to the glovebox.
    HtlModSt: interface=HtlModSt1  # Hotel Mode Status | Information of the activation/deactivation of the hotel mode
    HtlModSts: interface=HtlModSts1  # Hotel Mode Status | Information of the activation/deactivation of the hotel mode
    HvacDefrstReqFrnt: interface=LvlDefrstReq1  # Front Defrost Request from Hvac | Port for Front Defrost Request From Hvac
    HvacDefrstReqRe: interface=LvlDefrstReq1  # Rear Defrost Request from Hvac | Port for Rear Defrost Request From Hvac
    HvacDefrstStFrnt: interface=LvlDefrstSt1  # Front Defrost Status to Hvac | Port for Front Defrost Status To Hvac
    HvacDefrstStRe: interface=LvlDefrstSt1  # Rear Defrost Status to Hvac | Port for Rear Defrost Status To Hvac
    HvacDefrstStsFrnt: interface=LvlDefrstSts1  # Front Defrost Status to Hvac | Port for Front Defrost Status To Hvac
    HvacDefrstStsRe: interface=LvlDefrstSts1  # Rear Defrost Status to Hvac | Port for Rear Defrost Status To Hvac
    HvacTq: interface=HvacTq1  # Mechanical Torque for A/C Compressor | Mechanical torque for Air Conditioning (A/C) compressor. This value must take into account all relevant dynamic effects, e.g. transient torque increase during activation of the Air Conditioning (A/C) compressor. It is converted to engine crankshaft torque by the provider. | Default value after reset is zero.
    HvacTqReq: interface=HvacTqReq1  # Requested Mechanical Torque for A/C Compressor | Requested mechanical torque for Air Conditioning (A/C) compressor. This value represents the torque consumption in a predicted future state. It is converted to engine crankshaft torque by the provider. Examples of realization: Before activation of the Air Conditioning (A/C) compressor this interface could contain either - the predicted highest torque consumption during the activation process. - the predicted torque consumption in steady state after the activation is finished. | Default value after reset is zero.
    HzrdWarn: interface=ExtrLiDisp1  # Hazard Warning | This port provides Indication to Instrument cluster and other body functionalities of Hazard lamps activation status. Use case: illumination of hazard switch is often used for functional indication too (see Internal Lights)
    ImobAlrmReq: interface=AlrmAcoustCmd1  # Immobilizer Alarm Request | Request to activate/deactivate the acoustic indication
    ImobSt: interface=ImobSt1  # Immobilizer Status | Status of the Immobilizer
    ImobSts: interface=ImobSts1  # Immobilizer Status | Status of the Immobilizer
    ImobnWirels: interface=ImobnWirelsReq1  # Immobilization Request from Wireless | Signal to immobilize the vehicle from a wireless terminal
    ImpctLocnEstimdOfCrashAtFrnt: interface=LocnOfImpctAtCrash1  # Impact Location Estimated of Crash at Front | Estimated impact locations of frontal crash
    ImpctLocnEstimdOfCrashAtLe: interface=LocnOfImpctAtCrash1  # Impact Location Estimated of Crash at Left | Estimated impact locations of left side crash
    ImpctLocnEstimdOfCrashAtRe: interface=LocnOfImpctAtCrash1  # Impact Location Estimated of Crash at Rear | Estimated impact locations of rear crash
    ImpctLocnEstimdOfCrashAtRi: interface=LocnOfImpctAtCrash1  # Impact Location Estimated of Crash at Right | Estimated impact locations of right side crash
    IndcrDisp: interface=IndcrDisp1  # Indicator Display | This port provides Indication to Instrument cluster of Left/Right turn indicator activation status.
    IndcrOut: interface=IndcrTurnCmd1  # Indicator Output | This port provides request to Turn on or off the turn indicators
    IndcrPat: interface=IndcrPatCmd1  # Indicator Pattern | This port provides request to Set a pattern for flashing sequence
    IntrLiBriActvn: interface=BriCmd1  # Interior Light Brightness Activation | The brightness of a light source is requested by a percentage value (independent of light actuator type and environment e.g. voltage of electrical system). It depends on the functionality when the light source shall be switched on. | 100 percent means full power of the light actuator
    IntrLiBriActvnOfAshtrayLiFrntCen: interface=BriCmd1  # Activation of Interior Light Source Brightness | The brightness of a interior light source is requested by the interior light manager. The percentage value (independent of light actuator type and environment e.g. voltage of electrical system) depends on the functionality that the light source shall be switched on. 100 percent means full power of the light actuator
    IntrLiBriActvnOfAshtrayLiFrntLe: interface=BriCmd1  # Activation of Interior Light Source Brightness | The brightness of a interior light source is requested by the interior light manager. The percentage value (independent of light actuator type and environment e.g. voltage of electrical system) depends on the functionality that the light source shall be switched on. 100 percent means full power of the light actuator
    IntrLiBriActvnOfAshtrayLiFrntRi: interface=BriCmd1  # Activation of Interior Light Source Brightness | The brightness of a interior light source is requested by the interior light manager. The percentage value (independent of light actuator type and environment e.g. voltage of electrical system) depends on the functionality that the light source shall be switched on. 100 percent means full power of the light actuator
    IntrLiBriActvnOfAshtrayLiGroup: interface=BriCmd1  # Activation of Interior Light Source Brightness | The brightness of a interior light source is requested by the interior light manager. The percentage value (independent of light actuator type and environment e.g. voltage of electrical system) depends on the functionality that the light source shall be switched on. 100 percent means full power of the light actuator
    IntrLiBriActvnOfAshtrayLiMidCen: interface=BriCmd1  # Activation of Interior Light Source Brightness | The brightness of a interior light source is requested by the interior light manager. The percentage value (independent of light actuator type and environment e.g. voltage of electrical system) depends on the functionality that the light source shall be switched on. 100 percent means full power of the light actuator
    IntrLiBriActvnOfAshtrayLiMidLe: interface=BriCmd1  # Activation of Interior Light Source Brightness | The brightness of a interior light source is requested by the interior light manager. The percentage value (independent of light actuator type and environment e.g. voltage of electrical system) depends on the functionality that the light source shall be switched on. 100 percent means full power of the light actuator
    IntrLiBriActvnOfAshtrayLiMidRi: interface=BriCmd1  # Activation of Interior Light Source Brightness | The brightness of a interior light source is requested by the interior light manager. The percentage value (independent of light actuator type and environment e.g. voltage of electrical system) depends on the functionality that the light source shall be switched on. 100 percent means full power of the light actuator
    IntrLiBriActvnOfAshtrayLiReCen: interface=BriCmd1  # Activation of Interior Light Source Brightness | The brightness of a interior light source is requested by the interior light manager. The percentage value (independent of light actuator type and environment e.g. voltage of electrical system) depends on the functionality that the light source shall be switched on. 100 percent means full power of the light actuator
    IntrLiBriActvnOfAshtrayLiReLe: interface=BriCmd1  # Activation of Interior Light Source Brightness | The brightness of a interior light source is requested by the interior light manager. The percentage value (independent of light actuator type and environment e.g. voltage of electrical system) depends on the functionality that the light source shall be switched on. 100 percent means full power of the light actuator
    IntrLiBriActvnOfAshtrayLiReRi: interface=BriCmd1  # Activation of Interior Light Source Brightness | The brightness of a interior light source is requested by the interior light manager. The percentage value (independent of light actuator type and environment e.g. voltage of electrical system) depends on the functionality that the light source shall be switched on. 100 percent means full power of the light actuator
    IntrLiBriActvnOfCbnLiFrntCen: interface=BriCmd1  # Activation of Interior Light Source Brightness | The brightness of a interior light source is requested by the interior light manager. The percentage value (independent of light actuator type and environment e.g. voltage of electrical system) depends on the functionality that the light source shall be switched on. 100 percent means full power of the light actuator
    IntrLiBriActvnOfCbnLiFrntLe: interface=BriCmd1  # Activation of Interior Light Source Brightness | The brightness of a interior light source is requested by the interior light manager. The percentage value (independent of light actuator type and environment e.g. voltage of electrical system) depends on the functionality that the light source shall be switched on. 100 percent means full power of the light actuator
    IntrLiBriActvnOfCbnLiFrntRi: interface=BriCmd1  # Activation of Interior Light Source Brightness | The brightness of a interior light source is requested by the interior light manager. The percentage value (independent of light actuator type and environment e.g. voltage of electrical system) depends on the functionality that the light source shall be switched on. 100 percent means full power of the light actuator
    IntrLiBriActvnOfCbnLiGroup: interface=BriCmd1  # Activation of Interior Light Source Brightness | The brightness of a interior light source is requested by the interior light manager. The percentage value (independent of light actuator type and environment e.g. voltage of electrical system) depends on the functionality that the light source shall be switched on. 100 percent means full power of the light actuator
    IntrLiBriActvnOfCbnLiMidCen: interface=BriCmd1  # Activation of Interior Light Source Brightness | The brightness of a interior light source is requested by the interior light manager. The percentage value (independent of light actuator type and environment e.g. voltage of electrical system) depends on the functionality that the light source shall be switched on. 100 percent means full power of the light actuator
    IntrLiBriActvnOfCbnLiMidLe: interface=BriCmd1  # Activation of Interior Light Source Brightness | The brightness of a interior light source is requested by the interior light manager. The percentage value (independent of light actuator type and environment e.g. voltage of electrical system) depends on the functionality that the light source shall be switched on. 100 percent means full power of the light actuator
    IntrLiBriActvnOfCbnLiMidRi: interface=BriCmd1  # Activation of Interior Light Source Brightness | The brightness of a interior light source is requested by the interior light manager. The percentage value (independent of light actuator type and environment e.g. voltage of electrical system) depends on the functionality that the light source shall be switched on. 100 percent means full power of the light actuator
    IntrLiBriActvnOfCbnLiReCen: interface=BriCmd1  # Activation of Interior Light Source Brightness | The brightness of a interior light source is requested by the interior light manager. The percentage value (independent of light actuator type and environment e.g. voltage of electrical system) depends on the functionality that the light source shall be switched on. 100 percent means full power of the light actuator
    IntrLiBriActvnOfCbnLiReLe: interface=BriCmd1  # Activation of Interior Light Source Brightness | The brightness of a interior light source is requested by the interior light manager. The percentage value (independent of light actuator type and environment e.g. voltage of electrical system) depends on the functionality that the light source shall be switched on. 100 percent means full power of the light actuator
    IntrLiBriActvnOfCbnLiReRi: interface=BriCmd1  # Activation of Interior Light Source Brightness | The brightness of a interior light source is requested by the interior light manager. The percentage value (independent of light actuator type and environment e.g. voltage of electrical system) depends on the functionality that the light source shall be switched on. 100 percent means full power of the light actuator
    IntrLiBriActvnOfCurbLiFrntLe: interface=BriCmd1  # Activation of Interior Light Source Brightness | The brightness of a interior light source is requested by the interior light manager. The percentage value (independent of light actuator type and environment e.g. voltage of electrical system) depends on the functionality that the light source shall be switched on. 100 percent means full power of the light actuator
    IntrLiBriActvnOfCurbLiFrntRi: interface=BriCmd1  # Activation of Interior Light Source Brightness | The brightness of a interior light source is requested by the interior light manager. The percentage value (independent of light actuator type and environment e.g. voltage of electrical system) depends on the functionality that the light source shall be switched on. 100 percent means full power of the light actuator
    IntrLiBriActvnOfCurbLiGroup: interface=BriCmd1  # Activation of Interior Light Source Brightness | The brightness of a interior light source is requested by the interior light manager. The percentage value (independent of light actuator type and environment e.g. voltage of electrical system) depends on the functionality that the light source shall be switched on. 100 percent means full power of the light actuator
    IntrLiBriActvnOfCurbLiMidLe: interface=BriCmd1  # Activation of Interior Light Source Brightness | The brightness of a interior light source is requested by the interior light manager. The percentage value (independent of light actuator type and environment e.g. voltage of electrical system) depends on the functionality that the light source shall be switched on. 100 percent means full power of the light actuator
    IntrLiBriActvnOfCurbLiMidRi: interface=BriCmd1  # Activation of Interior Light Source Brightness | The brightness of a interior light source is requested by the interior light manager. The percentage value (independent of light actuator type and environment e.g. voltage of electrical system) depends on the functionality that the light source shall be switched on. 100 percent means full power of the light actuator
    IntrLiBriActvnOfCurbLiReLe: interface=BriCmd1  # Activation of Interior Light Source Brightness | The brightness of a interior light source is requested by the interior light manager. The percentage value (independent of light actuator type and environment e.g. voltage of electrical system) depends on the functionality that the light source shall be switched on. 100 percent means full power of the light actuator
    IntrLiBriActvnOfCurbLiReRi: interface=BriCmd1  # Activation of Interior Light Source Brightness | The brightness of a interior light source is requested by the interior light manager. The percentage value (independent of light actuator type and environment e.g. voltage of electrical system) depends on the functionality that the light source shall be switched on. 100 percent means full power of the light actuator
    IntrLiBriActvnOfEngCmptmtLi: interface=BriCmd1  # Activation of Interior Light Source Brightness | The brightness of a interior light source is requested by the interior light manager. The percentage value (independent of light actuator type and environment e.g. voltage of electrical system) depends on the functionality that the light source shall be switched on. 100 percent means full power of the light actuator
    IntrLiBriActvnOfExtrLiSwtIllmn: interface=BriCmd1  # Activation of Interior Light Source Brightness | The brightness of a interior light source is requested by the interior light manager. The percentage value (independent of light actuator type and environment e.g. voltage of electrical system) depends on the functionality that the light source shall be switched on. 100 percent means full power of the light actuator
    IntrLiBriActvnOfFootwellGroup: interface=BriCmd1  # Activation of Interior Light Source Brightness | The brightness of a interior light source is requested by the interior light manager. The percentage value (independent of light actuator type and environment e.g. voltage of electrical system) depends on the functionality that the light source shall be switched on. 100 percent means full power of the light actuator
    IntrLiBriActvnOfFootwellLiFrntCen: interface=BriCmd1  # Activation of Interior Light Source Brightness | The brightness of a interior light source is requested by the interior light manager. The percentage value (independent of light actuator type and environment e.g. voltage of electrical system) depends on the functionality that the light source shall be switched on. 100 percent means full power of the light actuator
    IntrLiBriActvnOfFootwellLiFrntLe: interface=BriCmd1  # Activation of Interior Light Source Brightness | The brightness of a interior light source is requested by the interior light manager. The percentage value (independent of light actuator type and environment e.g. voltage of electrical system) depends on the functionality that the light source shall be switched on. 100 percent means full power of the light actuator
    IntrLiBriActvnOfFootwellLiFrntRi: interface=BriCmd1  # Activation of Interior Light Source Brightness | The brightness of a interior light source is requested by the interior light manager. The percentage value (independent of light actuator type and environment e.g. voltage of electrical system) depends on the functionality that the light source shall be switched on. 100 percent means full power of the light actuator
    IntrLiBriActvnOfFootwellLiMidCen: interface=BriCmd1  # Activation of Interior Light Source Brightness | The brightness of a interior light source is requested by the interior light manager. The percentage value (independent of light actuator type and environment e.g. voltage of electrical system) depends on the functionality that the light source shall be switched on. 100 percent means full power of the light actuator
    IntrLiBriActvnOfFootwellLiMidLe: interface=BriCmd1  # Activation of Interior Light Source Brightness | The brightness of a interior light source is requested by the interior light manager. The percentage value (independent of light actuator type and environment e.g. voltage of electrical system) depends on the functionality that the light source shall be switched on. 100 percent means full power of the light actuator
    IntrLiBriActvnOfFootwellLiMidRi: interface=BriCmd1  # Activation of Interior Light Source Brightness | The brightness of a interior light source is requested by the interior light manager. The percentage value (independent of light actuator type and environment e.g. voltage of electrical system) depends on the functionality that the light source shall be switched on. 100 percent means full power of the light actuator
    IntrLiBriActvnOfFootwellLiReCen: interface=BriCmd1  # Activation of Interior Light Source Brightness | The brightness of a interior light source is requested by the interior light manager. The percentage value (independent of light actuator type and environment e.g. voltage of electrical system) depends on the functionality that the light source shall be switched on. 100 percent means full power of the light actuator
    IntrLiBriActvnOfFootwellLiReLe: interface=BriCmd1  # Activation of Interior Light Source Brightness | The brightness of a interior light source is requested by the interior light manager. The percentage value (independent of light actuator type and environment e.g. voltage of electrical system) depends on the functionality that the light source shall be switched on. 100 percent means full power of the light actuator
    IntrLiBriActvnOfFootwellLiReRi: interface=BriCmd1  # Activation of Interior Light Source Brightness | The brightness of a interior light source is requested by the interior light manager. The percentage value (independent of light actuator type and environment e.g. voltage of electrical system) depends on the functionality that the light source shall be switched on. 100 percent means full power of the light actuator
    IntrLiBriActvnOfGlvCmptmtLi: interface=BriCmd1  # Activation of Interior Light Source Brightness | The brightness of a interior light source is requested by the interior light manager. The percentage value (independent of light actuator type and environment e.g. voltage of electrical system) depends on the functionality that the light source shall be switched on. 100 percent means full power of the light actuator
    IntrLiBriActvnOfIgnSwtIllmn: interface=BriCmd1  # Activation of Interior Light Source Brightness | The brightness of a interior light source is requested by the interior light manager. The percentage value (independent of light actuator type and environment e.g. voltage of electrical system) depends on the functionality that the light source shall be switched on. 100 percent means full power of the light actuator
    IntrLiBriActvnOfIntrLiGroup0: interface=BriCmd1  # Activation of Interior Light Source Brightness | The brightness of a interior light source is requested by the interior light manager. The percentage value (independent of light actuator type and environment e.g. voltage of electrical system) depends on the functionality that the light source shall be switched on. 100 percent means full power of the light actuator
    IntrLiBriActvnOfIntrLiGroup1: interface=BriCmd1  # Activation of Interior Light Source Brightness | The brightness of a interior light source is requested by the interior light manager. The percentage value (independent of light actuator type and environment e.g. voltage of electrical system) depends on the functionality that the light source shall be switched on. 100 percent means full power of the light actuator
    IntrLiBriActvnOfIntrLiGroup{10..15}: interface=BriCmd1  # Activation of Interior Light Source Brightness | The brightness of a interior light source is requested by the interior light manager. The percentage value (independent of light actuator type and environment e.g. voltage of electrical system) depends on the functionality that the light source shall be switched on. 100 percent means full power of the light actuator
    IntrLiBriActvnOfIntrLiGroup{2..9}: interface=BriCmd1  # Activation of Interior Light Source Brightness | The brightness of a interior light source is requested by the interior light manager. The percentage value (independent of light actuator type and environment e.g. voltage of electrical system) depends on the functionality that the light source shall be switched on. 100 percent means full power of the light actuator
    IntrLiBriActvnOfLiForCigaretteLighterIllmnAtTrLe: interface=BriCmd1  # Activation of Interior Light Source Brightness | The brightness of a interior light source is requested by the interior light manager. The percentage value (independent of light actuator type and environment e.g. voltage of electrical system) depends on the functionality that the light source shall be switched on. 100 percent means full power of the light actuator
    IntrLiBriActvnOfLiForCigaretteLighterIllmnAtTrRi: interface=BriCmd1  # Activation of Interior Light Source Brightness | The brightness of a interior light source is requested by the interior light manager. The percentage value (independent of light actuator type and environment e.g. voltage of electrical system) depends on the functionality that the light source shall be switched on. 100 percent means full power of the light actuator
    IntrLiBriActvnOfLiForCigaretteLighterIllmnFrntCen: interface=BriCmd1  # Activation of Interior Light Source Brightness | The brightness of a interior light source is requested by the interior light manager. The percentage value (independent of light actuator type and environment e.g. voltage of electrical system) depends on the functionality that the light source shall be switched on. 100 percent means full power of the light actuator
    IntrLiBriActvnOfLiForCigaretteLighterIllmnFrntLe: interface=BriCmd1  # Activation of Interior Light Source Brightness | The brightness of a interior light source is requested by the interior light manager. The percentage value (independent of light actuator type and environment e.g. voltage of electrical system) depends on the functionality that the light source shall be switched on. 100 percent means full power of the light actuator
    IntrLiBriActvnOfLiForCigaretteLighterIllmnFrntRi: interface=BriCmd1  # Activation of Interior Light Source Brightness | The brightness of a interior light source is requested by the interior light manager. The percentage value (independent of light actuator type and environment e.g. voltage of electrical system) depends on the functionality that the light source shall be switched on. 100 percent means full power of the light actuator
    IntrLiBriActvnOfLiForCigaretteLighterIllmnGroup: interface=BriCmd1  # Activation of Interior Light Source Brightness | The brightness of a interior light source is requested by the interior light manager. The percentage value (independent of light actuator type and environment e.g. voltage of electrical system) depends on the functionality that the light source shall be switched on. 100 percent means full power of the light actuator
    IntrLiBriActvnOfLiForCigaretteLighterIllmnMidCen: interface=BriCmd1  # Activation of Interior Light Source Brightness | The brightness of a interior light source is requested by the interior light manager. The percentage value (independent of light actuator type and environment e.g. voltage of electrical system) depends on the functionality that the light source shall be switched on. 100 percent means full power of the light actuator
    IntrLiBriActvnOfLiForCigaretteLighterIllmnMidLe: interface=BriCmd1  # Activation of Interior Light Source Brightness | The brightness of a interior light source is requested by the interior light manager. The percentage value (independent of light actuator type and environment e.g. voltage of electrical system) depends on the functionality that the light source shall be switched on. 100 percent means full power of the light actuator
    IntrLiBriActvnOfLiForCigaretteLighterIllmnMidRi: interface=BriCmd1  # Activation of Interior Light Source Brightness | The brightness of a interior light source is requested by the interior light manager. The percentage value (independent of light actuator type and environment e.g. voltage of electrical system) depends on the functionality that the light source shall be switched on. 100 percent means full power of the light actuator
    IntrLiBriActvnOfLiForCigaretteLighterIllmnReCen: interface=BriCmd1  # Activation of Interior Light Source Brightness | The brightness of a interior light source is requested by the interior light manager. The percentage value (independent of light actuator type and environment e.g. voltage of electrical system) depends on the functionality that the light source shall be switched on. 100 percent means full power of the light actuator
    IntrLiBriActvnOfLiForCigaretteLighterIllmnReLe: interface=BriCmd1  # Activation of Interior Light Source Brightness | The brightness of a interior light source is requested by the interior light manager. The percentage value (independent of light actuator type and environment e.g. voltage of electrical system) depends on the functionality that the light source shall be switched on. 100 percent means full power of the light actuator
    IntrLiBriActvnOfLiForCigaretteLighterIllmnReRi: interface=BriCmd1  # Activation of Interior Light Source Brightness | The brightness of a interior light source is requested by the interior light manager. The percentage value (independent of light actuator type and environment e.g. voltage of electrical system) depends on the functionality that the light source shall be switched on. 100 percent means full power of the light actuator
    IntrLiBriActvnOfLiForDoorOpenerIllmnFrntLe: interface=BriCmd1  # Activation of Interior Light Source Brightness | The brightness of a interior light source is requested by the interior light manager. The percentage value (independent of light actuator type and environment e.g. voltage of electrical system) depends on the functionality that the light source shall be switched on. 100 percent means full power of the light actuator
    IntrLiBriActvnOfLiForDoorOpenerIllmnFrntRi: interface=BriCmd1  # Activation of Interior Light Source Brightness | The brightness of a interior light source is requested by the interior light manager. The percentage value (independent of light actuator type and environment e.g. voltage of electrical system) depends on the functionality that the light source shall be switched on. 100 percent means full power of the light actuator
    IntrLiBriActvnOfLiForDoorOpenerIllmnGroup: interface=BriCmd1  # Activation of Interior Light Source Brightness | The brightness of a interior light source is requested by the interior light manager. The percentage value (independent of light actuator type and environment e.g. voltage of electrical system) depends on the functionality that the light source shall be switched on. 100 percent means full power of the light actuator
    IntrLiBriActvnOfLiForDoorOpenerIllmnMidLe: interface=BriCmd1  # Activation of Interior Light Source Brightness | The brightness of a interior light source is requested by the interior light manager. The percentage value (independent of light actuator type and environment e.g. voltage of electrical system) depends on the functionality that the light source shall be switched on. 100 percent means full power of the light actuator
    IntrLiBriActvnOfLiForDoorOpenerIllmnMidRi: interface=BriCmd1  # Activation of Interior Light Source Brightness | The brightness of a interior light source is requested by the interior light manager. The percentage value (independent of light actuator type and environment e.g. voltage of electrical system) depends on the functionality that the light source shall be switched on. 100 percent means full power of the light actuator
    IntrLiBriActvnOfLiForDoorOpenerIllmnReLe: interface=BriCmd1  # Activation of Interior Light Source Brightness | The brightness of a interior light source is requested by the interior light manager. The percentage value (independent of light actuator type and environment e.g. voltage of electrical system) depends on the functionality that the light source shall be switched on. 100 percent means full power of the light actuator
    IntrLiBriActvnOfLiForDoorOpenerIllmnReRi: interface=BriCmd1  # Activation of Interior Light Source Brightness | The brightness of a interior light source is requested by the interior light manager. The percentage value (independent of light actuator type and environment e.g. voltage of electrical system) depends on the functionality that the light source shall be switched on. 100 percent means full power of the light actuator
    IntrLiBriActvnOfLiForDoorSillIllmnFrntLe: interface=BriCmd1  # Activation of Interior Light Source Brightness | The brightness of a interior light source is requested by the interior light manager. The percentage value (independent of light actuator type and environment e.g. voltage of electrical system) depends on the functionality that the light source shall be switched on. 100 percent means full power of the light actuator
    IntrLiBriActvnOfLiForDoorSillIllmnFrntRi: interface=BriCmd1  # Activation of Interior Light Source Brightness | The brightness of a interior light source is requested by the interior light manager. The percentage value (independent of light actuator type and environment e.g. voltage of electrical system) depends on the functionality that the light source shall be switched on. 100 percent means full power of the light actuator
    IntrLiBriActvnOfLiForDoorSillIllmnGroup: interface=BriCmd1  # Activation of Interior Light Source Brightness | The brightness of a interior light source is requested by the interior light manager. The percentage value (independent of light actuator type and environment e.g. voltage of electrical system) depends on the functionality that the light source shall be switched on. 100 percent means full power of the light actuator
    IntrLiBriActvnOfLiForDoorSillIllmnMidLe: interface=BriCmd1  # Activation of Interior Light Source Brightness | The brightness of a interior light source is requested by the interior light manager. The percentage value (independent of light actuator type and environment e.g. voltage of electrical system) depends on the functionality that the light source shall be switched on. 100 percent means full power of the light actuator
    IntrLiBriActvnOfLiForDoorSillIllmnMidRi: interface=BriCmd1  # Activation of Interior Light Source Brightness | The brightness of a interior light source is requested by the interior light manager. The percentage value (independent of light actuator type and environment e.g. voltage of electrical system) depends on the functionality that the light source shall be switched on. 100 percent means full power of the light actuator
    IntrLiBriActvnOfLiForDoorSillIllmnReLe: interface=BriCmd1  # Activation of Interior Light Source Brightness | The brightness of a interior light source is requested by the interior light manager. The percentage value (independent of light actuator type and environment e.g. voltage of electrical system) depends on the functionality that the light source shall be switched on. 100 percent means full power of the light actuator
    IntrLiBriActvnOfLiForDoorSillIllmnReRi: interface=BriCmd1  # Activation of Interior Light Source Brightness | The brightness of a interior light source is requested by the interior light manager. The percentage value (independent of light actuator type and environment e.g. voltage of electrical system) depends on the functionality that the light source shall be switched on. 100 percent means full power of the light actuator
    IntrLiBriActvnOfLiForReadingAtRowThrdCen: interface=BriCmd1  # Activation of Interior Light Source Brightness | The brightness of a interior light source is requested by the interior light manager. The percentage value (independent of light actuator type and environment e.g. voltage of electrical system) depends on the functionality that the light source shall be switched on. 100 percent means full power of the light actuator
    IntrLiBriActvnOfLiForReadingAtRowThrdLe: interface=BriCmd1  # Activation of Interior Light Source Brightness | The brightness of a interior light source is requested by the interior light manager. The percentage value (independent of light actuator type and environment e.g. voltage of electrical system) depends on the functionality that the light source shall be switched on. 100 percent means full power of the light actuator
    IntrLiBriActvnOfLiForReadingAtRowThrdRi: interface=BriCmd1  # Activation of Interior Light Source Brightness | The brightness of a interior light source is requested by the interior light manager. The percentage value (independent of light actuator type and environment e.g. voltage of electrical system) depends on the functionality that the light source shall be switched on. 100 percent means full power of the light actuator
    IntrLiBriActvnOfLiForReadingFrntCen: interface=BriCmd1  # Activation of Interior Light Source Brightness | The brightness of a interior light source is requested by the interior light manager. The percentage value (independent of light actuator type and environment e.g. voltage of electrical system) depends on the functionality that the light source shall be switched on. 100 percent means full power of the light actuator
    IntrLiBriActvnOfLiForReadingFrntLe: interface=BriCmd1  # Activation of Interior Light Source Brightness | The brightness of a interior light source is requested by the interior light manager. The percentage value (independent of light actuator type and environment e.g. voltage of electrical system) depends on the functionality that the light source shall be switched on. 100 percent means full power of the light actuator
    IntrLiBriActvnOfLiForReadingFrntRi: interface=BriCmd1  # Activation of Interior Light Source Brightness | The brightness of a interior light source is requested by the interior light manager. The percentage value (independent of light actuator type and environment e.g. voltage of electrical system) depends on the functionality that the light source shall be switched on. 100 percent means full power of the light actuator
    IntrLiBriActvnOfLiForReadingGroup: interface=BriCmd1  # Activation of Interior Light Source Brightness | The brightness of a interior light source is requested by the interior light manager. The percentage value (independent of light actuator type and environment e.g. voltage of electrical system) depends on the functionality that the light source shall be switched on. 100 percent means full power of the light actuator
    IntrLiBriActvnOfLiForReadingReCen: interface=BriCmd1  # Activation of Interior Light Source Brightness | The brightness of a interior light source is requested by the interior light manager. The percentage value (independent of light actuator type and environment e.g. voltage of electrical system) depends on the functionality that the light source shall be switched on. 100 percent means full power of the light actuator
    IntrLiBriActvnOfLiForReadingReLe: interface=BriCmd1  # Activation of Interior Light Source Brightness | The brightness of a interior light source is requested by the interior light manager. The percentage value (independent of light actuator type and environment e.g. voltage of electrical system) depends on the functionality that the light source shall be switched on. 100 percent means full power of the light actuator
    IntrLiBriActvnOfLiForReadingReRi: interface=BriCmd1  # Activation of Interior Light Source Brightness | The brightness of a interior light source is requested by the interior light manager. The percentage value (independent of light actuator type and environment e.g. voltage of electrical system) depends on the functionality that the light source shall be switched on. 100 percent means full power of the light actuator
    IntrLiBriActvnOfLiForSftyBltLockIllmnFrntCen: interface=BriCmd1  # Activation of Interior Light Source Brightness | The brightness of a interior light source is requested by the interior light manager. The percentage value (independent of light actuator type and environment e.g. voltage of electrical system) depends on the functionality that the light source shall be switched on. 100 percent means full power of the light actuator
    IntrLiBriActvnOfLiForSftyBltLockIllmnFrntLe: interface=BriCmd1  # Activation of Interior Light Source Brightness | The brightness of a interior light source is requested by the interior light manager. The percentage value (independent of light actuator type and environment e.g. voltage of electrical system) depends on the functionality that the light source shall be switched on. 100 percent means full power of the light actuator
    IntrLiBriActvnOfLiForSftyBltLockIllmnFrntRi: interface=BriCmd1  # Activation of Interior Light Source Brightness | The brightness of a interior light source is requested by the interior light manager. The percentage value (independent of light actuator type and environment e.g. voltage of electrical system) depends on the functionality that the light source shall be switched on. 100 percent means full power of the light actuator
    IntrLiBriActvnOfLiForSftyBltLockIllmnGroup: interface=BriCmd1  # Activation of Interior Light Source Brightness | The brightness of a interior light source is requested by the interior light manager. The percentage value (independent of light actuator type and environment e.g. voltage of electrical system) depends on the functionality that the light source shall be switched on. 100 percent means full power of the light actuator
    IntrLiBriActvnOfLiForSftyBltLockIllmnMidCen: interface=BriCmd1  # Activation of Interior Light Source Brightness | The brightness of a interior light source is requested by the interior light manager. The percentage value (independent of light actuator type and environment e.g. voltage of electrical system) depends on the functionality that the light source shall be switched on. 100 percent means full power of the light actuator
    IntrLiBriActvnOfLiForSftyBltLockIllmnMidLe: interface=BriCmd1  # Activation of Interior Light Source Brightness | The brightness of a interior light source is requested by the interior light manager. The percentage value (independent of light actuator type and environment e.g. voltage of electrical system) depends on the functionality that the light source shall be switched on. 100 percent means full power of the light actuator
    IntrLiBriActvnOfLiForSftyBltLockIllmnMidRi: interface=BriCmd1  # Activation of Interior Light Source Brightness | The brightness of a interior light source is requested by the interior light manager. The percentage value (independent of light actuator type and environment e.g. voltage of electrical system) depends on the functionality that the light source shall be switched on. 100 percent means full power of the light actuator
    IntrLiBriActvnOfLiForSftyBltLockIllmnReCen: interface=BriCmd1  # Activation of Interior Light Source Brightness | The brightness of a interior light source is requested by the interior light manager. The percentage value (independent of light actuator type and environment e.g. voltage of electrical system) depends on the functionality that the light source shall be switched on. 100 percent means full power of the light actuator
    IntrLiBriActvnOfLiForSftyBltLockIllmnReLe: interface=BriCmd1  # Activation of Interior Light Source Brightness | The brightness of a interior light source is requested by the interior light manager. The percentage value (independent of light actuator type and environment e.g. voltage of electrical system) depends on the functionality that the light source shall be switched on. 100 percent means full power of the light actuator
    IntrLiBriActvnOfLiForSftyBltLockIllmnReRi: interface=BriCmd1  # Activation of Interior Light Source Brightness | The brightness of a interior light source is requested by the interior light manager. The percentage value (independent of light actuator type and environment e.g. voltage of electrical system) depends on the functionality that the light source shall be switched on. 100 percent means full power of the light actuator
    IntrLiBriActvnOfSwtIllmnForHzrdWarn: interface=BriCmd1  # Interior Light Brightness Activation of Hazard Warning Switch Illumination | Activation Of Interior Hazard Warning Switch Illumination (percentage value)
    IntrLiBriActvnOfTrCmptmtGroup: interface=BriCmd1  # Activation of Interior Light Source Brightness | The brightness of a interior light source is requested by the interior light manager. The percentage value (independent of light actuator type and environment e.g. voltage of electrical system) depends on the functionality that the light source shall be switched on. 100 percent means full power of the light actuator
    IntrLiBriActvnOfTrCmptmtLiCen: interface=BriCmd1  # Activation of Interior Light Source Brightness | The brightness of a interior light source is requested by the interior light manager. The percentage value (independent of light actuator type and environment e.g. voltage of electrical system) depends on the functionality that the light source shall be switched on. 100 percent means full power of the light actuator
    IntrLiBriActvnOfTrCmptmtLiLoLe: interface=BriCmd1  # Activation of Interior Light Source Brightness | The brightness of a interior light source is requested by the interior light manager. The percentage value (independent of light actuator type and environment e.g. voltage of electrical system) depends on the functionality that the light source shall be switched on. 100 percent means full power of the light actuator
    IntrLiBriActvnOfTrCmptmtLiLoRi: interface=BriCmd1  # Activation of Interior Light Source Brightness | The brightness of a interior light source is requested by the interior light manager. The percentage value (independent of light actuator type and environment e.g. voltage of electrical system) depends on the functionality that the light source shall be switched on. 100 percent means full power of the light actuator
    IntrLiBriActvnOfTrCmptmtLiUpLe: interface=BriCmd1  # Activation of Interior Light Source Brightness | The brightness of a interior light source is requested by the interior light manager. The percentage value (independent of light actuator type and environment e.g. voltage of electrical system) depends on the functionality that the light source shall be switched on. 100 percent means full power of the light actuator
    IntrLiBriActvnOfTrCmptmtLiUpRi: interface=BriCmd1  # Activation of Interior Light Source Brightness | The brightness of a interior light source is requested by the interior light manager. The percentage value (independent of light actuator type and environment e.g. voltage of electrical system) depends on the functionality that the light source shall be switched on. 100 percent means full power of the light actuator
    IntrLiBriActvnOfVanityLiFrntLe: interface=BriCmd1  # Activation of Interior Light Source Brightness | The brightness of a interior light source is requested by the interior light manager. The percentage value (independent of light actuator type and environment e.g. voltage of electrical system) depends on the functionality that the light source shall be switched on. 100 percent means full power of the light actuator
    IntrLiBriActvnOfVanityLiFrntRi: interface=BriCmd1  # Activation of Interior Light Source Brightness | The brightness of a interior light source is requested by the interior light manager. The percentage value (independent of light actuator type and environment e.g. voltage of electrical system) depends on the functionality that the light source shall be switched on. 100 percent means full power of the light actuator
    IntrLiBriActvnOfVanityLiGroup: interface=BriCmd1  # Activation of Interior Light Source Brightness | The brightness of a interior light source is requested by the interior light manager. The percentage value (independent of light actuator type and environment e.g. voltage of electrical system) depends on the functionality that the light source shall be switched on. 100 percent means full power of the light actuator
    IntrLiBriActvnOfVanityLiMidLe: interface=BriCmd1  # Activation of Interior Light Source Brightness | The brightness of a interior light source is requested by the interior light manager. The percentage value (independent of light actuator type and environment e.g. voltage of electrical system) depends on the functionality that the light source shall be switched on. 100 percent means full power of the light actuator
    IntrLiBriActvnOfVanityLiMidRi: interface=BriCmd1  # Activation of Interior Light Source Brightness | The brightness of a interior light source is requested by the interior light manager. The percentage value (independent of light actuator type and environment e.g. voltage of electrical system) depends on the functionality that the light source shall be switched on. 100 percent means full power of the light actuator
    IntrLiBriActvnOfVanityLiReLe: interface=BriCmd1  # Activation of Interior Light Source Brightness | The brightness of a interior light source is requested by the interior light manager. The percentage value (independent of light actuator type and environment e.g. voltage of electrical system) depends on the functionality that the light source shall be switched on. 100 percent means full power of the light actuator
    IntrLiBriActvnOfVanityLiReRi: interface=BriCmd1  # Activation of Interior Light Source Brightness | The brightness of a interior light source is requested by the interior light manager. The percentage value (independent of light actuator type and environment e.g. voltage of electrical system) depends on the functionality that the light source shall be switched on. 100 percent means full power of the light actuator
    IntrLiReqFromHmiToAshtrayLiFrntCen: interface=IntrLiReq1  # HMI Switch for Interior Light Source | User request to activate / deactivate an interior light source (switch on/off or automatic mode).
    IntrLiReqFromHmiToAshtrayLiFrntLe: interface=IntrLiReq1  # HMI Switch for Interior Light Source | User request to activate / deactivate an interior light source (switch on/off or automatic mode).
    IntrLiReqFromHmiToAshtrayLiFrntRi: interface=IntrLiReq1  # HMI Switch for Interior Light Source | User request to activate / deactivate an interior light source (switch on/off or automatic mode).
    IntrLiReqFromHmiToAshtrayLiGroup: interface=IntrLiReq1  # HMI Switch for Interior Light Source | User request to activate / deactivate an interior light source (switch on/off or automatic mode).
    IntrLiReqFromHmiToAshtrayLiMidCen: interface=IntrLiReq1  # HMI Switch for Interior Light Source | User request to activate / deactivate an interior light source (switch on/off or automatic mode).
    IntrLiReqFromHmiToAshtrayLiMidLe: interface=IntrLiReq1  # HMI Switch for Interior Light Source | User request to activate / deactivate an interior light source (switch on/off or automatic mode).
    IntrLiReqFromHmiToAshtrayLiMidRi: interface=IntrLiReq1  # HMI Switch for Interior Light Source | User request to activate / deactivate an interior light source (switch on/off or automatic mode).
    IntrLiReqFromHmiToAshtrayLiReCen: interface=IntrLiReq1  # HMI Switch for Interior Light Source | User request to activate / deactivate an interior light source (switch on/off or automatic mode).
    IntrLiReqFromHmiToAshtrayLiReLe: interface=IntrLiReq1  # HMI Switch for Interior Light Source | User request to activate / deactivate an interior light source (switch on/off or automatic mode).
    IntrLiReqFromHmiToAshtrayLiReRi: interface=IntrLiReq1  # HMI Switch for Interior Light Source | User request to activate / deactivate an interior light source (switch on/off or automatic mode).
    IntrLiReqFromHmiToCbnLiFrntCen: interface=IntrLiReq1  # HMI Switch for Interior Light Source | User request to activate / deactivate an interior light source (switch on/off or automatic mode).
    IntrLiReqFromHmiToCbnLiFrntLe: interface=IntrLiReq1  # HMI Switch for Interior Light Source | User request to activate / deactivate an interior light source (switch on/off or automatic mode).
    IntrLiReqFromHmiToCbnLiFrntRi: interface=IntrLiReq1  # HMI Switch for Interior Light Source | User request to activate / deactivate an interior light source (switch on/off or automatic mode).
    IntrLiReqFromHmiToCbnLiGroup: interface=IntrLiReq1  # HMI Switch for Interior Light Source | User request to activate / deactivate an interior light source (switch on/off or automatic mode).
    IntrLiReqFromHmiToCbnLiMidCen: interface=IntrLiReq1  # HMI Switch for Interior Light Source | User request to activate / deactivate an interior light source (switch on/off or automatic mode).
    IntrLiReqFromHmiToCbnLiMidLe: interface=IntrLiReq1  # HMI Switch for Interior Light Source | User request to activate / deactivate an interior light source (switch on/off or automatic mode).
    IntrLiReqFromHmiToCbnLiMidRi: interface=IntrLiReq1  # HMI Switch for Interior Light Source | User request to activate / deactivate an interior light source (switch on/off or automatic mode).
    IntrLiReqFromHmiToCbnLiReCen: interface=IntrLiReq1  # HMI Switch for Interior Light Source | User request to activate / deactivate an interior light source (switch on/off or automatic mode).
    IntrLiReqFromHmiToCbnLiReLe: interface=IntrLiReq1  # HMI Switch for Interior Light Source | User request to activate / deactivate an interior light source (switch on/off or automatic mode).
    IntrLiReqFromHmiToCbnLiReRi: interface=IntrLiReq1  # HMI Switch for Interior Light Source | User request to activate / deactivate an interior light source (switch on/off or automatic mode).
    IntrLiReqFromHmiToCurbLiFrntLe: interface=IntrLiReq1  # HMI Switch for Interior Light Source | User request to activate / deactivate an interior light source (switch on/off or automatic mode).
    IntrLiReqFromHmiToCurbLiFrntRi: interface=IntrLiReq1  # HMI Switch for Interior Light Source | User request to activate / deactivate an interior light source (switch on/off or automatic mode).
    IntrLiReqFromHmiToCurbLiGroup: interface=IntrLiReq1  # HMI Switch for Interior Light Source | User request to activate / deactivate an interior light source (switch on/off or automatic mode).
    IntrLiReqFromHmiToCurbLiMidLe: interface=IntrLiReq1  # HMI Switch for Interior Light Source | User request to activate / deactivate an interior light source (switch on/off or automatic mode).
    IntrLiReqFromHmiToCurbLiMidRi: interface=IntrLiReq1  # HMI Switch for Interior Light Source | User request to activate / deactivate an interior light source (switch on/off or automatic mode).
    IntrLiReqFromHmiToCurbLiReLe: interface=IntrLiReq1  # HMI Switch for Interior Light Source | User request to activate / deactivate an interior light source (switch on/off or automatic mode).
    IntrLiReqFromHmiToCurbLiReRi: interface=IntrLiReq1  # HMI Switch for Interior Light Source | User request to activate / deactivate an interior light source (switch on/off or automatic mode).
    IntrLiReqFromHmiToEngCmptmtLi: interface=IntrLiReq1  # HMI Switch for Interior Light Source | User request to activate / deactivate an interior light source (switch on/off or automatic mode).
    IntrLiReqFromHmiToExtrLiSwtIllmn: interface=IntrLiReq1  # HMI Switch for Interior Light Source | User request to activate / deactivate an interior light source (switch on/off or automatic mode).
    IntrLiReqFromHmiToFootwellGroup: interface=IntrLiReq1  # HMI Switch for Interior Light Source | User request to activate / deactivate an interior light source (switch on/off or automatic mode).
    IntrLiReqFromHmiToFootwellLiFrntCen: interface=IntrLiReq1  # HMI Switch for Interior Light Source | User request to activate / deactivate an interior light source (switch on/off or automatic mode).
    IntrLiReqFromHmiToFootwellLiFrntLe: interface=IntrLiReq1  # HMI Switch for Interior Light Source | User request to activate / deactivate an interior light source (switch on/off or automatic mode).
    IntrLiReqFromHmiToFootwellLiFrntRi: interface=IntrLiReq1  # HMI Switch for Interior Light Source | User request to activate / deactivate an interior light source (switch on/off or automatic mode).
    IntrLiReqFromHmiToFootwellLiMidCen: interface=IntrLiReq1  # HMI Switch for Interior Light Source | User request to activate / deactivate an interior light source (switch on/off or automatic mode).
    IntrLiReqFromHmiToFootwellLiMidLe: interface=IntrLiReq1  # HMI Switch for Interior Light Source | User request to activate / deactivate an interior light source (switch on/off or automatic mode).
    IntrLiReqFromHmiToFootwellLiMidRi: interface=IntrLiReq1  # HMI Switch for Interior Light Source | User request to activate / deactivate an interior light source (switch on/off or automatic mode).
    IntrLiReqFromHmiToFootwellLiReCen: interface=IntrLiReq1  # HMI Switch for Interior Light Source | User request to activate / deactivate an interior light source (switch on/off or automatic mode).
    IntrLiReqFromHmiToFootwellLiReLe: interface=IntrLiReq1  # HMI Switch for Interior Light Source | User request to activate / deactivate an interior light source (switch on/off or automatic mode).
    IntrLiReqFromHmiToFootwellLiReRi: interface=IntrLiReq1  # HMI Switch for Interior Light Source | User request to activate / deactivate an interior light source (switch on/off or automatic mode).
    IntrLiReqFromHmiToGlvCmptmtLi: interface=IntrLiReq1  # HMI Switch for Interior Light Source | User request to activate / deactivate an interior light source (switch on/off or automatic mode).
    IntrLiReqFromHmiToIgnSwtIllmn: interface=IntrLiReq1  # HMI Switch for Interior Light Source | User request to activate / deactivate an interior light source (switch on/off or automatic mode).
    IntrLiReqFromHmiToIntrLiGroup0: interface=IntrLiReq1  # HMI Switch for Interior Light Source | User request to activate / deactivate an interior light source (switch on/off or automatic mode).
    IntrLiReqFromHmiToIntrLiGroup1: interface=IntrLiReq1  # HMI Switch for Interior Light Source | User request to activate / deactivate an interior light source (switch on/off or automatic mode).
    IntrLiReqFromHmiToIntrLiGroup{10..15}: interface=IntrLiReq1  # HMI Switch for Interior Light Source | User request to activate / deactivate an interior light source (switch on/off or automatic mode).
    IntrLiReqFromHmiToIntrLiGroup{2..9}: interface=IntrLiReq1  # HMI Switch for Interior Light Source | User request to activate / deactivate an interior light source (switch on/off or automatic mode).
    IntrLiReqFromHmiToLiForCigaretteLighterIllmnAtTrLe: interface=IntrLiReq1  # HMI Switch for Interior Light Source | User request to activate / deactivate an interior light source (switch on/off or automatic mode).
    IntrLiReqFromHmiToLiForCigaretteLighterIllmnAtTrRi: interface=IntrLiReq1  # HMI Switch for Interior Light Source | User request to activate / deactivate an interior light source (switch on/off or automatic mode).
    IntrLiReqFromHmiToLiForCigaretteLighterIllmnFrntCen: interface=IntrLiReq1  # HMI Switch for Interior Light Source | User request to activate / deactivate an interior light source (switch on/off or automatic mode).
    IntrLiReqFromHmiToLiForCigaretteLighterIllmnFrntLe: interface=IntrLiReq1  # HMI Switch for Interior Light Source | User request to activate / deactivate an interior light source (switch on/off or automatic mode).
    IntrLiReqFromHmiToLiForCigaretteLighterIllmnFrntRi: interface=IntrLiReq1  # HMI Switch for Interior Light Source | User request to activate / deactivate an interior light source (switch on/off or automatic mode).
    IntrLiReqFromHmiToLiForCigaretteLighterIllmnGroup: interface=IntrLiReq1  # HMI Switch for Interior Light Source | User request to activate / deactivate an interior light source (switch on/off or automatic mode).
    IntrLiReqFromHmiToLiForCigaretteLighterIllmnMidCen: interface=IntrLiReq1  # HMI Switch for Interior Light Source | User request to activate / deactivate an interior light source (switch on/off or automatic mode).
    IntrLiReqFromHmiToLiForCigaretteLighterIllmnMidLe: interface=IntrLiReq1  # HMI Switch for Interior Light Source | User request to activate / deactivate an interior light source (switch on/off or automatic mode).
    IntrLiReqFromHmiToLiForCigaretteLighterIllmnMidRi: interface=IntrLiReq1  # HMI Switch for Interior Light Source | User request to activate / deactivate an interior light source (switch on/off or automatic mode).
    IntrLiReqFromHmiToLiForCigaretteLighterIllmnReCen: interface=IntrLiReq1  # HMI Switch for Interior Light Source | User request to activate / deactivate an interior light source (switch on/off or automatic mode).
    IntrLiReqFromHmiToLiForCigaretteLighterIllmnReLe: interface=IntrLiReq1  # HMI Switch for Interior Light Source | User request to activate / deactivate an interior light source (switch on/off or automatic mode).
    IntrLiReqFromHmiToLiForCigaretteLighterIllmnReRi: interface=IntrLiReq1  # HMI Switch for Interior Light Source | User request to activate / deactivate an interior light source (switch on/off or automatic mode).
    IntrLiReqFromHmiToLiForDoorOpenerIllmnFrntLe: interface=IntrLiReq1  # HMI Switch for Interior Light Source | User request to activate / deactivate an interior light source (switch on/off or automatic mode).
    IntrLiReqFromHmiToLiForDoorOpenerIllmnFrntRi: interface=IntrLiReq1  # HMI Switch for Interior Light Source | User request to activate / deactivate an interior light source (switch on/off or automatic mode).
    IntrLiReqFromHmiToLiForDoorOpenerIllmnGroup: interface=IntrLiReq1  # HMI Switch for Interior Light Source | User request to activate / deactivate an interior light source (switch on/off or automatic mode).
    IntrLiReqFromHmiToLiForDoorOpenerIllmnMidLe: interface=IntrLiReq1  # HMI Switch for Interior Light Source | User request to activate / deactivate an interior light source (switch on/off or automatic mode).
    IntrLiReqFromHmiToLiForDoorOpenerIllmnMidRi: interface=IntrLiReq1  # HMI Switch for Interior Light Source | User request to activate / deactivate an interior light source (switch on/off or automatic mode).
    IntrLiReqFromHmiToLiForDoorOpenerIllmnReLe: interface=IntrLiReq1  # HMI Switch for Interior Light Source | User request to activate / deactivate an interior light source (switch on/off or automatic mode).
    IntrLiReqFromHmiToLiForDoorOpenerIllmnReRi: interface=IntrLiReq1  # HMI Switch for Interior Light Source | User request to activate / deactivate an interior light source (switch on/off or automatic mode).
    IntrLiReqFromHmiToLiForDoorSillIllmnFrntLe: interface=IntrLiReq1  # HMI Switch for Interior Light Source | User request to activate / deactivate an interior light source (switch on/off or automatic mode).
    IntrLiReqFromHmiToLiForDoorSillIllmnFrntRi: interface=IntrLiReq1  # HMI Switch for Interior Light Source | User request to activate / deactivate an interior light source (switch on/off or automatic mode).
    IntrLiReqFromHmiToLiForDoorSillIllmnGroup: interface=IntrLiReq1  # HMI Switch for Interior Light Source | User request to activate / deactivate an interior light source (switch on/off or automatic mode).
    IntrLiReqFromHmiToLiForDoorSillIllmnMidLe: interface=IntrLiReq1  # HMI Switch for Interior Light Source | User request to activate / deactivate an interior light source (switch on/off or automatic mode).
    IntrLiReqFromHmiToLiForDoorSillIllmnMidRi: interface=IntrLiReq1  # HMI Switch for Interior Light Source | User request to activate / deactivate an interior light source (switch on/off or automatic mode).
    IntrLiReqFromHmiToLiForDoorSillIllmnReLe: interface=IntrLiReq1  # HMI Switch for Interior Light Source | User request to activate / deactivate an interior light source (switch on/off or automatic mode).
    IntrLiReqFromHmiToLiForDoorSillIllmnReRi: interface=IntrLiReq1  # HMI Switch for Interior Light Source | User request to activate / deactivate an interior light source (switch on/off or automatic mode).
    IntrLiReqFromHmiToLiForReadingAtRowThrdCen: interface=IntrLiReq1  # HMI Switch for Interior Light Source | User request to activate / deactivate an interior light source (switch on/off or automatic mode).
    IntrLiReqFromHmiToLiForReadingAtRowThrdLe: interface=IntrLiReq1  # HMI Switch for Interior Light Source | User request to activate / deactivate an interior light source (switch on/off or automatic mode).
    IntrLiReqFromHmiToLiForReadingAtRowThrdRi: interface=IntrLiReq1  # HMI Switch for Interior Light Source | User request to activate / deactivate an interior light source (switch on/off or automatic mode).
    IntrLiReqFromHmiToLiForReadingFrntCen: interface=IntrLiReq1  # HMI Switch for Interior Light Source | User request to activate / deactivate an interior light source (switch on/off or automatic mode).
    IntrLiReqFromHmiToLiForReadingFrntLe: interface=IntrLiReq1  # HMI Switch for Interior Light Source | User request to activate / deactivate an interior light source (switch on/off or automatic mode).
    IntrLiReqFromHmiToLiForReadingFrntRi: interface=IntrLiReq1  # HMI Switch for Interior Light Source | User request to activate / deactivate an interior light source (switch on/off or automatic mode).
    IntrLiReqFromHmiToLiForReadingGroup: interface=IntrLiReq1  # HMI Switch for Interior Light Source | User request to activate / deactivate an interior light source (switch on/off or automatic mode).
    IntrLiReqFromHmiToLiForReadingReCen: interface=IntrLiReq1  # HMI Switch for Interior Light Source | User request to activate / deactivate an interior light source (switch on/off or automatic mode).
    IntrLiReqFromHmiToLiForReadingReLe: interface=IntrLiReq1  # HMI Switch for Interior Light Source | User request to activate / deactivate an interior light source (switch on/off or automatic mode).
    IntrLiReqFromHmiToLiForReadingReRi: interface=IntrLiReq1  # HMI Switch for Interior Light Source | User request to activate / deactivate an interior light source (switch on/off or automatic mode).
    IntrLiReqFromHmiToLiForSftyBltLockIllmnFrntCen: interface=IntrLiReq1  # HMI Switch for Interior Light Source | User request to activate / deactivate an interior light source (switch on/off or automatic mode).
    IntrLiReqFromHmiToLiForSftyBltLockIllmnFrntLe: interface=IntrLiReq1  # HMI Switch for Interior Light Source | User request to activate / deactivate an interior light source (switch on/off or automatic mode).
    IntrLiReqFromHmiToLiForSftyBltLockIllmnFrntRi: interface=IntrLiReq1  # HMI Switch for Interior Light Source | User request to activate / deactivate an interior light source (switch on/off or automatic mode).
    IntrLiReqFromHmiToLiForSftyBltLockIllmnGroup: interface=IntrLiReq1  # HMI Switch for Interior Light Source | User request to activate / deactivate an interior light source (switch on/off or automatic mode).
    IntrLiReqFromHmiToLiForSftyBltLockIllmnMidCen: interface=IntrLiReq1  # HMI Switch for Interior Light Source | User request to activate / deactivate an interior light source (switch on/off or automatic mode).
    IntrLiReqFromHmiToLiForSftyBltLockIllmnMidLe: interface=IntrLiReq1  # HMI Switch for Interior Light Source | User request to activate / deactivate an interior light source (switch on/off or automatic mode).
    IntrLiReqFromHmiToLiForSftyBltLockIllmnMidRi: interface=IntrLiReq1  # HMI Switch for Interior Light Source | User request to activate / deactivate an interior light source (switch on/off or automatic mode).
    IntrLiReqFromHmiToLiForSftyBltLockIllmnReCen: interface=IntrLiReq1  # HMI Switch for Interior Light Source | User request to activate / deactivate an interior light source (switch on/off or automatic mode).
    IntrLiReqFromHmiToLiForSftyBltLockIllmnReLe: interface=IntrLiReq1  # HMI Switch for Interior Light Source | User request to activate / deactivate an interior light source (switch on/off or automatic mode).
    IntrLiReqFromHmiToLiForSftyBltLockIllmnReRi: interface=IntrLiReq1  # HMI Switch for Interior Light Source | User request to activate / deactivate an interior light source (switch on/off or automatic mode).
    IntrLiReqFromHmiToTrCmptmtGroup: interface=IntrLiReq1  # HMI Switch for Interior Light Source | User request to activate / deactivate an interior light source (switch on/off or automatic mode).
    IntrLiReqFromHmiToTrCmptmtLiCen: interface=IntrLiReq1  # HMI Switch for Interior Light Source | User request to activate / deactivate an interior light source (switch on/off or automatic mode).
    IntrLiReqFromHmiToTrCmptmtLiLoLe: interface=IntrLiReq1  # HMI Switch for Interior Light Source | User request to activate / deactivate an interior light source (switch on/off or automatic mode).
    IntrLiReqFromHmiToTrCmptmtLiLoRi: interface=IntrLiReq1  # HMI Switch for Interior Light Source | User request to activate / deactivate an interior light source (switch on/off or automatic mode).
    IntrLiReqFromHmiToTrCmptmtLiUpLe: interface=IntrLiReq1  # HMI Switch for Interior Light Source | User request to activate / deactivate an interior light source (switch on/off or automatic mode).
    IntrLiReqFromHmiToTrCmptmtLiUpRi: interface=IntrLiReq1  # HMI Switch for Interior Light Source | User request to activate / deactivate an interior light source (switch on/off or automatic mode).
    IntrLiReqFromHmiToVanityLiFrntLe: interface=IntrLiReq1  # HMI Switch for Interior Light Source | User request to activate / deactivate an interior light source (switch on/off or automatic mode).
    IntrLiReqFromHmiToVanityLiFrntRi: interface=IntrLiReq1  # HMI Switch for Interior Light Source | User request to activate / deactivate an interior light source (switch on/off or automatic mode).
    IntrLiReqFromHmiToVanityLiGroup: interface=IntrLiReq1  # HMI Switch for Interior Light Source | User request to activate / deactivate an interior light source (switch on/off or automatic mode).
    IntrLiReqFromHmiToVanityLiMidLe: interface=IntrLiReq1  # HMI Switch for Interior Light Source | User request to activate / deactivate an interior light source (switch on/off or automatic mode).
    IntrLiReqFromHmiToVanityLiMidRi: interface=IntrLiReq1  # HMI Switch for Interior Light Source | User request to activate / deactivate an interior light source (switch on/off or automatic mode).
    IntrLiReqFromHmiToVanityLiReLe: interface=IntrLiReq1  # HMI Switch for Interior Light Source | User request to activate / deactivate an interior light source (switch on/off or automatic mode).
    IntrLiReqFromHmiToVanityLiReRi: interface=IntrLiReq1  # HMI Switch for Interior Light Source | User request to activate / deactivate an interior light source (switch on/off or automatic mode).
    KeyAcsRem: interface=LockgCenReq1  # Access Remote Key | Request to lock or unlock the vehicle required from remote keys
    KeyAuthn: interface=AntithftPasSt1  # Key Authorization | Status of key authorization by Immobilizer
    KeyInsertSt: interface=KeyInsertSt1  # Key Insert State | Information related to the mechanical key. It indicates whether the key is inserted into key cylinder or not
    KeyMecl: interface=LockgCenReq1  # Door Mechanical Key | Locking request with the mechanical key from the door
    KeyMeclOfDoorLockReLe: interface=LockgCenReq1  # Rear Door Mechanical Key | Locking request with the mechanical key from a rear door
    KeyMeclOfDoorLockReRi: interface=LockgCenReq1  # Rear Door Mechanical Key | Locking request with the mechanical key from a rear door
    KeyMeclOfDrvrDoorLock: interface=LockgCenReq1  # Front Door Mechanical Key | Locking request with the mechanical key from the front door
    KeyMeclOfLidRe: interface=LockgCenReq1  # Rear Lid Door Mechanical Key | Locking request with the mechanical key from the rear lid
    KeyMeclOfPassDoorLock: interface=LockgCenReq1  # Front Door Mechanical Key | Locking request with the mechanical key from the front door
    KeyPadOfLidRe: interface=LockgCenReq1  # Rear Lid Keypad | Request to activate central locking master on the rear lid from lid key pad
    KnobRotyBndlsStep15: interface=KnobRotyBndlsStep15  # Boundless Rotary Knob 15 Steps | The value represents the relative number of steps/positions (out of 15 values) the knob has been moved since the last reported movement. Positive values denote clockwise, negative counter clockwise rotation.
    KnobRotyBndlsStep7: interface=KnobRotyBndlsStep7  # Boundless Rotary Knob 7 Steps | The value represents the relative number of steps/positions (out of 7 values) the knob has been moved since the last reported movement. Positive values denote clockwise, negative counter clockwise rotation.
    LedFbVis: interface=LedCmd1  # Visual Feedback LED | Command to control the light emitting diode (LED) visual feedback
    LiAutReq: interface=LiExtReq1  # Auto Light Request | Request to turn on/off automatic light
    LiDaytiRunng: interface=LiExtCmd1  # Daytime Running Light | This port provides command to turn on/off day time running lights
    LiDaytiRunngIndcn: interface=ExtrLiDisp1  # Daytime Running Light Indication | This port provides Indication to the instrument cluster about the day time running lights on/off status
    LiDaytiRunngOut: interface=LiExtCmd1  # Daytime Running Light Output | This port provides command to turn on/off day time running lights
    LiDimGlb: interface=LiDimGlbCmd1  # Global Dimming Command | This port provides global dimming request for Interior Lights
    LiFlt: interface=LiFltSt1  # Light Source Fault Status | Feedback from the light actuator to be informed of possible fault situation; initial value: NoFlt
    LiFltOfAshtrayLiFrntCen: interface=LiFltSts1  # Interior Light Source Fault Status | Feedback from the light actuators to be informed of possible fault situation; initial value: NoFlt
    LiFltOfAshtrayLiFrntLe: interface=LiFltSt1  # Interior Light Source Fault Status | Feedback from the light actuators to be informed of possible fault situation; initial value: NoFlt
    LiFltOfAshtrayLiFrntRi: interface=LiFltSt1  # Interior Light Source Fault Status | Feedback from the light actuators to be informed of possible fault situation; initial value: NoFlt
    LiFltOfAshtrayLiGroup: interface=LiFltSt1  # Interior Light Source Fault Status | Feedback from the light actuators to be informed of possible fault situation; initial value: NoFlt
    LiFltOfAshtrayLiMidCen: interface=LiFltSt1  # Interior Light Source Fault Status | Feedback from the light actuators to be informed of possible fault situation; initial value: NoFlt
    LiFltOfAshtrayLiMidLe: interface=LiFltSt1  # Interior Light Source Fault Status | Feedback from the light actuators to be informed of possible fault situation; initial value: NoFlt
    LiFltOfAshtrayLiMidRi: interface=LiFltSt1  # Interior Light Source Fault Status | Feedback from the light actuators to be informed of possible fault situation; initial value: NoFlt
    LiFltOfAshtrayLiReCen: interface=LiFltSt1  # Interior Light Source Fault Status | Feedback from the light actuators to be informed of possible fault situation; initial value: NoFlt
    LiFltOfAshtrayLiReLe: interface=LiFltSt1  # Interior Light Source Fault Status | Feedback from the light actuators to be informed of possible fault situation; initial value: NoFlt
    LiFltOfAshtrayLiReRi: interface=LiFltSt1  # Interior Light Source Fault Status | Feedback from the light actuators to be informed of possible fault situation; initial value: NoFlt
    LiFltOfBeamHiLe: interface=LiFltSt1  # Exterior Light Source Fault Status | Feedback for Exterior Light Source Fault Status
    LiFltOfBeamHiRi: interface=LiFltSt1  # Exterior Light Source Fault Status | Feedback for Exterior Light Source Fault Status
    LiFltOfBeamLoLe: interface=LiFltSt1  # Exterior Light Source Fault Status | Feedback for Exterior Light Source Fault Status
    LiFltOfBeamLoRi: interface=LiFltSt1  # Exterior Light Source Fault Status | Feedback for Exterior Light Source Fault Status
    LiFltOfBrkLiLe: interface=LiFltSt1  # Exterior Light Source Fault Status | Feedback for Exterior Light Source Fault Status
    LiFltOfBrkLiRi: interface=LiFltSt1  # Exterior Light Source Fault Status | Feedback for Exterior Light Source Fault Status
    LiFltOfBrkLiTrlrLe: interface=LiFltSt1  # Exterior Light Source Fault Status | Feedback for Exterior Light Source Fault Status
    LiFltOfBrkLiTrlrRi: interface=LiFltSt1  # Exterior Light Source Fault Status | Feedback for Exterior Light Source Fault Status
    LiFltOfCbnLiFrntCen: interface=LiFltSt1  # Interior Light Source Fault Status | Feedback from the light actuators to be informed of possible fault situation; initial value: NoFlt
    LiFltOfCbnLiFrntLe: interface=LiFltSt1  # Interior Light Source Fault Status | Feedback from the light actuators to be informed of possible fault situation; initial value: NoFlt
    LiFltOfCbnLiFrntRi: interface=LiFltSt1  # Interior Light Source Fault Status | Feedback from the light actuators to be informed of possible fault situation; initial value: NoFlt
    LiFltOfCbnLiGroup: interface=LiFltSt1  # Interior Light Source Fault Status | Feedback from the light actuators to be informed of possible fault situation; initial value: NoFlt
    LiFltOfCbnLiMidCen: interface=LiFltSt1  # Interior Light Source Fault Status | Feedback from the light actuators to be informed of possible fault situation; initial value: NoFlt
    LiFltOfCbnLiMidLe: interface=LiFltSt1  # Interior Light Source Fault Status | Feedback from the light actuators to be informed of possible fault situation; initial value: NoFlt
    LiFltOfCbnLiMidRi: interface=LiFltSt1  # Interior Light Source Fault Status | Feedback from the light actuators to be informed of possible fault situation; initial value: NoFlt
    LiFltOfCbnLiReCen: interface=LiFltSt1  # Interior Light Source Fault Status | Feedback from the light actuators to be informed of possible fault situation; initial value: NoFlt
    LiFltOfCbnLiReLe: interface=LiFltSt1  # Interior Light Source Fault Status | Feedback from the light actuators to be informed of possible fault situation; initial value: NoFlt
    LiFltOfCbnLiReRi: interface=LiFltSt1  # Interior Light Source Fault Status | Feedback from the light actuators to be informed of possible fault situation; initial value: NoFlt
    LiFltOfCornrMkrCenLe: interface=LiFltSt1  # Exterior Light Source Fault Status | Feedback for Exterior Light Source Fault Status
    LiFltOfCornrMkrCenRi: interface=LiFltSt1  # Exterior Light Source Fault Status | Feedback for Exterior Light Source Fault Status
    LiFltOfCornrMkrFrntLe: interface=LiFltSt1  # Exterior Light Source Fault Status | Feedback for Exterior Light Source Fault Status
    LiFltOfCornrMkrFrntRi: interface=LiFltSt1  # Exterior Light Source Fault Status | Feedback for Exterior Light Source Fault Status
    LiFltOfCornrMkrReLe: interface=LiFltSt1  # Exterior Light Source Fault Status | Feedback for Exterior Light Source Fault Status
    LiFltOfCornrMkrReRi: interface=LiFltSt1  # Exterior Light Source Fault Status | Feedback for Exterior Light Source Fault Status
    LiFltOfCurbLiFrntLe: interface=LiFltSt1  # Interior Light Source Fault Status | Feedback from the light actuators to be informed of possible fault situation; initial value: NoFlt
    LiFltOfCurbLiFrntRi: interface=LiFltSt1  # Interior Light Source Fault Status | Feedback from the light actuators to be informed of possible fault situation; initial value: NoFlt
    LiFltOfCurbLiGroup: interface=LiFltSt1  # Interior Light Source Fault Status | Feedback from the light actuators to be informed of possible fault situation; initial value: NoFlt
    LiFltOfCurbLiMidLe: interface=LiFltSt1  # Interior Light Source Fault Status | Feedback from the light actuators to be informed of possible fault situation; initial value: NoFlt
    LiFltOfCurbLiMidRi: interface=LiFltSt1  # Interior Light Source Fault Status | Feedback from the light actuators to be informed of possible fault situation; initial value: NoFlt
    LiFltOfCurbLiReLe: interface=LiFltSt1  # Interior Light Source Fault Status | Feedback from the light actuators to be informed of possible fault situation; initial value: NoFlt
    LiFltOfCurbLiReRi: interface=LiFltSt1  # Interior Light Source Fault Status | Feedback from the light actuators to be informed of possible fault situation; initial value: NoFlt
    LiFltOfEngCmptmtLi: interface=LiFltSt1  # Interior Light Source Fault Status | Feedback from the light actuators to be informed of possible fault situation; initial value: NoFlt
    LiFltOfExtrLiSwtIllmn: interface=LiFltSt1  # Interior Light Source Fault Status | Feedback from the light actuators to be informed of possible fault situation; initial value: NoFlt
    LiFltOfFogLiFrntLe: interface=LiFltSt1  # Exterior Light Source Fault Status | Feedback for Exterior Light Source Fault Status
    LiFltOfFogLiFrntRi: interface=LiFltSt1  # Exterior Light Source Fault Status | Feedback for Exterior Light Source Fault Status
    LiFltOfFogLiReLe: interface=LiFltSt1  # Exterior Light Source Fault Status | Feedback for Exterior Light Source Fault Status
    LiFltOfFogLiReRi: interface=LiFltSt1  # Exterior Light Source Fault Status | Feedback for Exterior Light Source Fault Status
    LiFltOfFogLiTrlrLe: interface=LiFltSt1  # Exterior Light Source Fault Status | Feedback for Exterior Light Source Fault Status
    LiFltOfFogLiTrlrRi: interface=LiFltSt1  # Exterior Light Source Fault Status | Feedback for Exterior Light Source Fault Status
    LiFltOfFootwellGroup: interface=LiFltSt1  # Interior Light Source Fault Status | Feedback from the light actuators to be informed of possible fault situation; initial value: NoFlt
    LiFltOfFootwellLiFrntCen: interface=LiFltSt1  # Interior Light Source Fault Status | Feedback from the light actuators to be informed of possible fault situation; initial value: NoFlt
    LiFltOfFootwellLiFrntLe: interface=LiFltSt1  # Interior Light Source Fault Status | Feedback from the light actuators to be informed of possible fault situation; initial value: NoFlt
    LiFltOfFootwellLiFrntRi: interface=LiFltSt1  # Interior Light Source Fault Status | Feedback from the light actuators to be informed of possible fault situation; initial value: NoFlt
    LiFltOfFootwellLiMidCen: interface=LiFltSt1  # Interior Light Source Fault Status | Feedback from the light actuators to be informed of possible fault situation; initial value: NoFlt
    LiFltOfFootwellLiMidLe: interface=LiFltSt1  # Interior Light Source Fault Status | Feedback from the light actuators to be informed of possible fault situation; initial value: NoFlt
    LiFltOfFootwellLiMidRi: interface=LiFltSt1  # Interior Light Source Fault Status | Feedback from the light actuators to be informed of possible fault situation; initial value: NoFlt
    LiFltOfFootwellLiReCen: interface=LiFltSt1  # Interior Light Source Fault Status | Feedback from the light actuators to be informed of possible fault situation; initial value: NoFlt
    LiFltOfFootwellLiReLe: interface=LiFltSt1  # Interior Light Source Fault Status | Feedback from the light actuators to be informed of possible fault situation; initial value: NoFlt
    LiFltOfFootwellLiReRi: interface=LiFltSt1  # Interior Light Source Fault Status | Feedback from the light actuators to be informed of possible fault situation; initial value: NoFlt
    LiFltOfGlvCmptmtLi: interface=LiFltSt1  # Interior Light Source Fault Status | Feedback from the light actuators to be informed of possible fault situation; initial value: NoFlt
    LiFltOfIgnSwtIllmn: interface=LiFltSt1  # Interior Light Source Fault Status | Feedback from the light actuators to be informed of possible fault situation; initial value: NoFlt
    LiFltOfIndcrFrntLe: interface=LiFltSt1  # Exterior Light Source Fault Status | Feedback for Exterior Light Source Fault Status
    LiFltOfIndcrFrntRi: interface=LiFltSt1  # Exterior Light Source Fault Status | Feedback for Exterior Light Source Fault Status
    LiFltOfIndcrReLe: interface=LiFltSt1  # Exterior Light Source Fault Status | Feedback for Exterior Light Source Fault Status
    LiFltOfIndcrReRi: interface=LiFltSt1  # Exterior Light Source Fault Status | Feedback for Exterior Light Source Fault Status
    LiFltOfIndcrSideLe: interface=LiFltSt1  # Exterior Light Source Fault Status | Feedback for Exterior Light Source Fault Status
    LiFltOfIndcrSideRi: interface=LiFltSt1  # Exterior Light Source Fault Status | Feedback for Exterior Light Source Fault Status
    LiFltOfIndcrTrlrLe: interface=LiFltSt1  # Exterior Light Source Fault Status | Feedback for Exterior Light Source Fault Status
    LiFltOfIndcrTrlrRi: interface=LiFltSt1  # Exterior Light Source Fault Status | Feedback for Exterior Light Source Fault Status
    LiFltOfIntrLiGroup0: interface=LiFltSt1  # Interior Light Source Fault Status | Feedback from the light actuators to be informed of possible fault situation; initial value: NoFlt
    LiFltOfIntrLiGroup1: interface=LiFltSt1  # Interior Light Source Fault Status | Feedback from the light actuators to be informed of possible fault situation; initial value: NoFlt
    LiFltOfIntrLiGroup{10..15}: interface=LiFltSt1  # Interior Light Source Fault Status | Feedback from the light actuators to be informed of possible fault situation; initial value: NoFlt
    LiFltOfIntrLiGroup{2..9}: interface=LiFltSt1  # Interior Light Source Fault Status | Feedback from the light actuators to be informed of possible fault situation; initial value: NoFlt
    LiFltOfLampForStopOfBrkLiCenHiMntd: interface=LiFltSt1  # Exterior Light Source Fault Status | Feedback for Exterior Light Source Fault Status
    LiFltOfLiDaytiRunngFrntLe: interface=LiFltSt1  # Exterior Light Source Fault Status | Feedback for Exterior Light Source Fault Status
    LiFltOfLiDaytiRunngFrntRi: interface=LiFltSt1  # Exterior Light Source Fault Status | Feedback for Exterior Light Source Fault Status
    LiFltOfLiForCigaretteLighterIllmnAtTrLe: interface=LiFltSt1  # Interior Light Source Fault Status | Feedback from the light actuators to be informed of possible fault situation; initial value: NoFlt
    LiFltOfLiForCigaretteLighterIllmnAtTrRi: interface=LiFltSt1  # Interior Light Source Fault Status | Feedback from the light actuators to be informed of possible fault situation; initial value: NoFlt
    LiFltOfLiForCigaretteLighterIllmnFrntCen: interface=LiFltSt1  # Interior Light Source Fault Status | Feedback from the light actuators to be informed of possible fault situation; initial value: NoFlt
    LiFltOfLiForCigaretteLighterIllmnFrntLe: interface=LiFltSt1  # Interior Light Source Fault Status | Feedback from the light actuators to be informed of possible fault situation; initial value: NoFlt
    LiFltOfLiForCigaretteLighterIllmnFrntRi: interface=LiFltSt1  # Interior Light Source Fault Status | Feedback from the light actuators to be informed of possible fault situation; initial value: NoFlt
    LiFltOfLiForCigaretteLighterIllmnGroup: interface=LiFltSt1  # Interior Light Source Fault Status | Feedback from the light actuators to be informed of possible fault situation; initial value: NoFlt
    LiFltOfLiForCigaretteLighterIllmnMidCen: interface=LiFltSt1  # Interior Light Source Fault Status | Feedback from the light actuators to be informed of possible fault situation; initial value: NoFlt
