AUTOSAR XML (schema 00046)
package /AUTOSAR/AISpecification/LifeCycleInfoSets
  life cycle info set PortPrototypeBlueprintObslt: default-lc-state=obsolete, used-life-cycle-state-definition-group=AutosarLifeCycleStates
    life-cycle-infos:
      lc-object=PtIntvModTqCluMaxFast, period-begin=ar-release-version=4.3.0, remark=p=l-1=shortname changed, keyword Req added, use-instead=PtIntvModTqCluMaxFastReq
      lc-object=TrsmCluStAct, period-begin=ar-release-version=4.2.1, remark=p=l-1=shortname changed, keyword Act replaced by Consold, use-instead=TrsmCluStConsold
      lc-object=TrsmNrGearAct, lc-state=obsolete, period-begin=ar-release-version=4.2.1, remark=p=l-1=shortname changed, keyword Act replaced by Consold, use-instead=TrsmNrGearConsold
      lc-object=TrsmRatGearAct, lc-state=obsolete, period-begin=ar-release-version=4.2.1, remark=p=l-1=shortname changed, keyword Act replaced by Consold, use-instead=TrsmRatGearConsold
      lc-object=TrsmRatTqPtAct, lc-state=obsolete, period-begin=ar-release-version=4.2.1, remark=p=l-1=shortname changed, keyword Act replaced by Consold, use-instead=TrsmRatTqPtConsold
      lc-object=TrsmTqDftlAxleFrntAct, lc-state=obsolete, period-begin=ar-release-version=4.2.1, remark=p=l-1=shortname changed, keyword Act replaced by Consold, use-instead=TrsmTqDftlAxleFrntConsold
      lc-object=TrsmTqDftlAxleReAct, lc-state=obsolete, period-begin=ar-release-version=4.2.1, remark=p=l-1=shortname changed, keyword Act replaced by Consold, use-instead=TrsmTqDftlAxleReConsold
      lc-object=TrsmTqDftlTrfAct, lc-state=obsolete, period-begin=ar-release-version=4.2.1, remark=p=l-1=shortname changed, keyword Act replaced by Consold, use-instead=TrsmTqDftlTrfConsold
      lc-object=ActrBodyLvlSts, period-begin=ar-release-version=4.2.1, remark=p=l-1=Change of shortname, use-instead=ActrBodyLvlSt
      lc-object=ActrStsActAtDftlForTqTrf, period-begin=ar-release-version=4.2.1, remark=p=l-1=Change of shortname, use-instead=ActrStConsoldAtDftlForTqTrf
      lc-object=ActvSuspSts, period-begin=ar-release-version=4.2.1, remark=p=l-1=Change of shortname, use-instead=ActvSuspSt
      lc-object=BackliteWinSts, period-begin=ar-release-version=4.2.1, remark=p=l-1=Change of shortname, use-instead=BackliteWinSt
      lc-object=CoorrStsActAtAxleFrnt, lc-state=obsolete, period-begin=ar-release-version=4.2.1, remark=p=l-1=Change of shortname, use-instead=CoorrStConsoldAtAxleFrnt
      lc-object=CoorrStsActAtAxleRe, lc-state=obsolete, period-begin=ar-release-version=4.2.1, remark=p=l-1=Change of shortname, use-instead=CoorrStConsoldAtAxleRe
      lc-object=CoorrStsActAtDftlForTqTrf, lc-state=obsolete, period-begin=ar-release-version=4.2.1, remark=p=l-1=Change of shortname, use-instead=CoorrStConsoldAtDftlForTqTrf
      lc-object=CrsCtrlAndAccSwtStsEngd, period-begin=ar-release-version=4.2.1, remark=p=l-1=Change of shortname, use-instead=CrsCtrlAndAccSwtStEngd
      lc-object=DamprSts, period-begin=ar-release-version=4.2.1, remark=p=l-1=Change of shortname, use-instead=DamprSt
      lc-object=DoorSts, period-begin=ar-release-version=4.2.1, remark=p=l-1=Change of shortname, use-instead=DoorSt
      lc-object=DoorStsOfDoorLockReLe, period-begin=ar-release-version=4.2.1, remark=p=l-1=Change of shortname, use-instead=DoorStOfDoorLockReLe
      lc-object=DoorStsOfDoorLockReRi, period-begin=ar-release-version=4.2.1, remark=p=l-1=Change of shortname, use-instead=DoorStOfDoorLockReRi
      lc-object=DoorStsOfDrvrDoorLock, period-begin=ar-release-version=4.2.1, remark=p=l-1=Change of shortname, use-instead=DoorStOfDrvrDoorLock
      lc-object=DoorStsOfPassDoorLock, period-begin=ar-release-version=4.2.1, remark=p=l-1=Change of shortname, use-instead=DoorStOfPassDoorLock
      lc-object=DtTqDistbnStsIndcn, period-begin=ar-release-version=4.2.1, remark=p=l-1=Change of shortname, use-instead=DtTqDistbnStIndcn
      lc-object=EngHoodSts, period-begin=ar-release-version=4.2.1, remark=p=l-1=Change of shortname, use-instead=EngHoodSt
      lc-object=EpbActrFltSts, period-begin=ar-release-version=4.2.1, remark=p=l-1=Change of shortname, use-instead=EpbActrFltSt
      lc-object=EpbBtnCtrlSts, period-begin=ar-release-version=4.2.1, remark=p=l-1=Change of shortname, use-instead=EpbBtnCtrlSt
      lc-object=EscSts, period-begin=ar-release-version=4.2.1, remark=p=l-1=Change of shortname, use-instead=EscSt
      lc-object=EscStsIndcn, period-begin=ar-release-version=4.2.1, remark=p=l-1=Change of shortname, use-instead=EscStIndcn
      lc-object=HldOnDmdSts, period-begin=ar-release-version=4.2.1, remark=p=l-1=Change of shortname, use-instead=HldOnDmdSt
      lc-object=HoopRollSts, period-begin=ar-release-version=4.2.1, remark=p=l-1=Change of shortname, use-instead=HoopRollSt
      lc-object=HornSts, period-begin=ar-release-version=4.2.1, remark=p=l-1=Change of shortname, use-instead=HornSt
      lc-object=HtlModSts, period-begin=ar-release-version=4.2.1, remark=p=l-1=Change of shortname, use-instead=HtlModSt
      lc-object=HvacDefrstStsFrnt, period-begin=ar-release-version=4.2.1, remark=p=l-1=Change of shortname, use-instead=HvacDefrstStFrnt
      lc-object=HvacDefrstStsRe, period-begin=ar-release-version=4.2.1, remark=p=l-1=Change of shortname, use-instead=HvacDefrstStRe
      lc-object=ImobSts, period-begin=ar-release-version=4.2.1, remark=p=l-1=Change of shortname, use-instead=ImobSt
      lc-object=LidReSts, period-begin=ar-release-version=4.2.1, remark=p=l-1=Change of shortname, use-instead=LidReSt
      lc-object=LockStsOfSteerCol, period-begin=ar-release-version=4.2.1, remark=p=l-1=Change of shortname, use-instead=LockStOfSteerCol
      lc-object=MassgSts, period-begin=ar-release-version=4.2.1, remark=p=l-1=Change of shortname, use-instead=MassgSt
      lc-object=MassgStsOfDrvrSeat, period-begin=ar-release-version=4.2.1, remark=p=l-1=Change of shortname, use-instead=MassgStOfDrvrSeat
      lc-object=MassgStsOfPassSeat, period-begin=ar-release-version=4.2.1, remark=p=l-1=Change of shortname, use-instead=MassgStOfPassSeat
      lc-object=MassgStsOfSeatRowFirstMid, period-begin=ar-release-version=4.2.1, remark=p=l-1=Change of shortname, use-instead=MassgStOfSeatRowFirstMid
      lc-object=MassgStsOfSeatRowSecLe, period-begin=ar-release-version=4.2.1, remark=p=l-1=Change of shortname, use-instead=MassgStOfSeatRowSecLe
      lc-object=MassgStsOfSeatRowSecMid, period-begin=ar-release-version=4.2.1, remark=p=l-1=Change of shortname, use-instead=MassgStOfSeatRowSecMid
      lc-object=MassgStsOfSeatRowSecRi, period-begin=ar-release-version=4.2.1, remark=p=l-1=Change of shortname, use-instead=MassgStOfSeatRowSecRi
      lc-object=MassgStsOfSeatRowThrdLe, period-begin=ar-release-version=4.2.1, remark=p=l-1=Change of shortname, use-instead=MassgStOfSeatRowThrdLe
      lc-object=MassgStsOfSeatRowThrdMid, period-begin=ar-release-version=4.2.1, remark=p=l-1=Change of shortname, use-instead=MassgStOfSeatRowThrdMid
      lc-object=MassgStsOfSeatRowThrdRi, period-begin=ar-release-version=4.2.1, remark=p=l-1=Change of shortname, use-instead=MassgStOfSeatRowThrdRi
      lc-object=MirrMoveSts, period-begin=ar-release-version=4.2.1, remark=p=l-1=Change of shortname, use-instead=MirrMoveSt
      lc-object=NozHeatrSts, period-begin=ar-release-version=4.2.1, remark=p=l-1=Change of shortname, use-instead=NozHeatrSt
      lc-object=NozHeatrStsOfNozHeatrFrnt, period-begin=ar-release-version=4.2.1, remark=p=l-1=Change of shortname, use-instead=NozHeatrStOfNozHeatrFrnt
      lc-object=NozHeatrStsOfNozHeatrHdlamp, period-begin=ar-release-version=4.2.1, remark=p=l-1=Change of shortname, use-instead=NozHeatrStOfNozHeatrHdlamp
      lc-object=NozHeatrStsOfNozHeatrRe, period-begin=ar-release-version=4.2.1, remark=p=l-1=Change of shortname, use-instead=NozHeatrStOfNozHeatrRe
      lc-object=RadioSts, period-begin=ar-release-version=4.2.1, remark=p=l-1=Change of shortname, use-instead=RadioSt
      lc-object=RainAmntSts, period-begin=ar-release-version=4.2.1, remark=p=l-1=Change of shortname, use-instead=RainAmntSt
      lc-object=RoofCnvtbSts, period-begin=ar-release-version=4.2.1, remark=p=l-1=Change of shortname, use-instead=RoofCnvtbSt
      lc-object=SeatFixaSts, period-begin=ar-release-version=4.2.1, remark=p=l-1=Change of shortname, use-instead=SeatFixaSt
      lc-object=SeatFixaStsOfDrvrSeat, period-begin=ar-release-version=4.2.1, remark=p=l-1=Change of shortname, use-instead=SeatFixaStOfDrvrSeat
      lc-object=SeatFixaStsOfPassSeat, period-begin=ar-release-version=4.2.1, remark=p=l-1=Change of shortname, use-instead=SeatFixaStOfPassSeat
      lc-object=SeatFixaStsOfSeatRowFirstMid, period-begin=ar-release-version=4.2.1, remark=p=l-1=Change of shortname, use-instead=SeatFixaStOfSeatRowFirstMid
      lc-object=SeatFixaStsOfSeatRowSecLe, period-begin=ar-release-version=4.2.1, remark=p=l-1=Change of shortname, use-instead=SeatFixaStOfSeatRowSecLe
      lc-object=SeatFixaStsOfSeatRowSecMid, period-begin=ar-release-version=4.2.1, remark=p=l-1=Change of shortname, use-instead=SeatFixaStOfSeatRowSecMid
      lc-object=SeatFixaStsOfSeatRowSecRi, period-begin=ar-release-version=4.2.1, remark=p=l-1=Change of shortname, use-instead=SeatFixaStOfSeatRowSecRi
      lc-object=SeatFixaStsOfSeatRowThrdLe, period-begin=ar-release-version=4.2.1, remark=p=l-1=Change of shortname, use-instead=SeatFixaStOfSeatRowThrdLe
      lc-object=SeatFixaStsOfSeatRowThrdMid, period-begin=ar-release-version=4.2.1, remark=p=l-1=Change of shortname, use-instead=SeatFixaStOfSeatRowThrdMid
      lc-object=SeatFixaStsOfSeatRowThrdRi, period-begin=ar-release-version=4.2.1, remark=p=l-1=Change of shortname, use-instead=SeatFixaStOfSeatRowThrdRi
      lc-object=SeatMoveSts, period-begin=ar-release-version=4.2.1, remark=p=l-1=Change of shortname, use-instead=SeatMoveSt
      lc-object=SnsrAlrmSimpleSts, period-begin=ar-release-version=4.2.1, remark=p=l-1=Change of shortname, use-instead=SnsrAlrmSimpleSt
      lc-object=SnsrAlrmSimpleStsOfBackWin, period-begin=ar-release-version=4.2.1, remark=p=l-1=Change of shortname, use-instead=SnsrAlrmSimpleStOfBackWin
      lc-object=SnsrAlrmSimpleStsOfDoorFrntLe, period-begin=ar-release-version=4.2.1, remark=p=l-1=Change of shortname, use-instead=SnsrAlrmSimpleStOfDoorFrntLe
      lc-object=SnsrAlrmSimpleStsOfDoorFrntRi, period-begin=ar-release-version=4.2.1, remark=p=l-1=Change of shortname, use-instead=SnsrAlrmSimpleStOfDoorFrntRi
      lc-object=SnsrAlrmSimpleStsOfDoorReLe, period-begin=ar-release-version=4.2.1, remark=p=l-1=Change of shortname, use-instead=SnsrAlrmSimpleStOfDoorReLe
      lc-object=SnsrAlrmSimpleStsOfDoorReRi, period-begin=ar-release-version=4.2.1, remark=p=l-1=Change of shortname, use-instead=SnsrAlrmSimpleStOfDoorReRi
      lc-object=SnsrAlrmSimpleStsOfHood, period-begin=ar-release-version=4.2.1, remark=p=l-1=Change of shortname, use-instead=SnsrAlrmSimpleStOfHood
      lc-object=SnsrAlrmSimpleStsOfRadio, period-begin=ar-release-version=4.2.1, remark=p=l-1=Change of shortname, use-instead=SnsrAlrmSimpleStOfRadio
      lc-object=SnsrAlrmSimpleStsOfSnsrGlassBreak, period-begin=ar-release-version=4.2.1, remark=p=l-1=Change of shortname, use-instead=SnsrAlrmSimpleStOfSnsrGlassBreak
      lc-object=SnsrAlrmSimpleStsOfTankFlap, period-begin=ar-release-version=4.2.1, remark=p=l-1=Change of shortname, use-instead=SnsrAlrmSimpleStOfTankFlap
      lc-object=SnsrAlrmSimpleStsOfTr, period-begin=ar-release-version=4.2.1, remark=p=l-1=Change of shortname, use-instead=SnsrAlrmSimpleStOfTr
      lc-object=SnsrAlrmSimpleStsOfTrlr, period-begin=ar-release-version=4.2.1, remark=p=l-1=Change of shortname, use-instead=SnsrAlrmSimpleStOfTrlr
      lc-object=SsmStsToEpb, period-begin=ar-release-version=4.2.1, remark=p=l-1=Change of shortname, use-instead=SsmStToEpb
      lc-object=SsmStsToEsc, period-begin=ar-release-version=4.2.1, remark=p=l-1=Change of shortname, use-instead=SsmStToEsc
      lc-object=StabrSts, period-begin=ar-release-version=4.2.1, remark=p=l-1=Change of shortname, use-instead=StabrSt
      lc-object=SteerAgSuppsnBascSts, period-begin=ar-release-version=4.2.1, remark=p=l-1=Change of shortname, use-instead=SteerAgSuppsnBascSt
      lc-object=SteerDrvrAsscSysStsIndcn, period-begin=ar-release-version=4.2.1, remark=p=l-1=Change of shortname, use-instead=SteerDrvrAsscSysStIndcn
      lc-object=SteerTqSuppsnBascSts, period-begin=ar-release-version=4.2.1, remark=p=l-1=Change of shortname, use-instead=SteerTqSuppsnBascSt
      lc-object=SteerTqSuppsnFrntSts, period-begin=ar-release-version=4.2.1, remark=p=l-1=Change of shortname, use-instead=SteerTqSuppsnFrntSt
      lc-object=Sts, period-begin=ar-release-version=4.2.1, remark=p=l-1=Change of shortname, use-instead=St
      lc-object=StsOfActrDefrstFrnt, period-begin=ar-release-version=4.2.1, remark=p=l-1=Change of shortname, use-instead=StOfActrDefrstFrnt
      lc-object=StsOfActrDefrstRe, period-begin=ar-release-version=4.2.1, remark=p=l-1=Change of shortname, use-instead=StOfActrDefrstRe
      lc-object=StsOfActrMirrDefrst, period-begin=ar-release-version=4.2.1, remark=p=l-1=Change of shortname, use-instead=StOfActrMirrDefrst
      lc-object=SwilSprgSts, period-begin=ar-release-version=4.2.1, remark=p=l-1=Change of shortname, use-instead=SwilSprgSt
      lc-object=TankFlapSts, period-begin=ar-release-version=4.2.1, remark=p=l-1=Change of shortname, use-instead=TankFlapSt
      lc-object=TelltlDefrstSts, period-begin=ar-release-version=4.2.1, remark=p=l-1=Change of shortname, use-instead=TelltlDefrstSt
      lc-object=TintgAutSts, period-begin=ar-release-version=4.2.1, remark=p=l-1=Change of shortname, use-instead=TintgAutSt
      lc-object=TintgSts, period-begin=ar-release-version=4.2.1, remark=p=l-1=Change of shortname, use-instead=TintgSt
      lc-object=TirePMonCalStsIndcnPerWhl, period-begin=ar-release-version=4.2.1, remark=p=l-1=Change of shortname, use-instead=TirePMonCalStIndcnPerWhl
      lc-object=TirePMonSts, period-begin=ar-release-version=4.2.1, remark=p=l-1=Change of shortname, use-instead=TirePMonSt
      lc-object=TrlrSts, period-begin=ar-release-version=4.2.1, remark=p=l-1=Change of shortname, use-instead=TrlrSt
      lc-object=VehHldSts, period-begin=ar-release-version=4.2.1, remark=p=l-1=Change of shortname, use-instead=VehHldSt
      lc-object=VehModSts, period-begin=ar-release-version=4.2.1, remark=p=l-1=Change of shortname, use-instead=VehModSt
      lc-object=WhlSteerReBascSts, period-begin=ar-release-version=4.2.1, remark=p=l-1=Change of shortname, use-instead=WhlSteerReBascSt
      lc-object=WinHeatrSts, period-begin=ar-release-version=4.2.1, remark=p=l-1=Change of shortname, use-instead=WinHeatrSt
      lc-object=WiprSts, period-begin=ar-release-version=4.2.1, remark=p=l-1=Change of shortname, use-instead=WiprSt
      lc-object=WiprStsFrnt, period-begin=ar-release-version=4.2.1, remark=p=l-1=Change of shortname, use-instead=WiprStFrnt
      lc-object=WiprStsOfWiprFrnt, period-begin=ar-release-version=4.2.1, remark=p=l-1=Change of shortname, use-instead=WiprStOfWiprFrnt
      lc-object=WiprStsOfWiprRe, period-begin=ar-release-version=4.2.1, remark=p=l-1=Change of shortname, use-instead=WiprStOfWiprRe
      lc-object=WshrFldSts, period-begin=ar-release-version=4.2.1, remark=p=l-1=Change of shortname, use-instead=WshrFldSt
      lc-object=WshrFldStsOfWshrFldTankFrnt, period-begin=ar-release-version=4.2.1, remark=p=l-1=Change of shortname, use-instead=WshrFldStOfWshrFldTankFrnt
      lc-object=WshrFldStsOfWshrFldTankRe, period-begin=ar-release-version=4.2.1, remark=p=l-1=Change of shortname, use-instead=WshrFldStOfWshrFldTankRe
      lc-object=WshrSts, period-begin=ar-release-version=4.2.1, remark=p=l-1=Change of shortname, use-instead=WshrSt
      lc-object=WshrStsFrnt, period-begin=ar-release-version=4.2.1, remark=p=l-1=Change of shortname, use-instead=WshrStFrnt
      lc-object=WshrStsOfWshrFrnt, period-begin=ar-release-version=4.2.1, remark=p=l-1=Change of shortname, use-instead=WshrStOfWshrFrnt
      lc-object=WshrStsOfWshrHdlamp, period-begin=ar-release-version=4.2.1, remark=p=l-1=Change of shortname, use-instead=WshrStOfWshrHdlamp
      lc-object=WshrStsOfWshrRe, period-begin=ar-release-version=4.2.1, remark=p=l-1=Change of shortname, use-instead=WshrStOfWshrRe
      lc-object=SnsrInclnInhb, period-begin=ar-release-version=4.1.1, remark=p=l-1=Correction of used keyword abbreviation, use-instead=SnsrInclnInhb1
      lc-object=TirePEstimdPerWhl, period-begin=ar-release-version=4.1.1, remark=p=l-1=Interface Name Harmonization (removal of "Estimd"), use-instead=TirePEstimdPerWhl1
      lc-object=TireTEstimdPerWhl, period-begin=ar-release-version=4.1.1, remark=p=l-1=Interface Name Harmonization (removal of "Estimd"), use-instead=TireTEstimdPerWhl1
      lc-object=AbsFlgActv, period-begin=ar-release-version=4.1.1, remark=p=l-1=Port short names consolidation: receivers should use short name of providers., use-instead=AbsCtrlIntvg
      lc-object=AxleFrntCoorrSt, period-begin=ar-release-version=4.1.1, remark=p=l-1=Port short names consolidation: receivers should use short name of providers., use-instead=CoorrStsActAtAxleFrnt
      lc-object=AxleReCoorrSt, period-begin=ar-release-version=4.1.1, remark=p=l-1=Port short names consolidation: receivers should use short name of providers., use-instead=CoorrStsActAtAxleRe
      lc-object=BrkPedlFlgPsd, period-begin=ar-release-version=4.1.1, remark=p=l-1=Port short names consolidation: receivers should use short name of providers., use-instead=BrkPedlPsd
      lc-object=BrkPedlRat, period-begin=ar-release-version=4.1.1, remark=p=l-1=Port short names consolidation: receivers should use short name of providers., use-instead=BrkPedlVal
      lc-object=DrvFlgGearShiftDwnReq, period-begin=ar-release-version=4.1.1, remark=p=l-1=Port short names consolidation: receivers should use short name of providers., use-instead=GearShiftDwnReqFromDrvr
      lc-object=DrvFlgGearShiftUpReq, period-begin=ar-release-version=4.1.1, remark=p=l-1=Port short names consolidation: receivers should use short name of providers., use-instead=GearShiftUpReqFromDrvr
      lc-object=DtdRatTqDistbnReq, period-begin=ar-release-version=4.1.1, remark=p=l-1=Port short names consolidation: receivers should use short name of providers., use-instead=PtTqDistbnToWhlsReqdByDtd
      lc-object=DtdTqDftlAxleFrntReq, period-begin=ar-release-version=4.1.1, remark=p=l-1=Port short names consolidation: receivers should use short name of providers., use-instead=DftlTqReqAtAxleFrnt
      lc-object=DtdTqDftlAxleReReq, period-begin=ar-release-version=4.1.1, remark=p=l-1=Port short names consolidation: receivers should use short name of providers., use-instead=DftlTqReqAtAxleRe
      lc-object=DtdTqDftlTrfReq, period-begin=ar-release-version=4.1.1, remark=p=l-1=Port short names consolidation: receivers should use short name of providers., use-instead=DftlTqReqAtDftlForTqTrf
      lc-object=EgyMngtSt, period-begin=ar-release-version=4.1.1, remark=p=l-1=Port short names consolidation: receivers should use short name of providers., use-instead=EgyMngt
      lc-object=EscFlgNoFuCutOff, period-begin=ar-release-version=4.1.1, remark=p=l-1=Port short names consolidation: receivers should use short name of providers., use-instead=NoFuCutOffReq
      lc-object=EscTqCluPtMaxFast, period-begin=ar-release-version=4.1.1, remark=p=l-1=Port short names consolidation: receivers should use short name of providers., use-instead=EngTqDecAtCluReqByEscFast
      lc-object=EscTqCluPtMaxSlow, period-begin=ar-release-version=4.1.1, remark=p=l-1=Port short names consolidation: receivers should use short name of providers., use-instead=EngTqDecAtCluReqByEscSlow
      lc-object=EscTqCluPtMin, period-begin=ar-release-version=4.1.1, remark=p=l-1=Port short names consolidation: receivers should use short name of providers., use-instead=EngTqIncAtCluReqByEsc
      lc-object=EscTqWhlPtMaxSlow, period-begin=ar-release-version=4.1.1, remark=p=l-1=Port short names consolidation: receivers should use short name of providers., use-instead=PtTqDecAtWhlsReqByEscSlow
      lc-object=EscTqWhlPtMinFast, period-begin=ar-release-version=4.1.1, remark=p=l-1=Port short names consolidation: receivers should use short name of providers., use-instead=PtTqIncAtWhlsReqByEscFast
      lc-object=EscTqWhlPtMinSlow, period-begin=ar-release-version=4.1.1, remark=p=l-1=Port short names consolidation: receivers should use short name of providers., use-instead=PtTqIncAtWhlsReqByEscSlow
      lc-object=EscTqWhlPtMaxFast, period-begin=ar-release-version=4.1.1, remark=p=l-1=Port short names consolidation: receivers should use short name of providers., use-instead=PtTqDecAtWhlsReqByEscFast
      lc-object=EscVMax, period-begin=ar-release-version=4.1.1, remark=p=l-1=Port short names consolidation: receivers should use short name of providers., use-instead=BrkActrVehSpdMax
      lc-object=SsmFlgGearParkReq, period-begin=ar-release-version=4.1.1, remark=p=l-1=Port short names consolidation: receivers should use short name of providers., use-instead=GearParkReq
      lc-object=SteerTq, period-begin=ar-release-version=4.1.1, remark=p=l-1=Port short names consolidation: receivers should use short name of providers., use-instead=SteerLoadHyd
      lc-object=SteerTqReq, period-begin=ar-release-version=4.1.1, remark=p=l-1=Port short names consolidation: receivers should use short name of providers., use-instead=SteerLoadHydReq
      lc-object=TrfCaseCoorrSt, period-begin=ar-release-version=4.1.1, remark=p=l-1=Port short names consolidation: receivers should use short name of providers., use-instead=CoorrStsActAtDftlForTqTrf
      lc-object=VehStOper, period-begin=ar-release-version=4.1.1, remark=p=l-1=Port short names consolidation: receivers should use short name of providers., use-instead=OperMod
      lc-object=VehVLgt, period-begin=ar-release-version=4.1.1, remark=p=l-1=Port short names consolidation: receivers should use short name of providers., use-instead=VehSpdLgt
      lc-object=VlcStShiftPrevnCmft, period-begin=ar-release-version=4.1.1, remark=p=l-1=Port short names consolidation: receivers should use short name of providers., use-instead=GearShiftPrevnCmftReqByVlc
      lc-object=VlcTqWhlPtMax, period-begin=ar-release-version=4.1.1, remark=p=l-1=Port short names consolidation: receivers should use short name of providers., use-instead=PtTqTotMaxAtWhlsReqdByVlc
      lc-object=VlcTqWhlPtMin, period-begin=ar-release-version=4.1.1, remark=p=l-1=Port short names consolidation: receivers should use short name of providers., use-instead=PtTqTotMinAtWhlsReqdByVlc
      lc-object=EscVWhlInd, period-begin=ar-release-version=4.1.1, remark=p=l-1=Port short names consolidation: receivers should use short name of providers., use-instead=WhlSpdCircumlStd
      lc-object=EngSpd, lc-state=obsolete, period-begin=ar-release-version=4.1.1, remark=p=l-1=Port short names consolidation: receivers should use short name of providers., use-instead=EngN
      lc-object=GearRatAct, lc-state=obsolete, period-begin=ar-release-version=4.1.1, remark=p=l-1=Port short names consolidation: receivers should use short name of providers., use-instead=TrsmRatGearAct
      lc-object=PtTqTotAvlMaxAtWhls, period-begin=ar-release-version=4.1.1, remark=p=l-1=Port short names consolidation: receivers should use short name of providers., use-instead=PtTqWhlMax
      lc-object=PtTqTotAvlMinAtWhls, period-begin=ar-release-version=4.1.1, remark=p=l-1=Port short names consolidation: receivers should use short name of providers., use-instead=PtTqWhlMinWoCutOff
      lc-object=VlcReqOvrdnByDrvrReq, period-begin=ar-release-version=4.1.1, remark=p=l-1=Port short names consolidation: receivers should use short name of providers., use-instead=PtFlgDrvOvrdVlc
      lc-object=PtTqActAtWhls, lc-state=obsolete, period-begin=ar-release-version=4.1.1, remark=p=l-1=Port short names consolidation: receivers should use short name of providers., use-instead=PtTqWhlInd
      lc-object=PtTqTotActAtWhls, lc-state=obsolete, period-begin=ar-release-version=4.1.1, remark=p=l-1=Port short names consolidation: receivers should use short name of providers., use-instead=PtTqWhl
      lc-object=PtTqTotReqdAtWhlsForVlc, period-begin=ar-release-version=4.1.1, remark=p=l-1=Port short names consolidation: receivers should use short name of providers., use-instead=PtTqWhlReqDrvVlc
      lc-object=PtTqTotReqdAtWhls, period-begin=ar-release-version=4.1.1, remark=p=l-1=Port short names consolidation: receivers should use short name of providers., use-instead=PtTqWhlReq
      lc-object=DtOpend, period-begin=ar-release-version=4.1.1, remark=p=l-1=Port short names consolidation: receivers should use short name of providers., use-instead=TrsmFlgDtOpen
      lc-object=EngSpdGrdt, lc-state=obsolete, period-begin=ar-release-version=4.1.1, remark=p=l-1=Port short names consolidation: receivers should use short name of providers., use-instead=EngNGrdt
      lc-object=GbxCtrsftActv, period-begin=ar-release-version=4.1.1, remark=p=l-1=Port short names consolidation: receivers should use short name of providers., use-instead=TrsmFlgCtrsftActv
      lc-object=GearParkEngd, period-begin=ar-release-version=4.1.1, remark=p=l-1=Port short names consolidation: receivers should use short name of providers., use-instead=TrsmFlgParkLockEngd
      lc-object=DftlTqActAtAxleFrnt, period-begin=ar-release-version=4.1.1, remark=p=l-1=Port short names consolidation: receivers should use short name of providers., use-instead=TrsmTqDftlAxleFrntAct
      lc-object=DftlTqMaxAtAxleFrnt, period-begin=ar-release-version=4.1.1, remark=p=l-1=Port short names consolidation: receivers should use short name of providers., use-instead=TrsmTqDftlAxleFrntMax
      lc-object=DftlTqAtAxleRe, period-begin=ar-release-version=4.1.1, remark=p=l-1=Port short names consolidation: receivers should use short name of providers., use-instead=TrsmTqDftlAxleReAct
      lc-object=DftlTqMaxAtAxleRe, period-begin=ar-release-version=4.1.1, remark=p=l-1=Port short names consolidation: receivers should use short name of providers., use-instead=TrsmTqDftlAxleReMax
      lc-object=DftlTqAtDftlForTqTrf, period-begin=ar-release-version=4.1.1, remark=p=l-1=Port short names consolidation: receivers should use short name of providers., use-instead=TrsmTqDftlTrfAct
      lc-object=DftlTqMaxAtDftlForTqTrf, period-begin=ar-release-version=4.1.1, remark=p=l-1=Port short names consolidation: receivers should use short name of providers., use-instead=TrsmTqDftlTrfMax
      lc-object=TrsmActrStOfAxleFrnt, period-begin=ar-release-version=4.1.1, remark=p=l-1=Port short names consolidation: receivers should use short name of providers., use-instead=TrsmStAxleFrntActr
      lc-object=TrsmActrStOfAxleRe, period-begin=ar-release-version=4.1.1, remark=p=l-1=Port short names consolidation: receivers should use short name of providers., use-instead=TrsmStAxleReActr
      lc-object=ActrStsActAtDftlForTqTrf, period-begin=ar-release-version=4.1.1, remark=p=l-1=Port short names consolidation: receivers should use short name of providers., use-instead=TrsmStTrfCaseDftl
      lc-object=TqSlowAtCluReqdByDrvr, period-begin=ar-release-version=4.1.1, remark=p=l-1=Port short names consolidation: receivers should use short name of providers., use-instead=DrvReqTqCluSlow
      lc-object=AccrPedlRatVirt, period-begin=ar-release-version=4.1.1, remark=p=l-1=Port short names consolidation: receivers should use short name of providers., use-instead=PtAccrPedlPosnVirt
      lc-object=EscStShiftPrevnStaby, period-begin=ar-release-version=4.1.1, remark=p=l-1=Port short names consolidation: receivers should use short name of providers., use-instead=GearShiftPrevnStaby
      lc-object=CogPosnEstimd, period-begin=ar-release-version=4.1.1, remark=p=l-1=Interface Name Harmonization (removal of "Estimd"), use-instead=CogPosnEstimd1
      lc-object=DamprCoeffEstimd, period-begin=ar-release-version=4.1.1, remark=p=l-1=Interface Name Harmonization (removal of "Estimd"), use-instead=DamprCoeffEstimd1
      lc-object=DamprFEstimd, period-begin=ar-release-version=4.1.1, remark=p=l-1=Interface Name Harmonization (removal of "Estimd"), use-instead=DamprFEstimd1
      lc-object=SprgCoeffEstimd, period-begin=ar-release-version=4.1.1, remark=p=l-1=Interface Name Harmonization (removal of "Estimd"), use-instead=SprgCoeffEstimd1
      lc-object=SprgFEstimd, period-begin=ar-release-version=4.1.1, remark=p=l-1=Interface Name Harmonization (removal of "Estimd"), use-instead=SprgFEstimd1
      lc-object=VehMEstimdFromSusp, period-begin=ar-release-version=4.1.1, remark=p=l-1=Interface Name Harmonization (removal of "Estimd"), use-instead=VehMEstimdFromSusp1
      lc-object=VehMEstimdFromVlc, period-begin=ar-release-version=4.1.1, remark=p=l-1=Interface Name Harmonization (removal of "Estimd"), use-instead=VehMEstimdFromVlc1
      lc-object=FricCoeffEstimd, period-begin=ar-release-version=4.1.1, remark=p=l-1=Interface Name Harmonization (removal of "Estimd"), use-instead=FricCoeffEstimd1
      lc-object=AOnBmpAtFrntLe, period-begin=ar-release-version=4.1.1, remark=p=l-1=changed data type specification, use-instead=AOnBmpAtFrntLe1
      lc-object=AOnBmpAtFrntMidLe, period-begin=ar-release-version=4.1.1, remark=p=l-1=changed data type specification, use-instead=AOnBmpAtFrntMidLe1
      lc-object=AOnBmpAtFrntMid, period-begin=ar-release-version=4.1.1, remark=p=l-1=changed data type specification, use-instead=AOnBmpAtFrntMid1
      lc-object=AOnBmpAtFrntMidRi, period-begin=ar-release-version=4.1.1, remark=p=l-1=changed data type specification, use-instead=AOnBmpAtFrntMidRi1
      lc-object=AOnBmpAtFrntRi, period-begin=ar-release-version=4.1.1, remark=p=l-1=changed data type specification, use-instead=AOnBmpAtFrntRi1
      lc-object=ALgtAtFrntLe, period-begin=ar-release-version=4.1.1, remark=p=l-1=changed data type specification, use-instead=ALgtAtFrntLe1
      lc-object=ALgtAtFrntMid, period-begin=ar-release-version=4.1.1, remark=p=l-1=changed data type specification, use-instead=ALgtAtFrntMid1
      lc-object=ALgtAtFrntRi, period-begin=ar-release-version=4.1.1, remark=p=l-1=changed data type specification, use-instead=ALgtAtFrntRi1
      lc-object=ALatOnDoorAtFrntLe, period-begin=ar-release-version=4.1.1, remark=p=l-1=changed data type specification, use-instead=ALatOnDoorAtFrntLe1
      lc-object=ALatOnDoorAtFrntRi, period-begin=ar-release-version=4.1.1, remark=p=l-1=changed data type specification, use-instead=ALatOnDoorAtFrntRi1
      lc-object=ALatOnDoorAtReLe, period-begin=ar-release-version=4.1.1, remark=p=l-1=changed data type specification, use-instead=ALatOnDoorAtReLe1
      lc-object=ALatOnDoorAtReRi, period-begin=ar-release-version=4.1.1, remark=p=l-1=changed data type specification, use-instead=ALatOnDoorAtReRi1
      lc-object=ALgtAtReLe, period-begin=ar-release-version=4.1.1, remark=p=l-1=changed data type specification, use-instead=ALgtAtReLe1
      lc-object=ALgtAtReMid, period-begin=ar-release-version=4.1.1, remark=p=l-1=changed data type specification, use-instead=ALgtAtReMid1
      lc-object=ALgtAtReRi, period-begin=ar-release-version=4.1.1, remark=p=l-1=changed data type specification, use-instead=ALgtAtReRi1
      lc-object=ALgtAtCen, period-begin=ar-release-version=4.1.1, remark=p=l-1=changed data type specification, use-instead=ALgtAtCen1
      lc-object=ALatAtCen, period-begin=ar-release-version=4.1.1, remark=p=l-1=changed data type specification, use-instead=ALatAtCen1
      lc-object=AUpwAtCen, period-begin=ar-release-version=4.1.1, remark=p=l-1=changed data type specification, use-instead=AUpwAtCen1
      lc-object=ALatAtFrntLe, period-begin=ar-release-version=4.1.1, remark=p=l-1=changed data type specification, use-instead=ALatAtFrntLe1
      lc-object=ALatAtFrntMid, period-begin=ar-release-version=4.1.1, remark=p=l-1=changed data type specification, use-instead=ALatAtFrntMid1
      lc-object=ALatAtFrntRi, period-begin=ar-release-version=4.1.1, remark=p=l-1=changed data type specification, use-instead=ALatAtFrntRi1
      lc-object=ALgtOnDoorAtFrntLe, period-begin=ar-release-version=4.1.1, remark=p=l-1=changed data type specification, use-instead=ALgtOnDoorAtFrntLe1
      lc-object=ALgtOnDoorAtFrntRi, period-begin=ar-release-version=4.1.1, remark=p=l-1=changed data type specification, use-instead=ALgtOnDoorAtFrntRi1
      lc-object=ALgtOnDoorAtReLe, period-begin=ar-release-version=4.1.1, remark=p=l-1=changed data type specification, use-instead=ALgtOnDoorAtReLe1
      lc-object=ALgtOnDoorAtReRi, period-begin=ar-release-version=4.1.1, remark=p=l-1=changed data type specification, use-instead=ALgtOnDoorAtReRi1
      lc-object=ALatAtReLe, period-begin=ar-release-version=4.1.1, remark=p=l-1=changed data type specification, use-instead=ALatAtReLe1
      lc-object=ALatAtReMid, period-begin=ar-release-version=4.1.1, remark=p=l-1=changed data type specification, use-instead=ALatAtReMid1
      lc-object=ALatAtReRi, period-begin=ar-release-version=4.1.1, remark=p=l-1=changed data type specification, use-instead=ALatAtReRi1
      lc-object=ALatAtApilLe, period-begin=ar-release-version=4.1.1, remark=p=l-1=changed data type specification, use-instead=ALatAtApilLe1
      lc-object=ALgtAtApilLe, period-begin=ar-release-version=4.1.1, remark=p=l-1=changed data type specification, use-instead=ALgtAtApilLe1
      lc-object=ALatAtApilRi, period-begin=ar-release-version=4.1.1, remark=p=l-1=changed data type specification, use-instead=ALatAtApilRi1
      lc-object=ALgtAtApilRi, period-begin=ar-release-version=4.1.1, remark=p=l-1=changed data type specification, use-instead=ALgtAtApilRi1
      lc-object=ALatAtBpilLe, period-begin=ar-release-version=4.1.1, remark=p=l-1=changed data type specification, use-instead=ALatAtBpilLe1
      lc-object=ALgtAtBpilLe, period-begin=ar-release-version=4.1.1, remark=p=l-1=changed data type specification, use-instead=ALgtAtBpilLe1
      lc-object=ALatAtBpilRi, period-begin=ar-release-version=4.1.1, remark=p=l-1=changed data type specification, use-instead=ALatAtBpilRi1
      lc-object=ALgtAtBpilRi, period-begin=ar-release-version=4.1.1, remark=p=l-1=changed data type specification, use-instead=ALgtAtBpilRi1
      lc-object=ALatAtCpilLe, period-begin=ar-release-version=4.1.1, remark=p=l-1=changed data type specification, use-instead=ALatAtCpilLe1
      lc-object=ALgtAtCpilLe, period-begin=ar-release-version=4.1.1, remark=p=l-1=changed data type specification, use-instead=ALgtAtCpilLe1
      lc-object=ALatAtCpilRi, period-begin=ar-release-version=4.1.1, remark=p=l-1=changed data type specification, use-instead=ALatAtCpilRi1
      lc-object=ALgtAtCpilRi, period-begin=ar-release-version=4.1.1, remark=p=l-1=changed data type specification, use-instead=ALgtAtCpilRi1
      lc-object=PtFlgHvacDeactvt, lc-state=obsolete, period-begin=ar-release-version=4.2.1, remark=p=l-1=use instead "PtFlgAcDeactvt", use-instead=PtFlgAcDeactvt
      lc-object=PtTqMaxHvac, lc-state=obsolete, period-begin=ar-release-version=4.2.1, use-instead=PtTqMaxAc
      lc-object=HvacTq, lc-state=obsolete, period-begin=ar-release-version=4.2.1, use-instead=AcTq
      lc-object=HvacTqReq, lc-state=obsolete, period-begin=ar-release-version=4.2.1, use-instead=AcTqReq
      lc-object=OccptWghtStdAtDrvr, lc-state=obsolete, period-begin=ar-release-version=4.2.1, use-instead=OccptWghtMeasdAtDrvr
      lc-object=OccptWghtStdAtPass, lc-state=obsolete, period-begin=ar-release-version=4.2.1, use-instead=OccptWghtMeasdAtPass
      lc-object=OccptWghtStdAtRowFirstMid, lc-state=obsolete, period-begin=ar-release-version=4.2.1, use-instead=OccptWghtMeasdAtRowFirstMid
      lc-object=OccptWghtStdAtRowSecLe, lc-state=obsolete, period-begin=ar-release-version=4.2.1, use-instead=OccptWghtMeasdAtRowSecLe
      lc-object=OccptWghtStdAtRowSecMid, lc-state=obsolete, period-begin=ar-release-version=4.2.1, use-instead=OccptWghtMeasdAtRowSecMid
      lc-object=OccptWghtStdAtRowSecRi, lc-state=obsolete, period-begin=ar-release-version=4.2.1, use-instead=OccptWghtMeasdAtRowSecRi
      lc-object=OccptWghtStdAtRowThrdLe, lc-state=obsolete, period-begin=ar-release-version=4.2.1, use-instead=OccptWghtMeasdAtRowThrdLe
      lc-object=OccptWghtStdAtRowThrdMid, lc-state=obsolete, period-begin=ar-release-version=4.2.1, use-instead=OccptWghtMeasdAtRowThrdMid
      lc-object=OccptWghtStdAtRowThrdRi, lc-state=obsolete, period-begin=ar-release-version=4.2.1, use-instead=OccptWghtMeasdAtRowThrdRi
      lc-object=ALatStdByEsc, lc-state=obsolete, period-begin=ar-release-version=4.2.1, use-instead=ALatMeasdByEsc
      lc-object=ALgtStd, lc-state=obsolete, period-begin=ar-release-version=4.2.1, use-instead=ALgtMeasd
      lc-object=PitchRateStd, lc-state=obsolete, period-begin=ar-release-version=4.2.1, use-instead=PitchRateMeasd
      lc-object=RollRateStd, lc-state=obsolete, period-begin=ar-release-version=4.2.1, use-instead=RollRateMeasd
      lc-object=SteerWhlAgStd, lc-state=obsolete, period-begin=ar-release-version=4.2.1, use-instead=SteerWhlAgMeasd
      lc-object=VehBodyAVertMeasdStd, lc-state=obsolete, period-begin=ar-release-version=4.2.1, use-instead=VehBodyAVertMeasd
      lc-object=YawRateStdByEsc, lc-state=obsolete, period-begin=ar-release-version=4.2.1, use-instead=YawRateMeasdByEsc
      lc-object=ALgtStdWithPitchCmp, lc-state=obsolete, period-begin=ar-release-version=4.2.1, use-instead=ALgtMeasdWithPitchCmp
      lc-object=BodyPitchAgAbsltMeasdStd, lc-state=obsolete, period-begin=ar-release-version=4.2.1, use-instead=BodyPitchAgAbsltMeasd
      lc-object=BodyRollAgAbsltMeasdStd, lc-state=obsolete, period-begin=ar-release-version=4.2.1, use-instead=BodyRollAgAbsltMeasd
      lc-object=DrvrSteerTqStd, lc-state=obsolete, period-begin=ar-release-version=4.2.1, use-instead=DrvrSteerTqMeasd
      lc-object=PinionSteerAgFrntStd, lc-state=obsolete, period-begin=ar-release-version=4.2.1, use-instead=PinionSteerAgFrntMeasd
      lc-object=PinionSteerAgReStd, lc-state=obsolete, period-begin=ar-release-version=4.2.1, use-instead=PinionSteerAgReMeasd
      lc-object=PinionSteerAgSpdFrntStd, lc-state=obsolete, period-begin=ar-release-version=4.2.1, use-instead=PinionSteerAgSpdFrntMeasd
      lc-object=PinionSteerAgSpdReStd, lc-state=obsolete, period-begin=ar-release-version=4.2.1, use-instead=PinionSteerAgSpdReMeasd
      lc-object=RideHeiLvlMeasdFrntStd, lc-state=obsolete, period-begin=ar-release-version=4.2.1, use-instead=RideHeiLvlMeasdFrnt
      lc-object=RideHeiLvlMeasdReStd, lc-state=obsolete, period-begin=ar-release-version=4.2.1, use-instead=RideHeiLvlMeasdRe
      lc-object=SteerMotAgFrntStd, lc-state=obsolete, period-begin=ar-release-version=4.2.1, use-instead=SteerMotAgFrntMeasd
      lc-object=SteerMotAgSpdFrntStd, lc-state=obsolete, period-begin=ar-release-version=4.2.1, use-instead=SteerMotAgSpdFrntMeasd
      lc-object=SteerWhlAgSpdStd, lc-state=obsolete, period-begin=ar-release-version=4.2.1, use-instead=SteerWhlAgSpdMeasd
      lc-object=WhlAAgrStd, lc-state=obsolete, period-begin=ar-release-version=4.2.1, use-instead=WhlAAgrMeasd
      lc-object=WhlAVertStd, lc-state=obsolete, period-begin=ar-release-version=4.2.1, use-instead=WhlAVertMeasd
      lc-object=WhlDirRotlStd, lc-state=obsolete, period-begin=ar-release-version=4.2.1, use-instead=WhlDirRotlMeasd
      lc-object=WhlVAgrStd, lc-state=obsolete, period-begin=ar-release-version=4.2.1, use-instead=WhlVAgrMeasd
      lc-object=YawRateGrdtStdByEsc, lc-state=obsolete, period-begin=ar-release-version=4.2.1, use-instead=YawRateGrdtMeasdByEsc
      lc-object=ALatBas, lc-state=obsolete, period-begin=ar-release-version=4.2.1, use-instead=ALatRaw
      lc-object=ALgtBas, lc-state=obsolete, period-begin=ar-release-version=4.2.1, use-instead=ALgtRaw
      lc-object=BodyPitchAgAbsltMeasdBas, lc-state=obsolete, period-begin=ar-release-version=4.2.1, use-instead=BodyPitchAgAbsltMeasdRaw
      lc-object=BodyRollAgAbsltMeasdBas, lc-state=obsolete, period-begin=ar-release-version=4.2.1, use-instead=BodyRollAgAbsltMeasdRaw
      lc-object=DrvrSteerTqBas, lc-state=obsolete, period-begin=ar-release-version=4.2.1, use-instead=DrvrSteerTqRaw
      lc-object=PinionSteerAgFrntBas, lc-state=obsolete, period-begin=ar-release-version=4.2.1, use-instead=PinionSteerAgFrntRaw
      lc-object=PinionSteerAgReBas, lc-state=obsolete, period-begin=ar-release-version=4.2.1, use-instead=PinionSteerAgReRaw
      lc-object=PitchRateBas, lc-state=obsolete, period-begin=ar-release-version=4.2.1, use-instead=PitchRateRaw
      lc-object=RideHeiLvlMeasdFrntBas, lc-state=obsolete, period-begin=ar-release-version=4.2.1, use-instead=RideHeiLvlMeasdFrntRaw
      lc-object=RideHeiLvlMeasdReBas, lc-state=obsolete, period-begin=ar-release-version=4.2.1, use-instead=RideHeiLvlMeasdReRaw
      lc-object=RollRateBas, lc-state=obsolete, period-begin=ar-release-version=4.2.1, use-instead=RollRateRaw
      lc-object=SteerMotAgFrntBas, lc-state=obsolete, period-begin=ar-release-version=4.2.1, use-instead=SteerMotAgFrntRaw
      lc-object=SteerWhlAgBas, lc-state=obsolete, period-begin=ar-release-version=4.2.1, use-instead=SteerWhlAgRaw
      lc-object=VehBodyAVertMeasdBas, lc-state=obsolete, period-begin=ar-release-version=4.2.1, use-instead=VehBodyAVertMeasdRaw
      lc-object=WhlAVertBas, lc-state=obsolete, period-begin=ar-release-version=4.2.1, use-instead=WhlAVertRaw
      lc-object=YawRateBas, lc-state=obsolete, period-begin=ar-release-version=4.2.1, use-instead=YawRateRaw
      lc-object=WhlSpdCircumlStd, lc-state=obsolete, period-begin=ar-release-version=4.2.1, use-instead=WhlSpdCircumlMeasd
      lc-object=EmTqDynJ, lc-state=valid, period-begin=ar-release-version=4.2.1
      lc-object=PtTqCluDynJ, lc-state=valid, period-begin=ar-release-version=4.2.1
      lc-object=EngTqCrksftMaxSpdCur, lc-state=valid, period-begin=ar-release-version=4.2.1
      lc-object=PtTqCluMaxSpdCluCur, lc-state=valid, period-begin=ar-release-version=4.2.1
      lc-object=PtEngTqCrksftMinFast, lc-state=valid, period-begin=ar-release-version=4.2.1
      lc-object=EngTqCluMin, lc-state=obsolete, period-begin=ar-release-version=4.3.1, use-instead=EngTqCrksftRedByAncllryLossMin
      lc-object=PtTqMaxAc, lc-state=valid, period-begin=ar-release-version=4.2.1
      lc-object=AcTq, lc-state=valid, period-begin=ar-release-version=4.2.1
      lc-object=TrsmTqCluFast, lc-state=valid, period-begin=ar-release-version=4.2.1
      lc-object=PtDrvReqTqCluVirtEngSpd, lc-state=valid, period-begin=ar-release-version=4.2.1
      lc-object=TrsmReqTypTqCluFast, lc-state=valid, period-begin=ar-release-version=4.2.1
      lc-object=PtIntvModTqCluMaxFast, lc-state=valid, period-begin=ar-release-version=4.2.2
      lc-object=AccrPedlMeasd, lc-state=valid, period-begin=ar-release-version=4.3.0
      lc-object=AccrPedlRat, lc-state=obsolete, period-begin=ar-release-version=4.3.0, use-instead=AccrPedlMeasd
      lc-object=PtAccrPedlPosn, lc-state=valid, period-begin=ar-release-version=4.3.1
      lc-object=AccrPedlGrdt, lc-state=valid, period-begin=ar-release-version=4.3.0
      lc-object=AccrPedlRatFild, lc-state=obsolete, period-begin=ar-release-version=4.3.0, use-instead=PtAccrPedlPosn
      lc-object=AccrPedlRatGrdt, lc-state=obsolete, period-begin=ar-release-version=4.3.0, use-instead=AccrPedlGrdt
      lc-object=PtIntvModTqCluFastReq, lc-state=valid, period-begin=ar-release-version=4.3.0
      lc-object=PtIntvModTqCluMaxFastReq, lc-state=valid, period-begin=ar-release-version=4.3.0
      lc-object=PtIntvModTqCluMaxFast, lc-state=obsolete, period-begin=ar-release-version=4.3.0, remark=p=l-1=shortname changed, Req added, use-instead=PtIntvModTqCluMaxFastReq
      lc-object=TrsmReqTypTqCluFast1, lc-state=valid, period-begin=ar-release-version=4.3.0
      lc-object=TrsmReqTypTqCluFast, lc-state=obsolete, period-begin=ar-release-version=4.3.0, use-instead=TrsmReqTypTqCluFast1
      lc-object=TrsmNrTypTqCluResvReq, lc-state=valid, period-begin=ar-release-version=4.3.0
      lc-object=TrsmTqCluResvReq, lc-state=valid, period-begin=ar-release-version=4.3.0
      lc-object=TrsmTqCluStandStillPred, lc-state=valid, period-begin=ar-release-version=4.3.0
      lc-object=TrsmTqCluMinProtnReq, lc-state=valid, period-begin=ar-release-version=4.3.0
      lc-object=TrsmTqGrdtUpprLimReq, lc-state=valid, period-begin=ar-release-version=4.3.1
      lc-object=TrsmTqCluLoss, lc-state=valid, period-begin=ar-release-version=4.3.0
      lc-object=EngTqResvReqPt, lc-state=valid, period-begin=ar-release-version=4.3.0
      lc-object=EngTqResvPt, lc-state=obsolete, period-begin=ar-release-version=4.3.0, use-instead=EngTqResvReqPt
      lc-object=PtFlgAcDeactvtReq, lc-state=valid, period-begin=ar-release-version=4.3.0
      lc-object=PtFlgAcDeactvt, lc-state=obsolete, period-begin=ar-release-version=4.3.0, use-instead=PtFlgAcDeactvtReq
      lc-object=PtFlgAltDeactvtReq, lc-state=valid, period-begin=ar-release-version=4.3.0
      lc-object=PtFlgAltDeactvt, lc-state=obsolete, period-begin=ar-release-version=4.3.0, use-instead=PtFlgAltDeactvtReq
      lc-object=PtTqResvReqEng, lc-state=valid, period-begin=ar-release-version=4.3.0
      lc-object=PtTqResvEng, lc-state=obsolete, period-begin=ar-release-version=4.3.0, use-instead=PtTqResvReqEng
      lc-object=TrsmFlgSptModReq, lc-state=valid, period-begin=ar-release-version=4.3.0
      lc-object=TrsmFlgSptMod, lc-state=obsolete, period-begin=ar-release-version=4.3.0, use-instead=TrsmFlgSptModReq
      lc-object=TrsmFlgWntrModReq, lc-state=valid, period-begin=ar-release-version=4.3.0
      lc-object=TrsmFlgWntrMod, lc-state=obsolete, period-begin=ar-release-version=4.3.0, use-instead=TrsmFlgWntrModReq
      lc-object=TrsmTqCluStandStill, lc-state=valid, period-begin=ar-release-version=4.3.0
      lc-object=TrsmRatTqWhlByTqCluTar, lc-state=valid, period-begin=ar-release-version=4.3.0
      lc-object=TrsmRatTqWhlByTqClu, lc-state=valid, period-begin=ar-release-version=4.3.0
      lc-object=PtEngNSp, lc-state=valid, period-begin=ar-release-version=4.3.1
      lc-object=TrsmTiCluNReq, lc-state=valid, period-begin=ar-release-version=4.3.1
      lc-object=TrsmCluNReq, lc-state=valid, period-begin=ar-release-version=4.3.1
      lc-object=TrsmCluNReqEnaReq, lc-state=valid, period-begin=ar-release-version=4.3.1
      lc-object=EngNInclgStrtStop, lc-state=valid, period-begin=ar-release-version=4.3.1
      lc-object=TrsmGbxCoreSt, lc-state=valid, period-begin=ar-release-version=4.3.1
      lc-object=TrsmDrvOffElmSt, lc-state=valid, period-begin=ar-release-version=4.3.1
      lc-object=TrsmRatTqTrsmOutpByTqClu, lc-state=valid, period-begin=ar-release-version=4.3.1
      lc-object=TrsmRatTqTrsmOutpByTqCluTar, lc-state=valid, period-begin=ar-release-version=4.3.1
      lc-object=PtGearLvrLockReq, lc-state=valid, period-begin=ar-release-version=4.3.1
      lc-object=TrsmCluNLimnReq, lc-state=valid, period-begin=ar-release-version=4.3.1
      lc-object=TrsmCluNVirtGearTar, lc-state=valid, period-begin=ar-release-version=4.3.1
      lc-object=TrsmNIdleCluReq, lc-state=valid, period-begin=ar-release-version=4.3.1
      lc-object=PtCluN, lc-state=valid, period-begin=ar-release-version=4.3.0
      lc-object=TrsmGearSt, lc-state=valid, period-begin=ar-release-version=4.3.1
      lc-object=TrsmGbxSt, lc-state=valid, period-begin=ar-release-version=4.3.1
      lc-object=TrsmRednGbxSt, lc-state=valid, period-begin=ar-release-version=4.3.1
      lc-object=TrsmDrvOffElmStTar, lc-state=valid, period-begin=ar-release-version=4.3.1
      lc-object=TrsmInpN, lc-state=valid, period-begin=ar-release-version=4.3.0
      lc-object=PtEngTqCluMinFast, lc-state=valid, period-begin=ar-release-version=4.3.1
      lc-object=PtEngTqCrksftMinFast, lc-state=obsolete, period-begin=ar-release-version=4.3.0, use-instead=PtEngTqCluMinFast
      lc-object=TrsmTqCluMaxFastReq, lc-state=valid, period-begin=ar-release-version=4.3.1
      lc-object=TrsmTqCluMaxFast, lc-state=obsolete, period-begin=ar-release-version=4.3.0, use-instead=TrsmTqCluMaxFastReq
      lc-object=TrsmTqCluMaxSlowReq, lc-state=valid, period-begin=ar-release-version=4.3.1
      lc-object=TrsmTqCluMaxSlow, lc-state=obsolete, period-begin=ar-release-version=4.3.0, use-instead=TrsmTqCluMaxSlowReq
      lc-object=TrsmTqCluMinFastReq, lc-state=valid, period-begin=ar-release-version=4.3.1
      lc-object=TrsmTqCluMinSlowReq, lc-state=valid, period-begin=ar-release-version=4.3.1
      lc-object=TrsmTqCluMinFast, lc-state=obsolete, period-begin=ar-release-version=4.3.0, use-instead=TrsmTqCluMinFastReq
      lc-object=TrsmTqCluMinSlow, lc-state=obsolete, period-begin=ar-release-version=4.3.0, use-instead=TrsmTqCluMinSlowReq
      lc-object=TrsmTqCluFastReq, lc-state=valid, period-begin=ar-release-version=4.3.1
      lc-object=TrsmTqCluMaxProtnReq, lc-state=valid, period-begin=ar-release-version=4.3.1
      lc-object=TrsmTqCluMaxProtn, lc-state=obsolete, period-begin=ar-release-version=4.3.0, use-instead=TrsmTqCluMaxProtnReq
      lc-object=TrsmTqCluFast, lc-state=obsolete, period-begin=ar-release-version=4.3.0, use-instead=TrsmTqCluFastReq
      lc-object=TrsmNrTypTqCluFastReq, lc-state=valid, period-begin=ar-release-version=4.3.1
      lc-object=TrsmReqTypTqCluFast1, lc-state=obsolete, period-begin=ar-release-version=4.3.0, use-instead=TrsmNrTypTqCluFastReq
      lc-object=TrsmNrTypMaxMinTqCluFastSlowReq, lc-state=valid, period-begin=ar-release-version=4.3.1
      lc-object=EngTqCrksftMaxEngNCur, lc-state=valid, period-begin=ar-release-version=4.3.1
      lc-object=EngTqCrksftMaxSpdCur, lc-state=obsolete, period-begin=ar-release-version=4.3.1, use-instead=EngTqCrksftMaxEngNCur
      lc-object=PtTqCluMaxCluNCur, lc-state=valid, period-begin=ar-release-version=4.3.1
      lc-object=PtTqCluMaxSpdCluCur, lc-state=obsolete, period-begin=ar-release-version=4.3.1, use-instead=PtTqCluMaxCluNCur
      lc-object=PtDrvReqTqCluVirtEngSpd, lc-state=obsolete, period-begin=ar-release-version=4.3.1, use-instead=PtDrvReqTqCluVirtEngN
      lc-object=PtDrvReqTqCluVirtEngN, lc-state=valid, period-begin=ar-release-version=4.3.1
      lc-object=PtNEngSp, lc-state=obsolete, period-begin=ar-release-version=4.3.0, use-instead=PtEngNSp
      lc-object=TrsmNInp, lc-state=obsolete, period-begin=ar-release-version=4.3.0, use-instead=TrsmInpN
      lc-object=PtNClu, lc-state=obsolete, period-begin=ar-release-version=4.3.0, use-instead=PtCluN
      lc-object=PtAccrPedlPosnVirt, lc-state=valid, period-begin=ar-release-version=4.3.1
      lc-object=TrsmTOil, lc-state=valid, period-begin=ar-release-version=4.3.1
      lc-object=EngTqCrksftRedByAncllryLossMin, lc-state=valid, period-begin=ar-release-version=4.3.1
      lc-object=EngTqCrksftRedByAncllryLoss, lc-state=valid, period-begin=ar-release-version=4.3.1
      lc-object=PtKdDetd, lc-state=valid, period-begin=ar-release-version=4.3.1
      lc-object=PtTqCrksftRedByAncllryLossReq, lc-state=valid, period-begin=ar-release-version=4.3.1
      lc-object=PtEmTqReq, lc-state=valid, period-begin=ar-release-version=4.3.1
      lc-object=PtEmTq, lc-state=valid, period-begin=ar-release-version=4.3.1
      lc-object=PtEmTqMaxCluNCur, lc-state=valid, period-begin=ar-release-version=4.3.1
      lc-object=PtEmTqMinCluNCur, lc-state=valid, period-begin=ar-release-version=4.3.1
      lc-object=PtTqJClu, lc-state=valid, period-begin=ar-release-version=4.3.1
      lc-object=EngTqJCrksft, lc-state=valid, period-begin=ar-release-version=4.3.1
      lc-object=PtEmTqJRotorShaft, lc-state=valid, period-begin=ar-release-version=4.3.1
      lc-object=PtDrvReqTqCluFast, lc-state=valid, period-begin=ar-release-version=4.3.1
      lc-object=PtTqCluEngMaxProtnReq, lc-state=valid, period-begin=ar-release-version=4.3.1
      lc-object=PtEngNInclgStrtStop, lc-state=valid, period-begin=ar-release-version=4.3.1
      lc-object=PtEngNSpIdle, lc-state=valid, period-begin=ar-release-version=4.3.1
      lc-object=TrsmTqCluGrdtUpprLimReq, lc-state=valid, period-begin=ar-release-version=4.3.1
      lc-object=PtCluEngSt, lc-state=valid, period-begin=ar-release-version=4.3.1
      lc-object=PtEngNReq, lc-state=valid, period-begin=ar-release-version=4.3.1
      lc-object=PtEngNReqEnaReq, lc-state=valid, period-begin=ar-release-version=4.3.1
      lc-object=PtCluEngTqMaxCluPCur, lc-state=valid, period-begin=ar-release-version=4.3.1
      lc-object=PtEmTqResvReq, lc-state=valid, period-begin=ar-release-version=4.3.1
      lc-object=TrsmRatTqPtConsold, lc-state=obsolete, period-begin=ar-release-version=4.3.1, use-instead=TrsmRatTqWhlByTqClu
      lc-object=TrsmTqGrdtUpprLimReq, lc-state=obsolete, period-begin=ar-release-version=4.3.1, use-instead=TrsmTqCluGrdtUpprLimReq
      lc-object=TrsmNrGearReq, lc-state=obsolete, period-begin=ar-release-version=4.3.1, use-instead=TrsmGearSt
      lc-object=TrsmNrGearTar, lc-state=obsolete, period-begin=ar-release-version=4.3.1, use-instead=TrsmGearSt
      lc-object=TrsmNrGearConsold, lc-state=obsolete, period-begin=ar-release-version=4.3.1, use-instead=TrsmGearSt
      lc-object=PtTqCluDynJ, lc-state=obsolete, period-begin=ar-release-version=4.3.1, use-instead=PtTqJClu
      lc-object=EngTqDynJ, lc-state=obsolete, period-begin=ar-release-version=4.3.1, use-instead=EngTqJCrksft
      lc-object=EmTqDynJ, lc-state=obsolete, period-begin=ar-release-version=4.3.1, use-instead=PtEmTqJRotorShaft
      lc-object=DrvReqTqCluFast, lc-state=obsolete, period-begin=ar-release-version=4.3.1, use-instead=PtDrvReqTqCluFast
      lc-object=TrsmCluStTar, lc-state=obsolete, period-begin=ar-release-version=4.3.1, use-instead=TrsmDrvOffElmStTar
      lc-object=TrsmCluSt, lc-state=obsolete, period-begin=ar-release-version=4.3.1, use-instead=TrsmDrvOffElmSt
      lc-object=PtEngNSp, lc-state=obsolete, period-begin=ar-release-version=4.3.1, use-instead=PtEngNSpIdle
