AUTOSAR XML (schema 00046)
package /AUTOSAR/AISpecification/Collections_Blueprint
  collection PtRefAll:
    category=SET
    auto-collect=REF-ALL
    element-role=PART_OF_SUBSET
    element=[P5, P6, P7, Perc10, Perc11, T5, T6, AbsCtrlIntvg, AccrPedlRat, AccrPedlRatGrdt, AcTq, AcTqReq, TrsmStAxleFrntActr, TrsmStAxleReActr, BrkActrVehSpdMax, BrkPedlPsd, BrkPedlVal, CluPedlRat, CoorrStActAtAxleFrnt, CoorrStActAtAxleRe, CoorrStActAtDftlForTqTrf, Crash, DftlTqReqAtAxleFrnt, DftlTqReqAtAxleRe, DftlTqReqAtDftlForTqTrf, PtAccrPedlPosnVirt, EgyMngt, EngN, EngNGrdt, EngTqDecAtCluReqByEscSlow, EngTqCrksft, EngTqIncAtCluReqByEsc, EscSt, TrsmFlgParkLockEngd, GearParkReq, TrsmRatGearAct, GearShiftDwnReqFromDrvr, GearShiftPrevnCmftReqByVlc, GearShiftPrevnStaby, GearShiftUpReqFromDrvr, TrsmNrGearTar, NoFuCutOffReq, OperMod, OutdT, PtFlgDrvOvrdVlc, PtFlgTqIncPsbl, PtTqDistbnToWhlsReqdByDtd, PtTqTotMaxAtWhlsReqdByVlc, PtTqTotMinAtWhlsReqdByVlc, PtTqWhl, PtTqWhlInd, PtTqWhlMax, PtTqWhlMin, PtTqWhlMinWoCutOff, PtTqWhlReq, PtTqWhlReqDrvVlc, SteerLoadHyd, SteerLoadHydReq, TrsmRatTqPtAct, TrsmStTrfCaseDftl, TrsmFlgCtrsftActv, TrsmFlgDtOpen, TrsmFlgShiftProgs, TrsmNrGearAct, TrsmTqDftlAxleFrntAct, TrsmTqDftlAxleFrntMax, TrsmTqDftlAxleReAct, TrsmTqDftlAxleReMax, TrsmTqDftlTrfAct, TrsmTqDftlTrfMax, BattU, VehSpdLgt, VlcA, WhlSpdCircumlStd, DrvReqTqCluFast, PtFlgTqDecPsbl, EngTqDecAtCluReqByEscFast, PtTqIncAtWhlsReqByEscSlow, PtTqDecAtWhlsReqByEscSlow, PtTqDecAtWhlsReqByEscFast, PtTqClu, DrvReqTqCluSlow, PtTqWhlMinDrv, TrsmFlgSptMod, TrsmFlgWntrMod, PtFlgEngRun, PtFlgEngStop, PtTqIncAtWhlsReqByEscFast, AbsFlgActv, AxleFrntCoorrSt, AxleReCoorrSt, BrkPedlFlgPsd, BrkPedlRat, DrvFlgGearShiftDwnReq, DrvFlgGearShiftUpReq, DtdRatTqDistbnReq, DtdTqDftlAxleFrntReq, DtdTqDftlAxleReReq, DtdTqDftlTrfReq, EgyMngtSt, EscFlgNoFuCutOff, EscTqCluPtMaxFast, EscTqCluPtMaxSlow, EscTqCluPtMin, EscTqWhlPtMaxSlow, EscTqWhlPtMinFast, EscTqWhlPtMinSlow, EscTqWhlPtMaxFast, EscVMax, SsmFlgGearParkReq, SteerTq, SteerTqReq, TrfCaseCoorrSt, VehStOper, VehVLgt, VlcStShiftPrevnCmft, VlcTqWhlPtMax, VlcTqWhlPtMin, EscVWhlInd, EscStShiftPrevnStaby, EngRunngDirSt, AltTq, AltTqReq, DrvReqTqWhlFast, DrvReqTqWhlSlow, EngNGearTar, EngNMax, EngNMin, EngPAmbAir, EngT, EngTqDynJ, EngTqCrksftMax, EngTqCrksftMaxFast, EngTqCrksftMaxOptmCdn, EngTqCrksftMaxProtn, EngTqCrksftMin, EngTqCrksftMinBasc, EngTqCrksftMinFast, EngTqCrksftMinWoCutOff, EngTqResvPt, PtFlgAcDeactvt, PtFlgAltDeactvt, PtFlgEngStopReq, PtFlgEngStopReqAllwd, PtFlgEngStrtReq, PtFlgEngStrtReqAllwd, PtFlgNoTqWhlReq, PtNClu, PtNEngSp, PtRatTqDistbnReq, PtTqCluDyn, PtTqCluMaxDrv, PtTqCluMinDrv, PtTqCluReqWoTrsmIntv, PtTqCluTarGear, PtTqCluWoTrsmIntv, PtTqCrksftReqFast, PtTqCrksftReqSlow, PtTqMaxAc, PtTqMaxAlt, PtTqMaxSteer, PtTqMaxTrsmOilPmp, PtTqResvEng, PtTqWhlMaxDrv, TrsmCluStAct, TrsmCluStTar, TrsmNrGearReq, TrsmNrTyp, TrsmTqOilPmp, TrsmTqOilPmpReq, TrsmStGearLvr, TrsmRatGear, TrsmRatGearReq, TrsmRatGearTar, TrsmNInp, TrsmTOil, TrsmTqCluMaxFast, TrsmTqCluMaxProtn, TrsmTqCluMaxSlow, TrsmTqCluMinFast, TrsmTqCluMinSlow, TrsmTqWhlIndDistbn, VehTqWhlMaxSftyLimn, AccrPedlRatFild, BodyPitchAgAbsltEstimd, RoadWhlAgEstimdFrnt, RoadWhlAgSpdEstimdFrnt, RoadWhlAgEstimdRe, SwtIndcr, SetSpdIndcn, DtOpend, RoadWhlAgSpdEstimdFrntWishdByDrvr, RoadWhlAgEstimdFrntWishdByDrvr, ALatStdWithRollCmpByEsc, ALatStdByEsc, ALgtStdFromWhlSpd, PrkgBrkActv, SteerWhlAgStd, YawRateBas, YawRateOffsStdByEsc, TracCtrlIntvg, VehMtnSt, WhlBrkOvrheatd, WhlRdTolrCoeff, WhlDirRotlStd, YawStabyCtrlIntvg, YawStabyInfoByEsc, AccActv, AccCtrlActv, CrsCtrlCtrlActv, AccVehDetdIndcn, VehSpdDispd, SetSpdInc, SetSpdDec, CrsCtrlAndAccSwtStEngd, CrsCtrlAndAccSetTiGapInc, VehCourseCrvtPred, AArbnRes, CrsCtrlActv, CrsCtrlAndAccSetTiGapDec, AReqForCmftByCrsCtrlFree, AccYawRateSpc, CrsCtrlAndAccVehSpdLgt, CrsCtrlAndAccDrvrOvrd, CrsCtrlAndAccSetTiGap, SetSpd, TrsmCluSt, TrsmNrGearConsold, TrsmRatGearConsold, TrsmCluSt1, PtFlgHvacDeactvt1, AcTq1, AcTqReq1, PtFlgAcDeactvt1, HvacTq1, HvacTqReq1, PtTqMaxAc1, AcTq1, AcTqReq1, PtFlgAcDeactvtReq1, PtTqMaxAc1, HvacTq, HvacTqReq, PtFlgHvacDeactvt, PtTqMaxHvac, TrsmTqDftlAxleReConsold1, TrsmTqDftlTrfConsold1, TrsmTqDftlAxleFrntConsold1, TrsmNrGearConsold1, TrsmCluStConsold1, TrsmCluStConsold, PtNClu1, CrashSt1, EngTqCrksft1, PtTqCluWoTrsmIntv1, PtTqClu1, PtTqCluReqWoTrsmIntv1, PtTqCluDynJ1, PtTqCluDynJ, EngTqCrksftMaxSpdCur1, EngTqCrksftMaxSpdCur, CmbEng, EngTqModMngt, DrvReqTqCluFast1, EngTqDynJ1, TrsmTqCluMaxFast1, TrsmTqCluMinFast1, EngTqCrksftMin1, PtTqCluMaxSpdCluCur1, PtTqCluMaxSpdCluCur, PtEngTqCrksftMinFast1, PtEngTqCrksftMinFast, EngTqCluMin1, EngTqCluMin, EmTqDynJ1, EmTqDynJ, TrsmTqCluFast1, TrsmTqCluFast, PtDrvReqTqCluVirtEngSpd1, PtDrvReqTqCluVirtEngSpd, TrsmReqTypTqCluFast1, TrsmReqTypTqCluFast, EngN1, EngNGearTar1, EngNMax1, EngNMin1, PtNEngSp1, TrsmNInp1, EngNGrdt1, AccrPedlMeasd1, AccrPedlMeasd, PtAccrPedlPosn1, AccrPedlGrdt1, AccrPedlRat1, AccrPedlRatFild1, AccrPedlRatGrdt1, PtAccrPedlPosn, AccrPedlGrdt, EngTqResvReqPt1, EngTqResvReqPt1, EngTqResvReqPt, PtFlgAcDeactvtReq1, PtFlgAcDeactvtReq, PtFlgAltDeactvtReq, PtFlgAltDeactvt1, PtTqResvReqEng1, PtTqResvReqEng, TrsmFlgSptModReq1, TrsmFlgSptModReq, TrsmFlgWntrModReq1, TrsmFlgWntrModReq, N2, TrsmRatTqPtConsold1, TrsmRatTqPtConsold]
  collection Pt:
    category=SET
    auto-collect=REF-NONE
    element-role=PART_OF_SUBSET
    element=[AArbnRes, AArbnRes1, ALat1, ALatStdByEsc, ALatStdWithRollCmpByEsc, ALgt1, ALgt2, ALgtStdFromWhlSpd, AReqForCmft1, AReqForCmftByCrsCtrlFree, AbsCtrlIntvg, AbsCtrlIntvg1, AbsFlgActv, AcTq, AcTq1, AcTq1, AcTqReq, AcTqReq1, AcTqReq1, AccActv, AccCtrlActv, AccCtrlActv1, AccVehDetd1, AccVehDetdIndcn, AccYawRateSpc, AccrPedlGrdt, AccrPedlGrdt1, AccrPedlMeasd, AccrPedlMeasd, AccrPedlMeasd1, AccrPedlRat, AccrPedlRat1, AccrPedlRatFild, AccrPedlRatFild1, AccrPedlRatGrdt, AccrPedlRatGrdt1, AltTq, AltTq1, AltTqReq, AltTqReq1, AmbAirT1, AxleFrntCoorrSt, AxleReCoorrSt, BattU, BattU, BattU1, BattUToBattUOfCmbEngMisc, BodyPitchAg1, BodyPitchAgAbsltEstimd, BrkActrVehSpdMax, BrkPedlFlgPsd, BrkPedlPsd, BrkPedlPsd1, BrkPedlRat, BrkPedlVal, BrkPedlVal1, CluPedlRat, CluPedlRat1, CmbEng, CmbEngMisc, CoorrStActAtAxleFrnt, CoorrStActAtAxleRe, CoorrStActAtDftlForTqTrf, Crash, Crash, CrashSt1, CrashToCrashOfCmbEngMisc, CrsCtrlActv, CrsCtrlActv1, CrsCtrlAndAccDrvrOvrd, CrsCtrlAndAccDrvrOvrd1, CrsCtrlAndAccSetTiGap, CrsCtrlAndAccSetTiGapDec, CrsCtrlAndAccSetTiGapInc, CrsCtrlAndAccSwtStEngd, CrsCtrlAndAccSwtStEngd1, CrsCtrlAndAccVehSpdLgt, CrsCtrlAndAccVehSpdLgt1, CrsCtrlCtrlActv, CrsCtrlCtrlActv1, DftlCoorrSt1, DftlCoorrSts1, DftlTqReq1, DftlTqReqAtAxleFrnt, DftlTqReqAtAxleRe, DftlTqReqAtDftlForTqTrf, DrvFlgGearShiftDwnReq, DrvFlgGearShiftUpReq, DrvReqTqCluFast, DrvReqTqCluFast1, DrvReqTqCluSlow, DrvReqTqCluSlow1, DrvReqTqWhlFast, DrvReqTqWhlFast1, DrvReqTqWhlSlow, DrvReqTqWhlSlow1, DtOpend, DtdRatTqDistbnReq, DtdTqDftlAxleFrntReq, DtdTqDftlAxleReReq, DtdTqDftlTrfReq, EgyMngt, EgyMngtSt, EgyMngtSt1, EgyMngtSts1, EmTqDynJ, EmTqDynJ, EmTqDynJ1, EngN, EngN, EngN1, EngNGearTar, EngNGearTar1, EngNGrdt, EngNGrdt, EngNGrdt1, EngNGrdtToEngNGrdtOfEngSpdAndPosn, EngNMax, EngNMax, EngNMax, EngNMax1, EngNMaxToEngNMaxOfEngTqModMngt, EngNMin, EngNMin, EngNMin, EngNMin1, EngNMinToEngNMinOfEngTqModMngt, EngNToEngNOfEngSpdAndPosn, EngPAmbAir, EngPAmbAir, EngPAmbAir1, EngPAmbAirToEngPAmbAirOfCmbEngMisc, EngRunngDirSt, EngRunngDirSt, EngRunngDirSt1, EngRunngDirStToEngRunngDirStOfEngSpdAndPosn, EngSpdAndPosn, EngT, EngT, EngT1, EngTToEngTOfCmbEngMisc, EngTqCluMin, EngTqCluMin, EngTqCluMin1, EngTqCrksft, EngTqCrksft, EngTqCrksft, EngTqCrksft1, EngTqCrksftMax, EngTqCrksftMax, EngTqCrksftMax, EngTqCrksftMax1, EngTqCrksftMaxFast, EngTqCrksftMaxFast, EngTqCrksftMaxFast, EngTqCrksftMaxFast1, EngTqCrksftMaxFastToEngTqCrksftMaxFastOfEngTqModMngt, EngTqCrksftMaxOptmCdn, EngTqCrksftMaxOptmCdn, EngTqCrksftMaxOptmCdn, EngTqCrksftMaxOptmCdn1, EngTqCrksftMaxOptmCdnToEngTqCrksftMaxOptmCdnOfEngTqModMngt, EngTqCrksftMaxProtn, EngTqCrksftMaxProtn, EngTqCrksftMaxProtn, EngTqCrksftMaxProtn1, EngTqCrksftMaxProtnToEngTqCrksftMaxProtnOfEngTqModMngt, EngTqCrksftMaxSpdCur, EngTqCrksftMaxSpdCur, EngTqCrksftMaxSpdCur1, EngTqCrksftMaxToEngTqCrksftMaxOfEngTqModMngt, EngTqCrksftMin, EngTqCrksftMin, EngTqCrksftMin, EngTqCrksftMin1, EngTqCrksftMinBasc, EngTqCrksftMinBasc, EngTqCrksftMinBasc, EngTqCrksftMinBasc1, EngTqCrksftMinBascToEngTqCrksftMinBascOfEngTqModMngt, EngTqCrksftMinFast, EngTqCrksftMinFast, EngTqCrksftMinFast, EngTqCrksftMinFast1, EngTqCrksftMinFastToEngTqCrksftMinFastOfEngTqModMngt, EngTqCrksftMinToEngTqCrksftMinOfEngTqModMngt, EngTqCrksftMinWoCutOff, EngTqCrksftMinWoCutOff, EngTqCrksftMinWoCutOff, EngTqCrksftMinWoCutOff1, EngTqCrksftMinWoCutOffToEngTqCrksftMinWoCutOffOfEngTqModMngt, EngTqCrksftToEngTqCrksftOfEngTqModMngt, EngTqDecAtCluReqByEscFast, EngTqDecAtCluReqByEscFast1, EngTqDecAtCluReqByEscSlow, EngTqDecAtCluReqByEscSlow1, EngTqDynJ, EngTqDynJ, EngTqDynJ, EngTqDynJ1, EngTqDynJToEngTqDynJOfEngTqModMngt, EngTqIncAtCluReqByEsc, EngTqIncAtCluReqByEsc1, EngTqModMngt, EngTqModMngt, EngTqResvPt, EngTqResvPt1, EngTqResvReqPt, EngTqResvReqPt, EngTqResvReqPt, EngTqResvReqPt, EngTqResvReqPt, EngTqResvReqPt1, EngTqResvReqPt1, EngTqResvReqPtToEngTqResvReqPtOfEngTqModMngt, EscFlgNoFuCutOff, EscSt, EscSt1, EscStShiftPrevnStaby, EscTqCluPtMaxFast, EscTqCluPtMaxSlow, EscTqCluPtMin, EscTqWhlPtMaxFast, EscTqWhlPtMaxSlow, EscTqWhlPtMinFast, EscTqWhlPtMinSlow, EscVMax, EscVWhlInd, GearParkReq, GearParkReq1, GearShiftDwnReqFromDrvr, GearShiftDwnReqFromDrvr1, GearShiftPrevn1, GearShiftPrevnCmftReqByVlc, GearShiftPrevnStaby, GearShiftUpReqFromDrvr, GearShiftUpReqFromDrvr1, HvacTq, HvacTq, HvacTq1, HvacTqReq, HvacTqReq, HvacTqReq1, IndcrTurnReq1, N2, NoFuCutOffReq, NoFuCutOffReq1, OperMod, OperModSt1, OutdT, P5, P6, P7, Perc10, Perc11, PrkgBrkActv, PrkgBrkActv1, PtAccrPedlPosn, PtAccrPedlPosn, PtAccrPedlPosn1, PtAccrPedlPosnVirt, PtAccrPedlPosnVirt1, PtDrvReqTqCluVirtEngSpd, PtDrvReqTqCluVirtEngSpd, PtDrvReqTqCluVirtEngSpd1, PtEngNSp, PtEngNSp, PtEngNSpToPtEngNSpOfEngTqModMngt, PtEngTqCrksftMinFast, PtEngTqCrksftMinFast, PtEngTqCrksftMinFast1, PtFlgAcDeactvt, PtFlgAcDeactvt1, PtFlgAcDeactvtReq, PtFlgAcDeactvtReq, PtFlgAcDeactvtReq, PtFlgAcDeactvtReq1, PtFlgAcDeactvtReq1, PtFlgAltDeactvt, PtFlgAltDeactvt1, PtFlgAltDeactvtReq, PtFlgDrvOvrdVlc, PtFlgDrvOvrdVlc1, PtFlgEngRun, PtFlgEngRun, PtFlgEngRun, PtFlgEngRun1, PtFlgEngRunToPtFlgEngRunOfEngTqModMngt, PtFlgEngStop, PtFlgEngStop, PtFlgEngStop, PtFlgEngStop1, PtFlgEngStopReq, PtFlgEngStopReq, PtFlgEngStopReq, PtFlgEngStopReq1, PtFlgEngStopReqAllwd, PtFlgEngStopReqAllwd, PtFlgEngStopReqAllwd, PtFlgEngStopReqAllwd1, PtFlgEngStopReqAllwdToPtFlgEngStopReqAllwdOfEngTqModMngt, PtFlgEngStopReqToPtFlgEngStopReqOfEngTqModMngt, PtFlgEngStopToPtFlgEngStopOfEngTqModMngt, PtFlgEngStrtReq, PtFlgEngStrtReq, PtFlgEngStrtReq, PtFlgEngStrtReq1, PtFlgEngStrtReqAllwd, PtFlgEngStrtReqAllwd, PtFlgEngStrtReqAllwd, PtFlgEngStrtReqAllwd1, PtFlgEngStrtReqAllwdToPtFlgEngStrtReqAllwdOfEngTqModMngt, PtFlgEngStrtReqToPtFlgEngStrtReqOfEngTqModMngt, PtFlgHvacDeactvt, PtFlgHvacDeactvt, PtFlgHvacDeactvt1, PtFlgNoTqWhlReq, PtFlgNoTqWhlReq1, PtFlgTqDecPsbl, PtFlgTqDecPsbl1, PtFlgTqIncPsbl, PtFlgTqIncPsbl1, PtNClu, PtNClu1, PtNEngSp, PtNEngSp1, PtRatTqDistbnReq, PtRatTqDistbnReq1, PtTqClu, PtTqClu1, PtTqCluDyn, PtTqCluDyn1, PtTqCluDynJ, PtTqCluDynJ, PtTqCluDynJ1, PtTqCluMaxDrv, PtTqCluMaxDrv1, PtTqCluMaxSpdCluCur, PtTqCluMaxSpdCluCur, PtTqCluMaxSpdCluCur1, PtTqCluMinDrv, PtTqCluMinDrv1, PtTqCluReqWoTrsmIntv, PtTqCluReqWoTrsmIntv1, PtTqCluTarGear, PtTqCluTarGear1, PtTqCluWoTrsmIntv, PtTqCluWoTrsmIntv1, PtTqCrksftReqFast, PtTqCrksftReqFast, PtTqCrksftReqFast, PtTqCrksftReqFast1, PtTqCrksftReqFastToPtTqCrksftReqFastOfEngTqModMngt, PtTqCrksftReqSlow, PtTqCrksftReqSlow, PtTqCrksftReqSlow, PtTqCrksftReqSlow1, PtTqCrksftReqSlowToPtTqCrksftReqSlowOfEngTqModMngt, PtTqDecAtWhlsReqByEscFast, PtTqDecAtWhlsReqByEscSlow, PtTqDistbnToWhls1, PtTqDistbnToWhlsReqdByDtd, PtTqIncAtWhlsReqByEscFast, PtTqIncAtWhlsReqByEscSlow, PtTqMaxAc, PtTqMaxAc1, PtTqMaxAc1, PtTqMaxAlt, PtTqMaxAlt1, PtTqMaxHvac, PtTqMaxHvac1, PtTqMaxSteer, PtTqMaxSteer1, PtTqMaxTrsmOilPmp, PtTqMaxTrsmOilPmp1, PtTqResvEng, PtTqResvEng1, PtTqResvReqEng, PtTqResvReqEng, PtTqResvReqEng, PtTqResvReqEng, PtTqResvReqEng1, PtTqResvReqEngToPtTqResvReqEngOfEngTqModMngt, PtTqTotAtWhls1, PtTqTotMaxAtWhlsReqdByVlc, PtTqTotMinAtWhlsReqdByVlc, PtTqWhl, PtTqWhl1, PtTqWhlInd, PtTqWhlInd1, PtTqWhlMax, PtTqWhlMax1, PtTqWhlMaxDrv, PtTqWhlMaxDrv1, PtTqWhlMin, PtTqWhlMin1, PtTqWhlMinDrv, PtTqWhlMinDrv1, PtTqWhlMinWoCutOff, PtTqWhlMinWoCutOff1, PtTqWhlReq, PtTqWhlReq1, PtTqWhlReqDrvVlc, PtTqWhlReqDrvVlc1, RoadWhlAg1, RoadWhlAgEstimdFrnt, RoadWhlAgEstimdFrntWishdByDrvr, RoadWhlAgEstimdRe, RoadWhlAgSpd1, RoadWhlAgSpdEstimdFrnt, RoadWhlAgSpdEstimdFrntWishdByDrvr, SetSpd, SetSpd1, SetSpdDec, SetSpdDec1, SetSpdInc, SetSpdInc1, SetSpdIndcn, SetSpdIndcn1, SetTiGap1, SsmFlgGearParkReq, SteerLoadHyd, SteerLoadHyd1, SteerLoadHydReq, SteerTq, SteerTqReq, SteerWhlAg1, SteerWhlAgStd, SwtIndcr, T5, T6, TiGapDec1, TiGapInc1, TracCtrlIntvg, TracCtrlIntvg1, TrfCaseCoorrSt, TrsmAxleActrSt1, TrsmCluSt, TrsmCluSt1, TrsmCluStAct, TrsmCluStAct1, TrsmCluStConsold, TrsmCluStConsold, TrsmCluStConsold1, TrsmCluStTar, TrsmCluStTar1, TrsmFlgCtrsftActv, TrsmFlgCtrsftActv1, TrsmFlgDtOpen, TrsmFlgDtOpen1, TrsmFlgParkLockEngd, TrsmFlgParkLockEngd1, TrsmFlgShiftProgs, TrsmFlgShiftProgs1, TrsmFlgSptMod, TrsmFlgSptMod1, TrsmFlgSptModReq, TrsmFlgSptModReq, TrsmFlgSptModReq1, TrsmFlgWntrMod, TrsmFlgWntrMod1, TrsmFlgWntrModReq, TrsmFlgWntrModReq, TrsmFlgWntrModReq1, TrsmNInp, TrsmNInp1, TrsmNrGearAct, TrsmNrGearAct1, TrsmNrGearConsold, TrsmNrGearConsold1, TrsmNrGearReq, TrsmNrGearReq1, TrsmNrGearTar, TrsmNrGearTar1, TrsmNrTyp, TrsmNrTyp1, TrsmRatGear, TrsmRatGear1, TrsmRatGearAct, TrsmRatGearAct1, TrsmRatGearConsold, TrsmRatGearConsold1, TrsmRatGearReq, TrsmRatGearReq1, TrsmRatGearTar, TrsmRatGearTar1, TrsmRatTqPtAct, TrsmRatTqPtAct1, TrsmRatTqPtConsold, TrsmRatTqPtConsold, TrsmRatTqPtConsold1, TrsmReqTypTqCluFast, TrsmReqTypTqCluFast, TrsmReqTypTqCluFast1, TrsmStAxleFrntActr, TrsmStAxleReActr, TrsmStGearLvr, TrsmStGearLvr1, TrsmStTrfCaseDftl, TrsmStTrfCaseDftl1, TrsmTOil, TrsmTOil1, TrsmTqCluFast, TrsmTqCluFast, TrsmTqCluFast1, TrsmTqCluMaxFast, TrsmTqCluMaxFast1, TrsmTqCluMaxProtn, TrsmTqCluMaxSlow, TrsmTqCluMaxSlow1, TrsmTqCluMinFast, TrsmTqCluMinFast1, TrsmTqCluMinSlow, TrsmTqCluMinSlow1, TrsmTqDftlAxleFrntAct, TrsmTqDftlAxleFrntAct1, TrsmTqDftlAxleFrntConsold, TrsmTqDftlAxleFrntConsold1, TrsmTqDftlAxleFrntMax, TrsmTqDftlAxleFrntMax1, TrsmTqDftlAxleReAct, TrsmTqDftlAxleReAct1, TrsmTqDftlAxleReConsold, TrsmTqDftlAxleReConsold1, TrsmTqDftlAxleReMax, TrsmTqDftlAxleReMax1, TrsmTqDftlTrfAct, TrsmTqDftlTrfAct1, TrsmTqDftlTrfConsold, TrsmTqDftlTrfConsold1, TrsmTqDftlTrfMax, TrsmTqDftlTrfMax1, TrsmTqOilPmp, TrsmTqOilPmp1, TrsmTqOilPmpReq, TrsmTqOilPmpReq1, TrsmTqWhlIndDistbn, TrsmTqWhlIndDistbn1, VehCourseCrvtPred, VehCourseCrvtPred1, VehMtnSt, VehMtnSt1, VehSpd1, VehSpdDispd, VehSpdDispd1, VehSpdLgt, VehSpdLgt1, VehStOper, VehTqWhlMaxSftyLimn, VehTqWhlMaxSftyLimn1, VehVLgt, VlcA, VlcStShiftPrevnCmft, VlcTqWhlPtMax, VlcTqWhlPtMin, WhlBrkOvrheatd, WhlBrkOvrheatd1, WhlDirRotl1, WhlDirRotlStd, WhlRdTolrCoeff, WhlRdTolrCoeff1, WhlSpdCircuml1, WhlSpdCircumlStd, YawRate1, YawRateBas, YawRateOffsStdByEsc, YawStabyCtrlIntvg, YawStabyCtrlIntvg1, YawStabyInfo1, YawStabyInfoByEsc]
  collection PtRefAllToPt: category=RELATION, element-role=AUTO_COLLECTED_FROM, element=Pt, source-element=PtRefAll
