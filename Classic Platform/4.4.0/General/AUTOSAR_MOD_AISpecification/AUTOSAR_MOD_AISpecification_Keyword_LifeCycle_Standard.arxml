AUTOSAR XML (schema 00046)
package /AUTOSAR/AISpecification/LifeCycleInfoSets
  life cycle info set KeywordObslt: default-lc-state=obsolete, used-life-cycle-state-definition-group=AutosarLifeCycleStates
    life-cycle-infos:
      lc-object=Ar, period-begin=ar-release-version=4.1.1, remark=p=l-1=harmonisation with basic software abbreviations, use-instead=Area
      lc-object=Gen, period-begin=ar-release-version=4.1.1, remark=p=l-1=harmonisation with generate, generation, generated, generator, use-instead=Generic
      lc-object=Us, period-begin=ar-release-version=4.1.1, remark=p=l-1=Set to obsolete because there might be a different pair of keywords for upstream and downstream in the future
      lc-object=Wind, period-begin=ar-release-version=4.1.1, remark=p=l-1=correction according naming rules, To use Windscreen, please build the short name of the keyword abbreviations of Wind and Screen., use-instead=[Wind1, Scrn]
      lc-object=Sts, lc-state=obsolete, period-begin=ar-release-version=4.2.1, use-instead=St
      lc-object=Sec, lc-state=obsolete, period-begin=ar-release-version=4.2.1, use-instead=Idx2nd
      lc-object=Consold, lc-state=valid, period-begin=ar-release-version=4.2.1
      lc-object=Pwr1, lc-state=valid, period-begin=ar-release-version=4.2.1
      lc-object=Used, lc-state=valid, period-begin=ar-release-version=4.2.1
      lc-object=Exact, lc-state=valid, period-begin=ar-release-version=4.2.1
      lc-object=Ai, lc-state=valid, period-begin=ar-release-version=4.2.1
      lc-object=Us, lc-state=valid, period-begin=ar-release-version=4.2.2
      lc-object=Acry, lc-state=valid, period-begin=ar-release-version=4.3.0
      lc-object=Acrt, lc-state=valid, period-begin=ar-release-version=4.3.0
      lc-object=Inacrt, lc-state=valid, period-begin=ar-release-version=4.3.0
      lc-object=Agt, lc-state=valid, period-begin=ar-release-version=4.3.0
      lc-object=Red, lc-state=valid, period-begin=ar-release-version=4.3.0
      lc-object=Approx, lc-state=valid, period-begin=ar-release-version=4.3.0
      lc-object=Approxn, lc-state=valid, period-begin=ar-release-version=4.3.0
      lc-object=Lumi, lc-state=valid, period-begin=ar-release-version=4.3.0
      lc-object=Deci, lc-state=valid, period-begin=ar-release-version=4.3.0
      lc-object=Micro1, lc-state=valid, period-begin=ar-release-version=4.3.0
      lc-object=Hyddyn, lc-state=valid, period-begin=ar-release-version=4.3.1
      lc-object=Detrm, lc-state=valid, period-begin=ar-release-version=4.3.0
      lc-object=Cur, lc-state=valid, period-begin=ar-release-version=4.3.1
      lc-object=Ancllry, lc-state=valid, period-begin=ar-release-version=4.3.1
      lc-object=Inclg, lc-state=valid, period-begin=ar-release-version=4.3.1
