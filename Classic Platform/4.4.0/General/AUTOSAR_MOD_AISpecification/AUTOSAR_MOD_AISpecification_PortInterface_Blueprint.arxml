[part 2 of 2: package /AUTOSAR/AISpecification/PortInterfaces_Blueprint]
AUTOSAR XML (schema 00046)
package /AUTOSAR/AISpecification/PortInterfaces_Blueprint  (continued)
  client server interface TrsmRatGear1  # Transmission: Gear Ratio for a Given Gear | Returns the gear ratio for a given gear | Theoretical transmission ratio i = ntransmission_in / ntransmission_out transmission_in = after converter transmission_out = gearbox out The gear ratio means the theoretical/physical ratio belonging to each gear and not any actual measured value (proposal for Continuously Variable Transmission (CVT): if there is a wide range for gear states, this value could deliver a theoretical value). Negative values: Reverse driving direction. Without considering the: 1.) axle ratio 2.) converter ratio 3.) High/Low-Range ratio'Default value after reset is 1.0'
    operation GetTrsmRatGear  # Returns the Gear Ratio for a Given Gear | Returns the gear ratio for a given gear
      arg Gear: type=Nr4, direction=IN  # Gear for Which the Ratio Should Be Returned | Gear for which the ratio should be returned
      arg Rat: type=Fac1, direction=OUT  # Gear Ratio of Given Gear | Gear ratio of given gear
  104 x sender receiver interface:
    TrsmRatGearAct1  # Transmission: The Actual Gear Ratio Being Currently Engaged in the Gear Box | Actual theoretical transmission ratio i = ntransmission_in / ntransmission_out transmission_in = after converter transmission_out = gearbox out The gear ratio means the theoretical/physical ratio belonging to each gear and not any actual measured value (proposal for Continuously Variable Transmission (CVT): if there is a wide range for gear states, this value could deliver a theoretical value). Negative values: Reverse driving direction. Without considering the: 1.) axle ratio 2.) converter ratio 3.) High/Low-Range ratio | Default value after reset is 1.0.
      data TrsmRatGearAct: type=Fac1
    TrsmRatGearConsold1  # Transmission: The Consolidated Gear Ratio Being Currently Engaged in the Gear Box | Actual theoretical transmission ratio i = ntransmission_in / ntransmission_out transmission_in = after converter transmission_out = gearbox out The gear ratio means the theoretical/physical ratio belonging to each gear and not any actual measured value (proposal for Continuously Variable Transmission (CVT): if there is a wide range for gear states, this value could deliver a theoretical value). Negative values: Reverse driving direction. Without considering the: 1.) axle ratio 2.) converter ratio 3.) High/Low-Range ratio | Default value after reset is 1.0.
      data TrsmRatGearConsold: type=Fac1
    TrsmRatGearReq1  # Transmission: Requested Gear Ratio | The gear ratio which is requested by ration strategy | Theoretical transmission ratio i = ntransmission_in / ntransmission_out transmission_in = after converter transmission_out = gearbox out The gear ratio means the theoretical/physical ratio belonging to each gear and not any actual measured value. Proposal for Continuously Variable Transmission (CVT): if there is a wide range for gear states, this value could deliver a theoretical ratio. Negative values: Reverse driving direction. Without considering the: 1.) Axle ratio 2.) Converter ratio 3.) High/Low-Range ratio'Default value after reset is 1.0.'
      data TrsmRatGearReq: type=Fac1
    TrsmRatGearTar1  # Transmission: The Gear Ratio Which Will Be Engaged in the Gear Box When Target Gear Is Reached | Theoretical transmission ratio i = ntransmission_in / ntransmission_out transmission_in = after converter transmission_out = gearbox out The gear ratio means the theoretical/physical ratio belonging to each gear and not any actual measured value (proposal for Continuously Variable Transmission (CVT): if there is a wide range for gear states, this value could deliver a theoretical value). Negative values: Reverse driving direction. Without considering the: 1.) axle ratio 2.) converter ratio 3.) High/Low-Range ratio | Default value after reset is 1.0.
      data TrsmRatGearTar: type=Fac1
    TrsmRatTqPtAct1  # Transmission: Actual Powertrain Torque Ratio | Torque conversion ratio including everything between engine and wheel, i.e. converter gain (only for hydraulic converter), gear box and axle ratio. | TQwheel = (TQclutch * FACconverter * ntransmission_in / nwheel) - TQlossDT TQ conversion ratio = FACconverter * ntransmission_in / nwheel (remark: TQlossDT is not considered here) FACconverter = converter gain transmission_in = after converter/clutch Inertia is not considered. The torque conversion ratio considers only the total powertrain torque at wheels, not the wheel individual torque distribution. At open drivetrain: To get a valid value during the open drivetrain always the lowest gear should be used except: Driver or strategy selects "N" or "P": Every transmission has an open drivetrain Low vehicle speed: Manual Transmission (MT), Automatic Manual Transmission (AMT) and Dual Clutch Transmission (DCT) have an open drivetrain. For Automatic Transmission (AT) and Continuously Variable Transmission (CVT) the drivetrain is still closed (hydraulic converter) Shifting: Only Manual Transmission (MT) and Automatic Manual Transmission (AMT) have an open drivetrain for Automatic Manual Transmission (AMT), if a gear shift is detected, the torque ratio calculation changes from using the current gear state to the target gear state at some point during the shift. This point of change must be agreed between transmitter and receiver. The torque ratio never indicates neutral during a shift. for Automatic Transmission (AT), Continuously Variable Transmission (CVT) and Dual Clutch Transmission (DCT): While the drivetrain is open the transmission prepares a theoretical gear position to engage immediately after the driver selects "D". This theoretical gear state information should be used.Default value after reset is 1.0.
      data TrsmRatTqPtAct: type=Fac5
    TrsmRatTqPtConsold1  # Transmission: Consolidated Powertrain Torque Ratio | Torque conversion ratio including everything between engine and wheel, i.e. converter gain (only for hydraulic converter), gear box and axle ratio. | TQwheel = (TQclutch * FACconverter * ntransmission_in / nwheel) - TQlossDT TQ conversion ratio = FACconverter * ntransmission_in / nwheel (remark: TQlossDT is not considered here) FACconverter = converter gain transmission_in = after converter/clutch Inertia is not considered. The torque conversion ratio considers only the total powertrain torque at wheels, not the wheel individual torque distribution. At open drivetrain: To get a valid value during the open drivetrain always the lowest gear should be used except: Driver or strategy selects "N" or "P": every transmission has an open drivetrain Low vehicle speed: Manual Transmission (MT), Automatic Manual Transmission (AMT) and Dual Clutch Transmission (DCT) have an open drivetrain. For Automatic Transmission (AT) and Continuously Variable Transmission (CVT) the drivetrain is still closed (hydraulic converter) Shifting: Only Manual Transmission (MT) and Automatic Manual Transmission (AMT) have an open drivetrain for Automatic Manual Transmission (AMT), if a gear shift is detected, the torque ratio calculation changes from using the current gear state to the target gear state at some point during the shift. This point of change must be agreed between transmitter and receiver. The torque ratio never indicates neutral during a shift. for Automatic Transmission (AT), Continuously Variable Transmission (CVT) and Dual Clutch Transmission (DCT): While the drivetrain is open the transmission prepares a theoretical gear position to engage immediately after the driver selects "D". This theoretical gear state information should be used.Default value after reset is 1.0.
      data TrsmRatTqPtConsold: type=Fac5
    TrsmRatTqTrsmOutpByTqClu1  # Transmission: Ratio of Torque at Transmission Output by Torque at Clutch | Ratio of torque at transmission output by torque at clutch. | Current ratio of Torque at Transmission Output by Torque at Clutch. This ratio covers the ratio of the gearbox, but not the axle ratio. For transmissions without a converter: The slip of the drive-off element is supposed to be zero for the calculation of this signal. For transmissions with a converter: The signal is calculated with the current converter torque ratio. The converter torque ratio is continuously updated. For transmissions with a converter, the signal is the combination of the current torque ratio of the gearbox core and the actual torque ratio of the converter including the converter clutch, if present.
      data TrsmRatTqTrsmOutpByTqClu: type=Fac5  # Transmission: Ratio of Torque at Transmission Output by Torque at Clutch
    TrsmRatTqTrsmOutpByTqCluTar1  # Transmission: Target Ratio of Torque at Transmission Output By Torque at Clutch | Target ratio of torque at transmission output by torque at clutch. | Ratio, calculated at the current vehicle speed, Torque at Transmission Output by Torque at Clutch which is expected to be reached when the target gear is engaged This ratio covers the ratio of the gearbox, but not the axle ratio. For transmissions without a converter: The slip of the drive-off element is supposed to be zero for the calculation of this signal. For transmissions with a converter: The signal is calculated with the current converter torque ratio, because the converter torque ratio in the target gear is unknown. The converter torque ratio is continuously updated. For transmissions with a converter, the signal is the combination of the torque ratio of the gearbox core at target gear and the current torque ratio of the converter including the converter clutch, if present. The signal changes synchronously with the change of the "Transmission: Gear State". References to other signals: TrsmGearSt
      data TrsmRatTqTrsmOutpByTqCluTar: type=Fac5  # Transmission: Target Ratio of Torque at Transmission Output By Torque at Clutch
    TrsmRatTqWhlByTqClu1  # Transmission: Ratio of Torque at Wheel by Torque at Clutch | Ratio of torque at wheel by torque at clutch. | Current ratio of Torque at Wheel by Torque at Clutch. This ratio covers the ratio of the gearbox as well as the axle ratio. For transmissions without a converter: The slip of the drive-off element is supposed to be zero for the calculation of this signal. For transmissions with a converter: The signal is calculated with the current converter torque ratio. The converter torque ratio is continuously updated. For transmissions with a converter, the signal is the combination of the current torque ratio of the gearbox core and the current torque ratio of the converter including the converter clutch, if present.
      data TrsmRatTqWhlByTqClu: type=Fac5  # Transmission: Ratio of Torque at Wheel by Torque at Clutch
    TrsmRatTqWhlByTqCluTar1  # Transmission: Target Ratio of Torque at Wheel by Torque at Clutch | Target ratio of torque at wheel by torque at clutch. | Ratio, calculated at the current vehicle speed, of Torque at Wheel by Torque at Clutch which is expected to be reached when the target gear is engaged This ratio covers the ratio of the gearbox as well as the axle ratio. For transmissions without a converter: The slip of the drive-off element is supposed to be zero for the calculation of this signal. For transmissions with a converter: The signal is calculated with the current converter torque ratio, because the converter torque ratio in the target gear is unknown. The converter torque ratio is continuously updated. For transmissions with a converter, the signal is the combination of the torque ratio of the gearbox core at target gear and the current torque ratio of the converter including the converter clutch, if present. The signal changes synchronously with the change of the "Transmission: Gear State". References to other signals: TrsmGearSt
      data TrsmRatTqWhlByTqCluTar: type=Fac5  # Transmission: Target Ratio of Torque at Wheel by Torque at Clutch
    TrsmRednGbxSt1  # Transmission: State of Reduction Gearbox | State of the reduction gearbox concerning transmission of power. | The signal is defined for the most common case of implementation by dog clutch. Correspondingly, reduction gearboxes with more than two states of power transmission are not in scope of this definition. 0 = open 1 = closed 2 = init 3 = signal error
      data TrsmRednGbxSt: type=TrsmPwrSt1  # Transmission: State of Reduction Gearbox
    TrsmReqTypTqCluFast1  # Transmission: Request for Realisation Type of Torque at Clutch Requested by Transmission for Shift Intervention on Fast Path | Defines reference point and coordination of signal "Torque at Clutch Requested by Transmission for Shift Intervention on Fast Path". | 0 = no request => the transmission control unit does not send a request 1 = absolute maximum => the transmission control unit requests an absolute upper limit for the torque to be produced by the engine. The real engine torque is allowed to be lower. It may be lower due to driver request or due to interventions by other control systems. Usually used for decreasing torque requests. 2 = absolute minimum => the transmission control unit requests an absolute lower limit for the torque to be produced by the engine. The real engine torque is allowed to be higher. It may be higher due to driver request or due to interventions by other control systems. Usually used for increasing torque requests. 3 = absolute exact => the transmission control unit requests exactly the torque to be produced by the engine. The real engine torque has to follow the request. Used for exact torque requests independently whether the request is increasing or decreasing. 4 = relative => the transmission control unit requests a torque relative to the reference "Powertrain: Torque at Clutch without Transmission Intervention", PtTqCluWoTrsmIntv. The torque request to be realized is the sum of "Powertrain: Torque at Clutch without Transmission Intervention", PtTqCluWoTrsmIntv and "Transmission: Torque at Clutch Requested by Transmission for Shift Intervention on Fast Path", TrsmTqCluFast. If the sign of the relative torque request is positive the sum is treated like "2 = absolute minimum". If the sign of the relative torque request is negative the sum is treated like "1 = absolute maximum". Advantage of the relative request: It follows dynamic changes of the reference immediately. It does not depend strongly on bus communication time delays. Advantage of the absolute request: It is independent of the reference and its dynamic behavior and consequently meets exact absolute requests by the transmission control unit. This signal does not define whether the intervention of stability control has priority over the intervention of the transmission control unit or not. It can be used in both cases. This priority of stability versus transmission intervention is not part of this definition.
      data TrsmReqTypTqCluFast: type=TrsmTqReqTyp1
    TrsmReqTypTqCluFast2  # Transmission: Realization Type of Torque at Clutch Requested by Transmission for Shift Intervention on Fast Path | Defines reference point and coordination of transmission torque request on fast path. | 0 = no request => the transmission does not send a request 1 = absolute maximum => the transmission requests an absolute upper limit for the torque to be produced by the engine. The real engine torque is allowed to be lower. It may be lower due to driver request or due to interventions by other systems. Usually used for decreasing torque requests. 2 = absolute minimum => the transmission requests an absolute lower limit for the torque to be produced by the engine. The real engine torque is allowed to be higher. It may be higher due to driver request or due to interventions by other systems. Usually used for increasing torque requests. 3 = absolute exact => the transmission requests exactly the torque to be produced by the engine. The real engine torque has to follow the request. Used for exact torque requests independently whether the request is increasing or decreasing. 4 = relative => the transmission requests a torque relative to the reference "Powertrain: Torque at Clutch without Transmission Intervention”. The torque request to be realized is the sum of "Powertrain: Torque at Clutch without Transmission Intervention" and "Transmission: Torque at Clutch Requested by Transmission for Shift Intervention on Fast Path". If the sign of the relative torque request is positive the sum is treated like "2 = absolute minimum". If the sign of the relative torque request is negative the sum is treated like "1 = absolute maximum". Advantage of the relative request: It follows dynamic changes of the reference immediately. It does not depend strongly on communication time delays. Advantage of the absolute request: It is independent of the reference and its dynamic behavior and consequently meets exact absolute requests by the transmission. This signal does not define whether the intervention of stability control has priority over the intervention of the transmission or not. It can be used in both cases. This priority of stability versus transmission intervention is not part of this definition. References to other signals: PtTqCluWoTrsmIntv TrsmTqCluFast
      data TrsmReqTypTqCluFast1: type=TrsmTqReqTyp2
    TrsmRxnOfPasePanicReq1  # Transmission Reception of Pase Panic Request | Request given by Passive Entry (PASE) to command a panic alert.
      data TrsmRxnOfPasePanicReq: type=ReqSt1
    TrsmStGearLvr1  # Transmission: Gear Lever Position | The signal is based on the lever position. Only defined for automatic transmissions.
      data TrsmStGearLvr: type=TrsmPosnGearLvr1
    TrsmStTrfCaseDftl1  # Transmission: Status of the Transfer Case Differential | Status of the Transfer Case Differential
      data TrsmStTrfCaseDftl: type=DevErrSt4
    TrsmTOil1  # Transmission: Transmission Oil Temperature | Transmission oil temperature. | No further explanation needed.
      data TrsmTOil: type=T4  # Transmission: Transmission Oil Temperature
    TrsmTqCluFast1  # Transmission: Torque at Clutch Requested by Transmission for Shift Intervention on Fast Path | Torque at clutch requested by transmission for shift intervention on fast path. | This signal is closely related to the signals for "realization type" and “intervention mode” of request: Usually used for shift interventions, but permitted for all purposes. This request realized by the engine must not be visible on the following signals, which are sent by the engine: As long as there is no torque request by the transmission a constant substitute value (“no request”) will be transmitted on the signal. On parallel hybrid projects the transmission transmits the “summarized torque request” of the combustion engine and the electric machine. References to other signals: TrsmReqTypTqCluFast1 PtIntvModTqCluFastReq PtTqCluReqWoTrsmIntv PtTqCluWoTrsmIntv Transmission: Realization Type of Torque at Clutch Requested by Transmission for Shift Intervention on Fast Path Intervention Mode Permitted for Torque at Clutch Requested for Shift Intervention on Fast Path. Powertrain: Requested Torque at Clutch without Transmission Intervention and Powertrain: Torque at Clutch without Transmission Intervention.
      data TrsmTqCluFast: type=Tq5  # Transmission: Torque at Clutch Requested by Transmission for Shift Intervention on Fast Path
    TrsmTqCluFastReq1  # Transmission: Torque at Clutch Requested by Transmission for Shift Intervention on Fast Path | Torque at clutch requested by the transmission for shift intervention on fast path. | This signal is closely related to the signals for " implementation type" and “intervention mode” of request: “Transmission: Implementation Type of Torque at Clutch Requested by Transmission for Shift Intervention on Fast Path”, “Powertrain: Intervention Mode Permitted for Torque at Clutch Requested for Shift Intervention on Fast Path”. Usually used for shift interventions, but permitted for all purposes. This request, which is implemented by the engine, is not permitted to be visible on the following signals, which are sent by the engine: “Powertrain: Requested Torque at Clutch without Transmission Intervention”, “Powertrain: Torque at Clutch without Transmission Intervention”. As long as there is no torque request from the transmission a constant substitute value (“no request”) is transmitted on the signal. In parallel hybrid projects, the transmission transmits the “summarized torque request” of the combustion engine and the electric machine. References to other signals: TrsmNrTypTqCluFastReq PtIntvModTqCluFastReq PtTqCluReqWoTrsmIntv PtTqCluWoTrsmIntv
      data TrsmTqCluFastReq: type=Tq5  # Transmission: Torque at Clutch Requested by Transmission for Shift Intervention on Fast Path
    TrsmTqCluGrdtUpprLimReq1  # Transmission: Clutch Torque Gradient Upper Limit Requested by Transmission | Transmission request to limit the clutch torque gradient if changes in the real and virtual driver requests could cause the gradient to be exceeded. | Transmission request to limit the clutch torque gradient if changes in the real and virtual driver requests could cause the gradient to be exceeded. Other requests such as engine internal stall protection and idle speed control or other external interventions are not permitted to be limited. This signal offers the following benefit in comparison to the transmission torque requests: The effect of the signal must be visible on signals "Powertrain: Torque at Clutch", "Powertrain: Torque at Clutch without Transmission Intervention", "Powertrain: Requested Torque at Clutch without Transmission Intervention", “Powertrain: Virtual Driver Request of Torque at Clutch at Target Speed”. As a default value, or if there is no request from the transmission, the passive value (FEh) is sent. The target is to implement this gradient limitation as fast as possible by fast and slow request. For “Mild Hybrids” and “Full Hybrids” (Parallel Hybrids), the transmission transmits the “gradient of the summarized torque request of combustion engine and electric machine. For “Full Hybrids” (Parallel Hybrids), the torque transmitted by the engine clutch must be considered. References to other signals: PtTqClu PtTqCluWoTrsmIntv PtTqCluReqWoTrsmIntv PtDrvReqTqCluVirtEngN homogenous transition without torque jumps, preventive protection without unintended effects on driving behavior, improvement of dynamics in comparison to limitation by the transmission torque requests.
      data TrsmTqCluGrdtUpprLimReq: type=TqGrdt1  # Transmission: Clutch Torque Gradient Upper Limit Requested by Transmission
      data TrsmTqCluGrdtUpprLimReq: type=TqGrdt1  # Transmission: Clutch Torque Gradient Upper Limit Requested by Transmission
    TrsmTqCluLoss1  # Transmission: Transmission Torque Losses at Clutch | Transmission torque losses at clutch. | The transmission torque losses include the torque of the gearbox oil pump and gearbox internal losses, e.g., bearing friction and drag torque losses of clutches. Typically, the values are gathered from test bench measurements. These losses are usually considered when converting engine to wheel torque and vice versa. In projects in which the axle is integrated in the transmission, the signal considers the losses of the axle. In projects in which the axle is not integrated in the transmission, the signal does not consider the losses of the axle. The value sent on the network is the absolute value of the transmission torque losses. The value on the application level must consider the sign. The Application Data Type must cover negative values.
      data TrsmTqCluLoss: type=Tq6  # Transmission: Transmission Torque Losses at Clutch
    TrsmTqCluMaxFast1  # Transmission: Maximum Torque at Clutch Requested by Transmission for Shift Intervention on Fast Path | Maximum Torque at clutch requested by Transmission for shift intervention on fast path. | Usually used for shift intervention, but permitted for all purposes. This request realized by the engine must not be visible on the following signals, which are sent by the engine: and As long as there is no torque request by the transmission a constant substitute value (“no request”) or the maximum value will be transmitted on the signal. On parallel hybrid projects the transmission transmits the “summarized torque request” of the combustion engine and the electric machine. This signal is defined for an absolute intervention. The interface for relative interventions to the reference "Powertrain: Torque at Clutch without Transmission Intervention" has to be defined separately. References to other signals: PtTqCluReqWoTrsmIntv PtTqCluWoTrsmIntv Powertrain: Requested Torque at Clutch without Transmission Intervention, Powertrain: Torque at Clutch without Transmission Intervention.
      data TrsmTqCluMaxFast: type=Tq5
    TrsmTqCluMaxFastReq1  # Transmission: Maximum Torque at Clutch Requested by Transmission for Shift Intervention on Fast Path | Maximum Torque at clutch requested by transmission for shift intervention on fast path. | Usually used for shift intervention, but permitted for all purposes. This request, which is implemented by the engine, is not permitted to be visible on the following signals, which are sent by the engine: “Powertrain: Requested Torque at Clutch without Transmission Intervention”, “Powertrain: Torque at Clutch without Transmission Intervention”. As long as there is no torque request from the transmission, a constant substitute value (“no request”) or the maximum value is transmitted on the signal. In parallel hybrid projects, the transmission transmits the summarized torque request of the combustion engine and the electric machine. This signal is defined for an absolute intervention. The interface for relative interventions to the reference "Powertrain: Torque at Clutch without Transmission Intervention" must be defined separately. References to other signals: PtTqCluReqWoTrsmIntv PtTqCluWoTrsmIntv
      data TrsmTqCluMaxFastReq: type=Tq5  # Transmission: Maximum Torque at Clutch Requested by Transmission for Shift Intervention on Fast Path
    TrsmTqCluMaxProtnReq1  # Transmission: Maximum Torque at Clutch Requested by Transmission for Gearbox Protection | Maximum torque limitation for gearbox protection. | A torque decrease in the engine is performed via fast path and slow path. The engine limits the value of the torque at clutch as defined in the signal "Powertrain: Torque at Clutch", so the effects of dynamic torque are not considered. The lower limit to be considered by the engine depends on the torque necessary for the engine internal stall protection. The global target is to avoid damage of gearbox and drivetrain, e.g. caused by mechanical and thermal overload. The indicated torque must be calculated based on this signal, without consideration of the torque influence of inertia. Although this signal is a transmission intervention, the effect must also be visible on all signals with the suffix "...without Intervention". References to other signals: PtTqClu
      data TrsmTqCluMaxProtnReq: type=Tq5  # Transmission: Maximum Torque at Clutch Requested by Transmission for Gearbox Protection
    TrsmTqCluMaxSlow1  # Transmission: Maximum Torque at Clutch Requested by Transmission for Shift Intervention on Slow Path | Maximum torque at clutch requested by transmission for shift intervention on slow path. | Usually used for shift intervention, but permitted for all purposes. This request realized by the engine must not be visible on the following signals: and As long as there is no torque request by the transmission a constant substitute value (“no request”) or the maximum value will be transmitted on the signal. On parallel hybrid projects the transmission transmits the “summarized torque request” of the combustion engine and the electric machine. This signal is defined for an absolute intervention. The interface for relative interventions to the reference "Powertrain: Torque at Clutch without Transmission Intervention" has to be defined separately. References to other signals: PtTqCluReqWoTrsmIntv PtTqCluWoTrsmIntv Powertrain: Requested Torque at Clutch without Transmission Intervention Powertrain: Torque at Clutch without Transmission Intervention.
      data TrsmTqCluMaxSlow: type=Tq5
    TrsmTqCluMaxSlowReq1  # Transmission: Maximum Torque at Clutch Requested by Transmission for Shift Intervention on Slow Path | Maximum torque at clutch requested by transmission for shift intervention on slow path. | Usually used for shift intervention, but permitted for all purposes. This request, which is implemented by the engine, is not permitted to be visible on the following signals: “Powertrain: Requested Torque at Clutch without Transmission Intervention”, “Powertrain: Torque at Clutch without Transmission Intervention”. As long as there is no torque request from the transmission, a constant substitute value (“no request”) or the maximum value is transmitted on the signal. In parallel hybrid projects, the transmission transmits the summarized torque request of the combustion engine and the electric machine. This signal is defined for an absolute intervention. The interface for relative interventions to the reference "Powertrain: Torque at Clutch without Transmission Intervention" must be defined separately. References to other signals: PtTqCluReqWoTrsmIntv PtTqCluWoTrsmIntv
      data TrsmTqCluMaxSlowReq: type=Tq5  # Transmission: Maximum Torque at Clutch Requested by Transmission for Shift Intervention on Slow Path
    TrsmTqCluMinFast1  # Transmission: Minimum Torque at Clutch Requested by Transmission for Shift Intervention on Fast Path | Minimum Torque at clutch requested by Transmission for shift intervention on fast path. | Usually used for shift intervention, but permitted for all purposes. This request realized by the engine must not be visible on the following signals, which are sent by the engine: As long as there is no torque request by the transmission a constant substitute value (“no request”) or the minimum value will be transmitted on the signal. On parallel hybrid projects the transmission transmits the “summarized torque request” of the combustion engine and the electric machine. This signal is defined for an absolute intervention. The interface for relative interventions to the reference "Powertrain: Torque at Clutch without Transmission Intervention" has to be defined separately. References to other signals: PtTqCluReqWoTrsmIntv PtTqCluWoTrsmIntv “Powertrain: Requested Torque at Clutch without Transmission Intervention" “Powertrain: Torque at Clutch without Transmission Intervention”.
      data TrsmTqCluMinFast: type=Tq5
    TrsmTqCluMinFastReq1  # Transmission: Minimum Torque at Clutch Requested by Transmission for Shift Intervention on Fast Path | Minimum Torque at clutch requested by the transmission for shift intervention on fast path. | Usually used for shift intervention, but permitted for all purposes. This request, which is implemented by the engine, is not permitted to be visible on the following signals, which are sent by the engine: “Powertrain: Requested Torque at Clutch without Transmission Intervention”, “Powertrain: Torque at Clutch without Transmission Intervention”. As long as there is no torque request by from the transmission, a constant substitute value (“no request”) or the minimum value is transmitted on the signal. In parallel hybrid projects, the transmission transmits the summarized torque request of the combustion engine and the electric machine. This signal is defined for an absolute intervention. The interface for relative interventions to the reference "Powertrain: Torque at Clutch without Transmission Intervention" must be defined separately. References to other signals: PtTqCluReqWoTrsmIntv PtTqCluWoTrsmIntv
      data TrsmTqCluMinFastReq: type=Tq5  # Transmission: Minimum Torque at Clutch Requested by Transmission for Shift Intervention on Fast Path
    TrsmTqCluMinProtnReq1  # Transmission: Minimum Torque at Clutch Requested by Transmission for Gearbox Protection | Minimum torque limitation for gearbox protection. | The global target is to avoid damage of gearbox and drivetrain, e.g. caused by mechanical and thermal overload. The signal ensures that the gearbox is not loaded with deeply negative torque at clutch. Signal is relevant for projects with an electric machine. The implementation of the gearbox request is limited by the driving motors: For efficiency and safety reasons, the minimum torque for gearbox protection must not lead to a positive indicated or inner torque on any of the driving motors. The limitation must be implemented only by affecting the negative torque of the electric machine. The effects of dynamic torque are not considered. Although this signal is a transmission intervention, the effect must also be visible on all signals with the suffix "...without Transmission Intervention".
      data TrsmTqCluMinProtnReq: type=Tq5  # Transmission: Minimum Torque at Clutch Requested by Transmission for Gearbox Protection
    TrsmTqCluMinSlow1  # Transmission: Minimum Torque at Clutch Requested by Transmission for Shift Intervention on Slow Path | Minimum torque at clutch requested by transmission for shift intervention on slow path. | Usually used for shift intervention, but permitted for all purposes. This request realized by the engine must not be visible on the following signals, which are sent by the engine: As long as there is no torque request by the transmission a constant substitute value (“no request”) or the minimum value will be transmitted on the signal. On parallel hybrid projects the transmission transmits the “summarized torque request” of the combustion engine and the electric machine. This signal is defined for an absolute intervention. The interface for relative interventions to the reference "Powertrain: Torque at Clutch without Transmission Intervention" has to be defined separately. References to other signals: PtTqCluReqWoTrsmIntv PtTqCluWoTrsmIntv “Powertrain: Requested Torque at Clutch without Transmission Intervention” “Powertrain: Torque at Clutch without Transmission Intervention”.
      data TrsmTqCluMinSlow: type=Tq5
    TrsmTqCluMinSlowReq1  # Transmission: Minimum Torque at Clutch Requested by Transmission for Shift Intervention on Slow Path | Minimum torque at clutch requested by transmission for shift intervention on slow path. | Usually used for shift intervention, but permitted for all purposes. This request, which is implemented by the engine, is not permitted to be visible on the following signals, which are sent by the engine: “Powertrain: Requested Torque at Clutch without Transmission Intervention”, “Powertrain: Torque at Clutch without Transmission Intervention”. As long as there is no torque request from the transmission, a constant substitute value (“no request”) or the minimum value is transmitted on the signal. In parallel hybrid projects, the transmission transmits the “summarized torque request” of the combustion engine and the electric machine. This signal is defined for an absolute intervention. The interface for relative interventions to the reference "Powertrain: Torque at Clutch without Transmission Intervention" must be defined separately. References to other signals: PtTqCluReqWoTrsmIntv PtTqCluWoTrsmIntv
      data TrsmTqCluMinSlowReq: type=Tq5  # Transmission: Minimum Torque at Clutch Requested by Transmission for Shift Intervention on Slow Path
    TrsmTqCluResvReq1  # Transmission: Torque Reserve at Clutch Requested by Transmission | Request to increase torque on slow path without affecting torque at clutch. Reference for increase is defined by the corresponding status signal. | This signal is closely related to "Transmission: Implementation Type of Torque Reserve at Clutch Requested by Transmission". The engine must compensate for the increased air mass by ignition retard and/or injection cutoff. The engine is not permitted to increase the air mass more than can be compensated for. This prevents unintended acceleration of the car. This torque reserve prepares the engine to implement torque increase requests as quickly as is required. References to other signals: TrsmNrTypTqCluResvReq
      data TrsmTqCluResvReq: type=Tq5  # Transmission: Torque Reserve at Clutch Requested by Transmission
    TrsmTqCluStandStill1  # Transmission: Transmission Torque at Clutch in Standstill" | Transmission torque at clutch in vehicle motion state “Standstill”. | Value of torque at clutch consumed by the transmission in standstill. It includes the torque losses caused by the transmission oil pump and the slipping drive-off element such as converter and the drive-off clutch. It is calculated continuously, depending on the gear lever position and the targeted state of power transmission. The transmission calculates this signal by using the engine speed setpoint. The signal is to be used as a prediction in the idle speed governor only at vehicle standstill. The signal must always send a value. During driving, only the oil pump torque is sent. To provide a continuous transition of the torque when leaving standstill, the signal is decreased gradually from the summated torque (torque converter torque + oil pump torque) to the oil pump torque. To provide a continuous transition of the torque when approaching standstill, the signal is increased gradually from the the oil pump torque to the summated torque (torque converter torque + oil pump torque). For projects with an engine clutch, the drag torque of the engine clutch is considered on the signal.
      data TrsmTqCluStandStill: type=Tq5  # Transmission: Transmission Torque at Clutch in Standstill"
    TrsmTqCluStandStillPred1  # Transmission: Predicted Transmission Torque at Clutch in Standstill | Predicted transmission torque at clutch in vehicle motion state “Standstill”. | Predicted value of torque at clutch consumed by the transmission in standstill. It includes the torque losses caused by the transmission oil pump and the slipping drive-off element such as converter and drive-off clutch. It is calculated continuously, depending on the gear lever position and the targeted state of power transmission. The transmission calculates this signal by using the engine speed setpoint. The signal is to be used as a prediction in the idle speed governor only at vehicle standstill.
      data TrsmTqCluStandStillPred: type=Tq5  # Transmission: Predicted Transmission Torque at Clutch in Standstill
    TrsmTqDftlAxleFrntAct1  # Transmission: Actual Differential Torque at Front Axle | Actual theoretical maximum transfer torque at the differential on the front axle as realised by the actuator. | Sign convention: Positive to the right or front.
      data TrsmTqDftlAxleFrntAct: type=Tq13  # Actual theoretical maximum transfer torque at the differential on the front axle as realised by the actuator
    TrsmTqDftlAxleFrntConsold1  # Transmission: Consolidated Differential Torque at Front Axle | Actual theoretical maximum transfer torque at the differential on the front axle as realised by the actuator. | Sign convention: Positive to the right or front.
      data TrsmTqDftlAxleFrntConsold: type=Tq13  # Actual theoretical maximum transfer torque at the differential on the front axle as realised by the actuator
    TrsmTqDftlAxleFrntMax1  # Transmission: Maximum Differential Torque at Front Axle | Absolute value of the maximum torque at the differential on the front axle.
      data TrsmTqDftlAxleFrntMax: type=Tq14  # Absolute value of the maximum torque at the differential on the front axle
    TrsmTqDftlAxleReAct1  # Transmission: Actual Differential Torque at Rear Axle | Actual theoretical maximum transfer torque at the differential on the rear axle as realised by the actuator. | Sign convention: Positive to the right or front.
      data TrsmTqDftlAxleReAct: type=Tq13  # Actual theoretical maximum transfer torque at the differential at the rear axle as realised by the actuator
    TrsmTqDftlAxleReConsold1  # Transmission: Consolidated Differential Torque at Rear Axle | Actual theoretical maximum transfer torque at the differential on the rear axle as realised by the actuator. | Sign convention: Positive to the right or front.
      data TrsmTqDftlAxleReConsold: type=Tq13  # Actual theoretical maximum transfer torque at the differential at the rear axle as realised by the actuator
    TrsmTqDftlAxleReMax1  # Transmission: Maximum Differential Torque at Rear Axle | Absolute value of the maximum torque at the differential at the rear axle
      data TrsmTqDftlAxleReMax: type=Tq14  # Absolute value of the maximum torque at the differential at the rear axle
    TrsmTqDftlTrfAct1  # Transmission: Actual Differential Transfer Torque | Actual theoretical maximum transfer torque at the differential as realised by the actuator. | Sign convention: Positive to the right or front.
      data TrsmTqDftlTrfAct: type=Tq13  # Actual theoretical maximum transfer Torque Transfer Case Differential as realised by the actuator
    TrsmTqDftlTrfConsold1  # Transmission: Consolidated Differential Transfer Torque | Actual theoretical maximum transfer torque at the differential as realised by the actuator. | Sign convention: Positive to the right or front.
      data TrsmTqDftlTrfConsold: type=Tq13  # Actual theoretical maximum transfer Torque Transfer Case Differential as realised by the actuator
    TrsmTqDftlTrfMax1  # Transmission: Maximum Differential Transfer Torque | Absolute value of the maximum torque at the Transfer Case Differential
      data TrsmTqDftlTrfMax: type=Tq14  # Absolute value of the maximum torque at the Transfer Case Differential
    TrsmTqGrdtUpprLimReq1  # Transmission: Torque Gradient Upper Limit Requested by Transmission | Transmission request to limit the gradient of the clutch torque if the gradient would be exceeded by changes of the real and virtual driver requests. | Transmission request to limit the gradient of the clutch torque if the gradient would be exceeded by changes of the real and virtual driver request. Other requests like engine internal stall protection and idle speed control must not be limited. This signal offers following benefit in comparison to the transmission torque requests: and the other external requests must not be limited. The effect of the signal has to be visible on signals "Powertrain: Torque at Clutch", "Powertrain: Torque at Clutch without Transmission Intervention", "Powertrain: Requested Torque at Clutch without Transmission Intervention", “Powertrain: Virtual Driver Request of Torque at Clutch at Target Speed”. As a default value or if there is no request by the transmission the passive value (FEh) will be sent. On “Mild Hybrids” and “Full Hybrids” (Parallel Hybrids) the transmission transmits the “gradient of the summarized torque request of combustion engine and electric machine. On “Full Hybrids” (Parallel Hybrids) the torque transmitted by the engine clutch has to be considered. References to other signals: PtTqClu PtTqCluWoTrsmIntv PtTqCluReqWoTrsmIntv PtDrvReqTqCluVirtEngN homogenous transition without torque jumps preventive protection without unintended influences onto driving behavior. improvement of dynamics in comparison to limitation by the transmission torque requests.
      data TrsmTqGrdtUpprLimReq: type=TqGrdt1
    TrsmTqOilPmp1  # Transmission: Transmission Oil Pump Load | Transmission oil pump load at clutch. | The torque consumption of the transmission oil pump especially depends on the gearbox temperature, rotational speed and system pressure of the transmission hydraulic system. Typically, the values are gathered from test bench measurements. Used to distinguish between gearbox core losses and gearbox oil pump torque losses, which can only be measured together. The signal can be used by the propulsion unit to calculate Torque at Clutch with higher precision, especially for transmissions with a permanently connected transmission oil pump. If it the pump is is an electric oil pump, then the value should be zero Nm, because the load is included in the alternator load. The value of this signal is converted to clutch torque by the provider. The value sent on the network is the absolute value of the transmission torque losses. The value on the application level must consider the sign. The Application Data Type must cover negative values.
      data TrsmTqOilPmp: type=Tq6  # Transmission: Transmission Oil Pump Load
    TrsmTqOilPmpReq1  # Requested Transmission Oil Pump Load | Requested transmission oil pump load at engine crank shaft. | If the oil pump is driven by the engine crank shaft then this value must take into account all relevant dynamic effects. If it is an electric oil pump, the value should be zero Nm, because the load is included in alternator load. The value of this signal is converted to engine crank shaft torque by the provider.Default value after reset is zero.
      data TrsmTqOilPmpReq: type=Tq6
    TrsmTqWhlIndDistbn1  # Individual Torque at Wheel Distribution as Realized by Transmission System | Individual torque at wheel distribution as realized by Transmission System. Vector of 4 signals. | The DTD (drivetrain torque distribution) component in the transmission system realizes the torque distribution request and powertrain coordinator sends the coordinated actual wheel torques as feedback to the chassis. This interface only considers the torque which can be distributed from one or more central torque producers to the wheels by the transmission system. It does not consider additional torque producers located e.g. at the individual wheels. Where no torque is distributed to the wheels by the transmission system (e.g. one axle not driven or directly driven by an electric machine), the respective values are zero. In case of actor/sensor failures or if there is no possibility to determine the correct distribution a rough estimation is done. Additionally a qualifier has to be set, to inform about invalid or backup values.
      4 x data, all with type=Tq7:
        TrsmTqWhlIndDistbnFrntLe  # Front left wheel
        TrsmTqWhlIndDistbnFrntRi  # Front right wheel
        TrsmTqWhlIndDistbnReLe  # Rear left wheel
        TrsmTqWhlIndDistbnReRi  # Rear right wheel
    UpReqForRoofCnvtb1  # Up Request for Roof Convertible | Request related to Roof folded in the trunk. This request assists the customer to open the trunk with the roof folded in for a luggage access.
      data Req: type=OnOff1  # On: Request to assist the customer to open the trunk with the roof folded in Off: No request to assist the customer to open the trunk with the roof folded in
    VehBodyAVert1  # Vehicle Body Acceleration Vertical | Generic interface for vehicle vertical body accelerations at wheel. Refer to ISO 8855.
      data VehBodyAVert: type=VehBodyAVertPerWhl1
    VehBrkTqApplyReq1  # Vehicle Brake Torque Apply Request 1 | Indicates whether the Vehicle Longitudinal Control wants Electronic Stability Control to apply a desired vehicle global brake torque or not.
      data VehBrkTqReqSt: type=ReqSt1
    VehBrkTqGrdtReq1  # Vehicle Brake Torque Gradient Request 1 | Time Derivative of the requested total vehicle brake torque. Based on nominal brake parameters (e.g. constant pads friction) and (estimated or measured) brake clamp forces.
      data VehBrkTqGrdtReq: type=TqGrdt1
    VehBrkTqIntd1  # Vehicle Brake Torque Intended 1 | Sum of 4 wheel intended brake torques. Result of arbitration between driver and other chassis functions.
      data VehBrkTqIntd: type=Tq4
    VehBrkTqReq1  # Vehicle Brake Torque Request 1 | Generic interface for requested longitudinal vehicle brake torque based on nominal brake parameters and (estimated) brake pressures (clamp forces).
      data VehBrkTqReq: type=Tq4
    VehCourseCrvtCorrd1  # Corrected Vehicle Course Curvature | Curvature of predicted vehicle course which is calculated from vehicle information and environmental information.
      data VehCourseCrvtCorrd: type=Crvt1
    VehCourseCrvtPred1  # Predicted Vehicle Course Curvature | Curvature of predicted vehicle course which is calculated with vehicle speed and yaw rate.
      data VehCourseCrvtPred: type=Crvt1
    VehDetdByFolwCtrl1  # Follow Control Vehicle Detected | Target vehicle for follow control in Adaptive Cruise Control is detected. This information is used as input to Adaptive Cruise Control state machine.
      data St: type=DetnSt1  # 0: not detected 1: detected
    VehHldReq1  # Vehicle Hold Request | Generic interface regarding vehicle hold commands, e.g. from Vehicle Longitudinal Control (VLC) to Stand Still Manager (SSM).
      data VehHldReq: type=VehHldReq1
    VehHldSt1  # Vehicle Hold Status 1 | Status that indicates whether a vehicle is held or not
      data VehHldSt: type=VehHldSt1
    VehHldSts1  # Vehicle Hold Status 1 | Status that indicates whether a vehicle is held or not
      data VehHldSts: type=VehHldSt1
    VehM1  # Vehicle Mass | Vehicle mass provided
      data VehM: type=M1
    VehMEstimd1  # Vehicle Mass Estimated | Estimation of the vehicle mass provided
      data VehMEstimd: type=M1
    VehMod1  # Vehicle Mode | This information is needed to know if the vehicle is in factory mode, show room mode, customer mode
      data VehMod: type=VehMod1
    VehMtnSt1  # Vehicle Motion State 1 | Vehicle motion state whether vehicle is moving forward or backward or if it is in stand still.
      data VehMtnSt: type=VehMtnSt1
    VehPitchovrMod1  # Vehicle Pitchover Mode | This interface shows the state of pitchover
      data VehPitchovrMod: type=PitchovrMod1
    VehRollovrMod1  # Vehicle Rollover Mode | This interface shows the state of rollover
      data VehRollovrMod: type=RollovrMod1
    VehSpd1  # Vehicle Speed 1 | Generic interface for vehicle speed
      data VehSpd: type=Spd3
    VehSpdDispd1  # Displayed Vehicle Speed | Vehicle speed shown on speedometer.
      data VehSpdDispd: type=Spd4
    VehSpdLgt1  # Vehicle Speed Longitudinal 1 | Vehicle longitudinal speed based on individual wheel speeds, possibly extended by acceleration sensor. Coordinate system according to ISO 8855. The vehicle speed refers to Center Of Gravity (COG). | During brake intervention the accuracy of vehicle speed may be reduced, e.g. For the measured value only 2 wheel speed sensors are used as the other ones are locked.
      data VehSpdLgt: type=Spd1
    VehTqWhlMaxSftyLimn1  # Safety Torque Limit Calculated from the Vehicle's Maximum Speed | Torque limit calculated from the vehicle's maximum speed limit. This speed limit is not the "comfort" speed limit; it is the safety or vehicle protection limit, normally not selectable by the driver.
      data VehTqWhlMaxSftyLimn: type=Tq7
    WhlAAgr1  # Wheel Acceleration Angular 1 | Angular acceleration of the four individual wheels.
      data WhlAAgr: type=WhlAAgrPerWhl1
    WhlAVert1  # Wheel Acceleration Vertical | Vehicle vertical wheel acceleration. Refer to ISO 8855.
      data WhlAVert: type=WhlAVertPerWhl1
    WhlBrkOvrheatd1  # Wheel Brake Overheated 1 | Wheel brake overheating Indication that at least one wheel brake (caliper, disc, pad) temperature is high
      data WhlBrkOvrheatd: type=TSt1  # 0: normal brake temperature 1: brake overheated
    WhlBrkSlip1  # Wheel Brake Slip 1 | Generic interface for wheel brake slip
      data WhlBrkSlip: type=WhlBrkSlipPerWhl1
    WhlBrkTq1  # Wheel Brake Torque 1 | Requested Brake Torques to be acting on the wheels. Based on nominal brake parameters and (estimated) brake pressures (clamp forces). Absolute requested.
      data WhlBrkTq: type=WhlBrkTqPerWhl1
    WhlBrkTqApplyReq1  # Wheel Brake Torque Apply Request 1 | Wheel brake torques request status.
      data WhlBrkTqReqSt: type=WhlBrkTqReqStPerWhl1
    WhlDirRotl1  # Wheel Direction Rotational 1 | Direction of rotation of each wheel in the order front left, front right, rear left, rear right.
      data WhlDirRotl: type=WhlDirRotlPerWhl1
    WhlFVert1  # Wheel Force Vertical 1 | Estimation of the actual vehicle vertical wheel forces provided by the suspension systems. Vector of 4 scalars in the order front left, front right, rear left, rear right. Refer to ISO 8855.
      data WhlFVert: type=WhlFVertPerWhl1
    WhlLoadDif1  # Wheel Load Difference 1 | Generic interface for wheel load difference on an axle defined as the total axle load applied to the left wheel (100%: Total axle load on left wheel, 0%: Total axle load on right wheel)
      data WhlLoadDif: type=Perc2
    WhlRdTolrCoeff1  # Wheel Radius Tolerance Coefficient 1 | Wheel radius tolerance coefficient. Vector of 4 estimated scalars assigned to the individual wheels in the order front left, front right, rear left, rear right. The product of each scalar with its corresponding circumferential wheel speed allows getting a better estimation of the linear velocity of the contact patch of the wheel over ground. These scalars do not compensate for the possible wheel slip.
      data WhlRdTolrCoeff: type=WhlRdTolrCoeffPerWhl1
    WhlSpdCircuml1  # Wheel Speed Circumferential 1 | Wheel circumferential speed. Vector of 4 scalars in the order front left, front right, rear left, rear right. These scalars are the product of the individual angular velocities with the nominal (or static) rolling radius and are very close to the vehicle longitudinal speed of the vehicle. If signal is not provided (optional) the radius must be available as a parameter.
      data WhlSpdCircuml: type=WhlSpdCircumlPerWhl1
    WhlSpdWarnIndcn1  # Wheel Speed Warning Indication 1 | Warning indication, that the maximum speed allowed for the configured tires and/or actual pressure has been exceeded.
      data WhlSpdWarnIndcn: type=TirePMonWarnSt3
    WhlVAgr1  # Wheel Velocity Angular 1 | Angular velocity of individual wheels in the order front left, front right, rear left, rear right.
      data WhlVAgr: type=WhlVAgrPerWhl1
    WhlVAgrRaw1  # Wheel Angular Velocity Raw | Raw values of wheel speed sensors of individual wheels
      data WhlVAgrRaw: type=VAgrRawPerWhl1
    WinHeatrSt1  # Window Heater Status | Activation status of window heater
      data WinHeatrSt: type=DevSt4
    WinHeatrSts1  # Window Heater Status | Activation status of window heater
      data WinHeatrSts: type=DevSts4
    WinWipgCmd1  # Window Wiping Command | Provides information to activate the front wiper. As long as the information is provided the actuator should be on.
      data Cmd: type=Wipg1
    WipgAutReq1  # Wiping Automatic Request | Wiping request by the rain sensor with different interval time and speed. During interval wiping the wiper speed is the lowest possible speed (e.g. speed1). As long as automatic front wiping is requested the provided value of interval time or speed has to be used.
      data Req: type=WipgAutReqFrnt1
    WipgReq1  # Wiping Request | User request for wiping to switch on one strike, interval, low speed or high speed wiping. As long as a wipe sequence is requested, the corresponding value in the table below should be set.
      data Req: type=UsrReqForWipg1
    WipgSpdIntlReq1  # Wiping Speed Interval Request | Requests the interval speed. As long as a interval wipe sequence is requested the provided value of interval speed has to be used.
      data Req: type=WipgSpdIntl1
    WiprPosnCmd1  # Wiper Position Command | Provides information to run in a predefined position. As long as the information is provided the actuator should run/ stay in this position. If there is a valid Window Wiper Command, this supersedes commands given via this interface.
      data PosnReqd: type=WiprPosnReqd1
    WiprSt1  # Wiper Status | Wiper status information
      4 x data:
        Actv: type=OnOff1  # Provides information whether the wiper is currently running. (This is different to the status data element, as the status may report an active interval wiping. Consequently, the status data element does not allow to determine, if the wiper is currently running.) As long as the status is valid the corresponding value should be provided.
        Failr: type=DevErrSt2  # Used as feedback from an actuator component to indicate that the wiper is broken. | Note that no details of the fault are transmitted, but just an operational / defective fault indication.This data element shall not be used for detailed diagnostics.
        Posn: type=WiprPosnMeasd1  # Provides information in which position the wiper is in. As long as the status is valid the corresponding value should be provided.
        St: type=Wipg1  # Provides information about the current mode of the wiping system. As long as the status is valid the corresponding value should be provided.
    WiprSts1  # Wiper Status | Wiper status information
      4 x data:
        Actv: type=OnOff1  # Provides information whether the wiper is currently running. (This is different to the status data element, as the status may report an active interval wiping. Consequently, the status data element does not allow to determine, if the wiper is currently running.) As long as the status is valid the corresponding value should be provided.
        Failr: type=DevErrSts2  # Used as feedback from an actuator component to indicate that the wiper is broken. | Note that no details of the fault are transmitted, but just an operational / defective fault indication.This data element shall not be used for detailed diagnostics.
        Posn: type=WiprPosnMeasd1  # Provides information in which position the wiper is in. As long as the status is valid the corresponding value should be provided.
        Sts: type=Wipg1  # Provides information about the current mode of the wiping system. As long as the status is valid the corresponding value should be provided.
    WiprWshrDiReq1  # Wiper Washer Disable Request | Request to the wiper washer manager, to suppress wash or wipe actions.
      data Req: type=OnOff1
    WshngCmd1  # Washing Command | Actual command to activate the window washing (front, rear or headlamps). As long as the information is provided the actuator should be on.
      data Cmd: type=OnOff1
    WshngReq1  # Washing Request | Actual command to activate the washing, carries a user request to activate the washing of windows (front, rear or headlamps). As long as the information is provided the actuator should be on.
      data Req: type=OnOff1
    WshrFldSt1  # Washer Fluid Status | Provides information if the low limit of washer fluid is reached (enough=above threshold; low level=below threshold). As long as the water level is under the low limit the status is "on".
      data Elm: type=WshrFldLvlLo1
    WshrFldSts1  # Washer Fluid Status | Provides information if the low limit of washer fluid is reached (enough=above threshold; low level=below threshold). As long as the water level is under the low limit the status is "on".
      data Elm: type=WshrFldLvlLo1
    WshrSt1  # Washer Status | Provides the status and failure state information typically sent by a washer.
      data Failr: type=DevErrSt2  # Used as feedback from an actuator component to indicate that the washer is broken. | Note that no details of the fault are transmitted, but just an operational / defective fault indication.
      data St: type=OnOff1  # Provides information whether the washer is on or off. As long as the status is valid the corresponding value should be provided.
    WshrSts1  # Washer Status | Provides the status and failure state information typically sent by a washer.
      data Failr: type=DevErrSts2  # Used as feedback from an actuator component to indicate that the washer is broken. | Note that no details of the fault are transmitted, but just an operational / defective fault indication.
      data Sts: type=OnOff1  # Provides information whether the washer is on or off. As long as the status is valid the corresponding value should be provided.
    YawRate1  # Yaw Rate 1 | Generic interface for yaw rate measured along vehicle z- axis (i.e. compensated for orientation). Coordinate system according to ISO 8855
      data YawRate: type=AgSpd3
    YawRateGrdt1  # Yaw Rate Gradient 1 | Time-derivative of Yaw Rate
      data YawRateGrdt: type=AgA2
    YawStabyCtrlIntvg1  # Yaw Stability Control Intervening 1 | Yaw stability control intervention status.
      data YawStabyCtrlIntvg: type=CtrlSt1  # 0: Yaw stability control not intervening 1: Yaw stability control intervening
    YawStabyInfo1  # Yaw Stability Information 1 | Yaw stability information: Negative shows understeer. Positive shows oversteer. 0 is designed vehicle stable state. +/-100 is start of Yaw Control intervention.
      data YawStabyInfo: type=Perc6
    YawTq1  # Yaw Torque 1 | Generic interface for yaw torque
      data YawTq: type=Tq2
