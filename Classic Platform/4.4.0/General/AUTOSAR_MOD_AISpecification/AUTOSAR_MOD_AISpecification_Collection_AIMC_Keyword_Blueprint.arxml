AUTOSAR XML (schema 00046)
package /AUTOSAR/AISpecification/Collections_Blueprint
  collection PL_List: category=SET, auto-collect=REF-NONE, element-role=PART_OF_SUBSET, element=[A, Adr, Ag, Ar, Cntr, Fac, Flg, Frq, I, Idx, N, Nr, Posn, Pwr, P, Rat, R, St, T, Ti, Tq, V, U, Vol, W]  # Keywords Phys/Log (P/L-List) for Powertrain
