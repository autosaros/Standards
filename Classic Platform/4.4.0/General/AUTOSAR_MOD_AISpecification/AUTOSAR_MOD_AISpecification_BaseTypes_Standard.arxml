AUTOSAR XML (schema 00046)
standard types defined: SInt8
