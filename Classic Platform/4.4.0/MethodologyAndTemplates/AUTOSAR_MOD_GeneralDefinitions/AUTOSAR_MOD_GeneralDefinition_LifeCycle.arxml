AUTOSAR XML (schema 00046)
package /AUTOSAR/GenDef/LifeCycleStateDefinitionGroups
  life cycle state definition group AutosarLifeCycleStates  # Life Cycle Definitions used in AUTOSAR Standards | This set represents the life cycle definitions used by AUTOSAR on M1 and M2 level. See also [TPS_GST_00051] respectively [TPS_GST_00064].
    lc-states:
      6 x life cycle state:
        valid  # VALID | This indicates that the related entity is a valid part of the document. This is the default.
        draft  # DRAFT | This indicates that the related entity is introduced newly in the (meta) model but still experimental. This information is published but is subject to be changed without backward compatibility management.
        obsolete  # OBSOLETE | This indicates that the related entity is obsolete and kept in the (meta) model for compatibility reasons. | If this life cycle state is set, the LifeCycleInfo.remark shall express the recommended alternative solution.
        preliminary  # PRELIMINARY | This indicates that the related entity is preliminary in the (meta) model. It is subject to be changed without backwards compatibility management. An AUTOSAR release does not contain such elements. It is intended for AUTOSAR internal development.
        removed  # REMOVED | This indicates that the related entity is still in the (meta) model for whatever reason. It shall not be used and should not even appear in documents. | An AUTOSAR release does not contain such elements. It is intended for AUTOSAR internal development. Removed elements are not included in an .arxml delivery but can be referenced in a LifeCycleInformationSet by using the atpUriDef attributes of type Referrable: LifeCycleInfo.lcObject, respectively LifeCycleInfo.useInstead.
        shallBecomeMandatory  # SHALL-BECOME-MANDATORY | This indicates that the related entity should be mandatory from the semantical perspective and will become mandatory in future. It is yet left optional to avoid backwards compatibility issues. Such elements should be provided whenever possible.
