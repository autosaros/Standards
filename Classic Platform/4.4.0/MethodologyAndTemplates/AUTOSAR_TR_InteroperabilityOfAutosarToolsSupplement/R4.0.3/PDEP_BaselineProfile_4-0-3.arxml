[part 1 of 3: package /AUTOSAR/DataExchangePoints]
AUTOSAR XML (schema 00046)
package /AUTOSAR/DataExchangePoints
  data exchange point Default: kind=AGREED, referenced-baseline=standard-revisions=CP 4.0.3  # Profile of Default Data Exchange Point
    data-format-tailoring:
      abstract class tailoring ARElement: multiplicity-restriction={severity=INFO, lower-multiplicity=0, upper-multiplicity-infinite=true}
        class content conditional Invariant
      abstract class tailoring ARObject: multiplicity-restriction={severity=INFO, lower-multiplicity=0, upper-multiplicity-infinite=true}
        class content conditional Invariant
          primitive attribute tailoring checksum: in-scope=false, multiplicity-restriction={severity=ERROR, lower-multiplicity=0, upper-multiplicity=1}, default-value-handling=NO-DEFAULT
          primitive attribute tailoring timestamp: in-scope=false, multiplicity-restriction={severity=ERROR, lower-multiplicity=0, upper-multiplicity=1}, default-value-handling=NO-DEFAULT
      concrete class tailoring ARPackage: in-scope=false, multiplicity-restriction={severity=INFO, lower-multiplicity=0, upper-multiplicity-infinite=true}, validation-root=false
        class content conditional Invariant
          attribute-tailorings:
            aggregation tailoring arPackage: in-scope=false, multiplicity-restriction={severity=ERROR, lower-multiplicity=0, upper-multiplicity-infinite=true}, variation-restriction={severity=ERROR, variation=true, valid-binding-times=[BLUEPRINT-DERIVATION-TIME, SYSTEM-DESIGN-TIME, CODE-GENERATION-TIME, PRE-COMPILE-TIME, LINK-TIME, POST-BUILD]}
            aggregation tailoring element: in-scope=false, multiplicity-restriction={severity=ERROR, lower-multiplicity=0, upper-multiplicity-infinite=true}, variation-restriction={severity=ERROR, variation=true, valid-binding-times=[BLUEPRINT-DERIVATION-TIME, SYSTEM-DESIGN-TIME, CODE-GENERATION-TIME, PRE-COMPILE-TIME, LINK-TIME, POST-BUILD]}
            aggregation tailoring referenceBase: in-scope=false, multiplicity-restriction={severity=ERROR, lower-multiplicity=0, upper-multiplicity-infinite=true}
      concrete class tailoring AUTOSAR: in-scope=false, multiplicity-restriction={severity=INFO, lower-multiplicity=0, upper-multiplicity-infinite=true}, validation-root=false
        class content conditional Invariant
          attribute-tailorings:
            aggregation tailoring adminData: in-scope=false, multiplicity-restriction={severity=ERROR, lower-multiplicity=0, upper-multiplicity=1}
            aggregation tailoring arPackage: in-scope=false, multiplicity-restriction={severity=ERROR, lower-multiplicity=0, upper-multiplicity-infinite=true}, variation-restriction={severity=ERROR, variation=true, valid-binding-times=[BLUEPRINT-DERIVATION-TIME, SYSTEM-DESIGN-TIME, CODE-GENERATION-TIME, PRE-COMPILE-TIME, LINK-TIME, POST-BUILD]}
            aggregation tailoring introduction: in-scope=false, multiplicity-restriction={severity=ERROR, lower-multiplicity=0, upper-multiplicity=1}
      concrete class tailoring AbsoluteTolerance: in-scope=false, multiplicity-restriction={severity=INFO, lower-multiplicity=0, upper-multiplicity-infinite=true}, validation-root=false
        class content conditional Invariant
          primitive attribute tailoring absolute: in-scope=false, multiplicity-restriction={severity=ERROR, lower-multiplicity=0, upper-multiplicity=1}, default-value-handling=NO-DEFAULT
      6 x abstract class tailoring, all with multiplicity-restriction={severity=INFO, lower-multiplicity=0, upper-multiplicity-infinite=true}:
        AbstractCanCluster
          class content conditional Invariant
        AbstractCanCommunicationConnector
          class content conditional Invariant
        AbstractCanCommunicationController
          class content conditional Invariant
            attribute-tailorings:
              aggregation tailoring canControllerAttributes: in-scope=false, multiplicity-restriction={severity=ERROR, lower-multiplicity=0, upper-multiplicity=1}
        AbstractCanCommunicationControllerAttributes
          class content conditional Invariant
        AbstractCanPhysicalChannel
          class content conditional Invariant
        AbstractNumericalVariationPoint
          class content conditional Invariant
      9 x concrete class tailoring, all with in-scope=false, multiplicity-restriction={severity=INFO, lower-multiplicity=0, upper-multiplicity-infinite=true}, validation-root=false:
        AdminData
          class content conditional Invariant
            attribute-tailorings:
              aggregation tailoring docRevision: in-scope=false, multiplicity-restriction={severity=ERROR, lower-multiplicity=0, upper-multiplicity-infinite=true}
              primitive attribute tailoring language: in-scope=false, multiplicity-restriction={severity=ERROR, lower-multiplicity=0, upper-multiplicity=1}, default-value-handling=NO-DEFAULT
              aggregation tailoring sdg: in-scope=false, multiplicity-restriction={severity=ERROR, lower-multiplicity=0, upper-multiplicity-infinite=true}
              aggregation tailoring usedLanguages: in-scope=false, multiplicity-restriction={severity=ERROR, lower-multiplicity=0, upper-multiplicity=1}
        AgeConstraint
          class content conditional Invariant
            attribute-tailorings:
              aggregation tailoring maximum: in-scope=false, multiplicity-restriction={severity=ERROR, lower-multiplicity=0, upper-multiplicity=1}
              aggregation tailoring minimum: in-scope=false, multiplicity-restriction={severity=ERROR, lower-multiplicity=0, upper-multiplicity=1}
              reference tailoring scope: in-scope=false, multiplicity-restriction={severity=ERROR, lower-multiplicity=0, upper-multiplicity=1}, unresolved-reference-restriction=severity=ERROR
        AliasNameAssignment
          class content conditional Invariant
            attribute-tailorings:
              reference tailoring flatInstance: in-scope=false, multiplicity-restriction={severity=ERROR, lower-multiplicity=0, upper-multiplicity=1}, unresolved-reference-restriction=severity=ERROR
              reference tailoring identifiable: in-scope=false, multiplicity-restriction={severity=ERROR, lower-multiplicity=0, upper-multiplicity=1}, unresolved-reference-restriction=severity=ERROR
              aggregation tailoring label: in-scope=false, multiplicity-restriction={severity=ERROR, lower-multiplicity=0, upper-multiplicity=1}
              primitive attribute tailoring shortLabel: in-scope=false, multiplicity-restriction={severity=ERROR, lower-multiplicity=0, upper-multiplicity=1}, default-value-handling=NO-DEFAULT
        AliasNameSet
          class content conditional Invariant
            attribute-tailorings:
              aggregation tailoring aliasName: in-scope=false, multiplicity-restriction={severity=ERROR, lower-multiplicity=0, upper-multiplicity-infinite=true}, variation-restriction={severity=ERROR, variation=true, valid-binding-times=[BLUEPRINT-DERIVATION-TIME, SYSTEM-DESIGN-TIME, CODE-GENERATION-TIME, PRE-COMPILE-TIME, LINK-TIME, POST-BUILD]}
        AnalyzedExecutionTime
          class content conditional Invariant
            attribute-tailorings:
              aggregation tailoring bestCaseExecutionTime: in-scope=false, multiplicity-restriction={severity=ERROR, lower-multiplicity=0, upper-multiplicity=1}
              aggregation tailoring worstCaseExecutionTime: in-scope=false, multiplicity-restriction={severity=ERROR, lower-multiplicity=0, upper-multiplicity=1}
        Annotation
          class content conditional Invariant
        AnyInstanceRef
          class content conditional Invariant
            attribute-tailorings:
              reference tailoring contextElement: in-scope=false, multiplicity-restriction={severity=ERROR, lower-multiplicity=0, upper-multiplicity-infinite=true}, unresolved-reference-restriction=severity=ERROR
              reference tailoring target: in-scope=false, multiplicity-restriction={severity=ERROR, lower-multiplicity=0, upper-multiplicity=1}, unresolved-reference-restriction=severity=ERROR
        ApplicationArrayDataType
          class content conditional Invariant
            attribute-tailorings:
              aggregation tailoring element: in-scope=false, multiplicity-restriction={severity=ERROR, lower-multiplicity=0, upper-multiplicity=1}
        ApplicationArrayElement
          class content conditional Invariant
            primitive attribute tailoring arraySizeSemantics: in-scope=false, multiplicity-restriction={severity=ERROR, lower-multiplicity=0, upper-multiplicity=1}, default-value-handling=NO-DEFAULT
            primitive attribute tailoring maxNumberOfElements: in-scope=false, multiplicity-restriction={severity=ERROR, lower-multiplicity=0, upper-multiplicity=1}, variation-restriction={severity=ERROR, variation=true, valid-binding-times=[BLUEPRINT-DERIVATION-TIME, SYSTEM-DESIGN-TIME, CODE-GENERATION-TIME, PRE-COMPILE-TIME, LINK-TIME, POST-BUILD]}, default-value-handling=NO-DEFAULT
      abstract class tailoring ApplicationCompositeDataType: multiplicity-restriction={severity=INFO, lower-multiplicity=0, upper-multiplicity-infinite=true}
        class content conditional Invariant
      concrete class tailoring ApplicationCompositeDataTypeSubElementRef: in-scope=false, multiplicity-restriction={severity=INFO, lower-multiplicity=0, upper-multiplicity-infinite=true}, validation-root=false
        class content conditional Invariant
          attribute-tailorings:
            aggregation tailoring applicationCompositeElement: in-scope=false, multiplicity-restriction={severity=ERROR, lower-multiplicity=0, upper-multiplicity=1}
      abstract class tailoring ApplicationCompositeElementDataPrototype: multiplicity-restriction={severity=INFO, lower-multiplicity=0, upper-multiplicity-infinite=true}
        class content conditional Invariant
          attribute-tailorings:
            reference tailoring type: in-scope=false, multiplicity-restriction={severity=ERROR, lower-multiplicity=0, upper-multiplicity=1}, unresolved-reference-restriction=severity=ERROR
      concrete class tailoring ApplicationCompositeElementInPortInterfaceInstanceRef: in-scope=false, multiplicity-restriction={severity=INFO, lower-multiplicity=0, upper-multiplicity-infinite=true}, validation-root=false
        class content conditional Invariant
          attribute-tailorings:
            reference tailoring contextDataPrototype: in-scope=false, multiplicity-restriction={severity=ERROR, lower-multiplicity=0, upper-multiplicity-infinite=true}, unresolved-reference-restriction=severity=ERROR
            reference tailoring rootDataPrototype: in-scope=false, multiplicity-restriction={severity=ERROR, lower-multiplicity=0, upper-multiplicity=1}, unresolved-reference-restriction=severity=ERROR
            reference tailoring targetDataPrototype: in-scope=false, multiplicity-restriction={severity=ERROR, lower-multiplicity=0, upper-multiplicity=1}, unresolved-reference-restriction=severity=ERROR
      abstract class tailoring ApplicationDataType: multiplicity-restriction={severity=INFO, lower-multiplicity=0, upper-multiplicity-infinite=true}
        class content conditional Invariant
      20 x concrete class tailoring, all with in-scope=false, multiplicity-restriction={severity=INFO, lower-multiplicity=0, upper-multiplicity-infinite=true}, validation-root=false:
        ApplicationEntry
          class content conditional Invariant
            attribute-tailorings:
              reference tailoring frameTriggering: in-scope=false, multiplicity-restriction={severity=ERROR, lower-multiplicity=0, upper-multiplicity=1}, unresolved-reference-restriction=severity=ERROR
        ApplicationError
          class content conditional Invariant
            primitive attribute tailoring errorCode: in-scope=false, multiplicity-restriction={severity=ERROR, lower-multiplicity=0, upper-multiplicity=1}, default-value-handling=NO-DEFAULT
        ApplicationErrorMapping
          class content conditional Invariant
            attribute-tailorings:
              reference tailoring systemSignal: in-scope=false, multiplicity-restriction={severity=ERROR, lower-multiplicity=0, upper-multiplicity=1}, unresolved-reference-restriction=severity=ERROR
        ApplicationPrimitiveDataType
          class content conditional Invariant
        ApplicationRecordDataType
          class content conditional Invariant
            attribute-tailorings:
              aggregation tailoring element: in-scope=false, multiplicity-restriction={severity=ERROR, lower-multiplicity=0, upper-multiplicity-infinite=true}, variation-restriction={severity=ERROR, variation=true, valid-binding-times=[BLUEPRINT-DERIVATION-TIME, SYSTEM-DESIGN-TIME, CODE-GENERATION-TIME, PRE-COMPILE-TIME, LINK-TIME, POST-BUILD]}
        ApplicationRecordElement
          class content conditional Invariant
        ApplicationSwComponentType
          class content conditional Invariant
        ApplicationValueSpecification
          class content conditional Invariant
            attribute-tailorings:
              aggregation tailoring SwValueCont: in-scope=false, multiplicity-restriction={severity=ERROR, lower-multiplicity=0, upper-multiplicity=1}
              primitive attribute tailoring category: in-scope=false, multiplicity-restriction={severity=ERROR, lower-multiplicity=0, upper-multiplicity=1}, default-value-handling=NO-DEFAULT
                sub-attribute-tailorings:
                  primitive attribute tailoring namePattern: in-scope=false, multiplicity-restriction={severity=ERROR, lower-multiplicity=0, upper-multiplicity=1}, default-value-handling=NO-DEFAULT
              aggregation tailoring swAxisCont: in-scope=false, multiplicity-restriction={severity=ERROR, lower-multiplicity=0, upper-multiplicity-infinite=true}
        ArVariableInImplementationDataInstanceRef
          class content conditional Invariant
            attribute-tailorings:
              4 x reference tailoring, all with in-scope=false, unresolved-reference-restriction=severity=ERROR:
                contextDataPrototype: multiplicity-restriction={severity=ERROR, lower-multiplicity=0, upper-multiplicity-infinite=true}
                portPrototype: multiplicity-restriction={severity=ERROR, lower-multiplicity=0, upper-multiplicity=1}
                rootVariableDataPrototype: multiplicity-restriction={severity=ERROR, lower-multiplicity=0, upper-multiplicity=1}
                targetDataPrototype: multiplicity-restriction={severity=ERROR, lower-multiplicity=0, upper-multiplicity=1}
        ArbitraryEventTriggering
          class content conditional Invariant
            attribute-tailorings:
              aggregation tailoring confidenceInterval: in-scope=false, multiplicity-restriction={severity=ERROR, lower-multiplicity=0, upper-multiplicity-infinite=true}
              aggregation tailoring maximumDistance: in-scope=false, multiplicity-restriction={severity=ERROR, lower-multiplicity=0, upper-multiplicity-infinite=true}
              aggregation tailoring minimumDistance: in-scope=false, multiplicity-restriction={severity=ERROR, lower-multiplicity=0, upper-multiplicity-infinite=true}
        Area
          class content conditional Invariant
            22 x primitive attribute tailoring, all with in-scope=false, multiplicity-restriction={severity=ERROR, lower-multiplicity=0, upper-multiplicity=1}, default-value-handling=NO-DEFAULT:
              accesskey
              alt
              class
              coords
              href
              nohref
              onblur
              onclick
              ondblclick
              onfocus
              onkeydown
              onkeypress
              onkeyup
              onmousedown
              onmousemove
              onmouseout
              onmouseover
              onmouseup
              shape
              style
              tabindex
              title
        ArgumentDataPrototype
          class content conditional Invariant
            primitive attribute tailoring direction: in-scope=false, multiplicity-restriction={severity=ERROR, lower-multiplicity=0, upper-multiplicity=1}, default-value-handling=NO-DEFAULT
            primitive attribute tailoring serverArgumentImplPolicy: in-scope=false, multiplicity-restriction={severity=ERROR, lower-multiplicity=0, upper-multiplicity=1}, default-value-handling=NO-DEFAULT
        ArrayValueSpecification
          class content conditional Invariant
            attribute-tailorings:
              aggregation tailoring element: in-scope=false, multiplicity-restriction={severity=ERROR, lower-multiplicity=0, upper-multiplicity-infinite=true}, variation-restriction={severity=ERROR, variation=true, valid-binding-times=[BLUEPRINT-DERIVATION-TIME, SYSTEM-DESIGN-TIME, CODE-GENERATION-TIME, PRE-COMPILE-TIME, LINK-TIME, POST-BUILD]}
        AssemblySwConnector
          class content conditional Invariant
            attribute-tailorings:
              aggregation tailoring provider: in-scope=false, multiplicity-restriction={severity=ERROR, lower-multiplicity=0, upper-multiplicity=1}
              aggregation tailoring requester: in-scope=false, multiplicity-restriction={severity=ERROR, lower-multiplicity=0, upper-multiplicity=1}
        AssignFrameId
          class content conditional Invariant
            attribute-tailorings:
              reference tailoring assignedFrameTriggering: in-scope=false, multiplicity-restriction={severity=ERROR, lower-multiplicity=0, upper-multiplicity=1}, unresolved-reference-restriction=severity=ERROR
        AssignFrameIdRange
          class content conditional Invariant
            attribute-tailorings:
              aggregation tailoring framePid: in-scope=false, multiplicity-restriction={severity=ERROR, lower-multiplicity=0, upper-multiplicity=4}
              primitive attribute tailoring startIndex: in-scope=false, multiplicity-restriction={severity=ERROR, lower-multiplicity=0, upper-multiplicity=1}, default-value-handling=NO-DEFAULT
        AssignNad
          class content conditional Invariant
            primitive attribute tailoring newNad: in-scope=false, multiplicity-restriction={severity=ERROR, lower-multiplicity=0, upper-multiplicity=1}, default-value-handling=NO-DEFAULT
        AsynchronousServerCallPoint
          class content conditional Invariant
        AsynchronousServerCallResultPoint
          class content conditional Invariant
            attribute-tailorings:
              reference tailoring asynchronousServerCallPoint: in-scope=false, multiplicity-restriction={severity=ERROR, lower-multiplicity=0, upper-multiplicity=1}, unresolved-reference-restriction=severity=ERROR
        AsynchronousServerCallReturnsEvent
          class content conditional Invariant
            attribute-tailorings:
              reference tailoring eventSource: in-scope=false, multiplicity-restriction={severity=ERROR, lower-multiplicity=0, upper-multiplicity=1}, unresolved-reference-restriction=severity=ERROR
      13 x abstract class tailoring, all with multiplicity-restriction={severity=INFO, lower-multiplicity=0, upper-multiplicity-infinite=true}:
        AtomicSwComponentType
          class content conditional Invariant
            attribute-tailorings:
              aggregation tailoring internalBehavior: in-scope=false, multiplicity-restriction={severity=ERROR, lower-multiplicity=0, upper-multiplicity=1}, variation-restriction={severity=ERROR, variation=true, valid-binding-times=[BLUEPRINT-DERIVATION-TIME, SYSTEM-DESIGN-TIME, CODE-GENERATION-TIME, PRE-COMPILE-TIME, LINK-TIME, POST-BUILD]}
              aggregation tailoring symbolProps: in-scope=false, multiplicity-restriction={severity=ERROR, lower-multiplicity=0, upper-multiplicity=1}
        AtpBlueprint
          class content conditional Invariant
            primitive attribute tailoring shortNamePattern: in-scope=false, multiplicity-restriction={severity=WARNING, lower-multiplicity=0, upper-multiplicity=0}, default-value-handling=NO-DEFAULT  # Spec element has lifecycle state 'obsolete'.
        AtpBlueprintMapping
          class content conditional Invariant
        AtpBlueprintable
          class content conditional Invariant
        AtpClassifier
          class content conditional Invariant
        AtpFeature
          class content conditional Invariant
        AtpInstanceRef
          class content conditional Invariant
        AtpPrototype
          class content conditional Invariant
        AtpStructureElement
          class content conditional Invariant
        AtpType
          class content conditional Invariant
        AttributeValueVariationPoint
          class content conditional Invariant
            4 x primitive attribute tailoring, all with in-scope=false, multiplicity-restriction={severity=ERROR, lower-multiplicity=0, upper-multiplicity=1}, default-value-handling=NO-DEFAULT:
              bindingTime
              blueprintValue
              sd
              shortLabel
                sub-attribute-tailorings:
                  primitive attribute tailoring namePattern: in-scope=false, multiplicity-restriction={severity=ERROR, lower-multiplicity=0, upper-multiplicity=1}, default-value-handling=NO-DEFAULT
        AutosarDataPrototype
          class content conditional Invariant
            attribute-tailorings:
              reference tailoring type: in-scope=false, multiplicity-restriction={severity=ERROR, lower-multiplicity=0, upper-multiplicity=1}, unresolved-reference-restriction=severity=ERROR
        AutosarDataType
          class content conditional Invariant
            attribute-tailorings:
              aggregation tailoring swDataDefProps: in-scope=false, multiplicity-restriction={severity=ERROR, lower-multiplicity=0, upper-multiplicity=1}
      6 x concrete class tailoring, all with in-scope=false, multiplicity-restriction={severity=INFO, lower-multiplicity=0, upper-multiplicity-infinite=true}, validation-root=false:
        AutosarEngineeringObject
          class content conditional Invariant
        AutosarOperationArgumentInstance
          class content conditional Invariant
            attribute-tailorings:
              aggregation tailoring operationArgumentInstance: in-scope=false, multiplicity-restriction={severity=ERROR, lower-multiplicity=0, upper-multiplicity=1}
        AutosarParameterRef
          class content conditional Invariant
            attribute-tailorings:
              aggregation tailoring autosarParameter: in-scope=false, multiplicity-restriction={severity=ERROR, lower-multiplicity=0, upper-multiplicity=1}
              reference tailoring localParameter: in-scope=false, multiplicity-restriction={severity=ERROR, lower-multiplicity=0, upper-multiplicity=1}, unresolved-reference-restriction=severity=ERROR
        AutosarVariableInstance
          class content conditional Invariant
            attribute-tailorings:
              aggregation tailoring variableInstance: in-scope=false, multiplicity-restriction={severity=ERROR, lower-multiplicity=0, upper-multiplicity=1}
        AutosarVariableRef
          class content conditional Invariant
            attribute-tailorings:
              aggregation tailoring autosarVariable: in-scope=false, multiplicity-restriction={severity=ERROR, lower-multiplicity=0, upper-multiplicity=1}
              aggregation tailoring autosarVariableInImplDatatype: in-scope=false, multiplicity-restriction={severity=ERROR, lower-multiplicity=0, upper-multiplicity=1}
              reference tailoring localVariable: in-scope=false, multiplicity-restriction={severity=ERROR, lower-multiplicity=0, upper-multiplicity=1}, unresolved-reference-restriction=severity=ERROR
        BackgroundEvent
          class content conditional Invariant
      abstract class tailoring BaseType: multiplicity-restriction={severity=INFO, lower-multiplicity=0, upper-multiplicity-infinite=true}
        class content conditional Invariant
          attribute-tailorings:
            aggregation tailoring baseTypeDefinition: in-scope=false, multiplicity-restriction={severity=ERROR, lower-multiplicity=0, upper-multiplicity=1}
      concrete class tailoring BaseTypeAbsSize: in-scope=false, multiplicity-restriction={severity=INFO, lower-multiplicity=0, upper-multiplicity-infinite=true}, validation-root=false
        class content conditional Invariant
          primitive attribute tailoring baseTypeSize: in-scope=false, multiplicity-restriction={severity=ERROR, lower-multiplicity=0, upper-multiplicity=1}, default-value-handling=NO-DEFAULT
      abstract class tailoring BaseTypeDefinition: multiplicity-restriction={severity=INFO, lower-multiplicity=0, upper-multiplicity-infinite=true}
        class content conditional Invariant
      concrete class tailoring BaseTypeDirectDefinition: in-scope=false, multiplicity-restriction={severity=INFO, lower-multiplicity=0, upper-multiplicity-infinite=true}, validation-root=false
        class content conditional Invariant
          attribute-tailorings:
            primitive attribute tailoring baseTypeEncoding: in-scope=false, multiplicity-restriction={severity=ERROR, lower-multiplicity=0, upper-multiplicity=1}, default-value-handling=NO-DEFAULT
            aggregation tailoring baseTypeSizeDefintionType: in-scope=false, multiplicity-restriction={severity=ERROR, lower-multiplicity=0, upper-multiplicity=1}
            primitive attribute tailoring byteOrder: in-scope=false, multiplicity-restriction={severity=ERROR, lower-multiplicity=0, upper-multiplicity=1}, default-value-handling=NO-DEFAULT
            primitive attribute tailoring memAlignment: in-scope=false, multiplicity-restriction={severity=ERROR, lower-multiplicity=0, upper-multiplicity=1}, default-value-handling=NO-DEFAULT
            primitive attribute tailoring nativeDeclaration: in-scope=false, multiplicity-restriction={severity=ERROR, lower-multiplicity=0, upper-multiplicity=1}, default-value-handling=NO-DEFAULT
      concrete class tailoring BaseTypeMaxSize: in-scope=false, multiplicity-restriction={severity=INFO, lower-multiplicity=0, upper-multiplicity-infinite=true}, validation-root=false
        class content conditional Invariant
          primitive attribute tailoring maxBaseTypeSize: in-scope=false, multiplicity-restriction={severity=ERROR, lower-multiplicity=0, upper-multiplicity=1}, default-value-handling=NO-DEFAULT
      abstract class tailoring BaseTypeSizeDefinition: multiplicity-restriction={severity=INFO, lower-multiplicity=0, upper-multiplicity-infinite=true}
        class content conditional Invariant
      7 x concrete class tailoring, all with in-scope=false, multiplicity-restriction={severity=INFO, lower-multiplicity=0, upper-multiplicity-infinite=true}, validation-root=false:
        BlueprintMapping
          class content conditional Invariant
            attribute-tailorings:
              reference tailoring blueprint: in-scope=false, multiplicity-restriction={severity=ERROR, lower-multiplicity=0, upper-multiplicity=1}, unresolved-reference-restriction=severity=ERROR
              reference tailoring derivedObject: in-scope=false, multiplicity-restriction={severity=ERROR, lower-multiplicity=0, upper-multiplicity=1}, unresolved-reference-restriction=severity=ERROR
        BlueprintMappingSet
          class content conditional Invariant
            attribute-tailorings:
              aggregation tailoring blueprintMap: in-scope=false, multiplicity-restriction={severity=ERROR, lower-multiplicity=0, upper-multiplicity-infinite=true}
        BooleanValueVariationPoint
          class content conditional Invariant
        Br
          class content conditional Invariant
        BswBackgroundEvent
          class content conditional Invariant
        BswCalledEntity
          class content conditional Invariant
        BswDebugInfo
          class content conditional Invariant
            attribute-tailorings:
              aggregation tailoring localDebugData: in-scope=false, multiplicity-restriction={severity=ERROR, lower-multiplicity=0, upper-multiplicity-infinite=true}
              reference tailoring parameterAccessedForDebug: in-scope=false, multiplicity-restriction={severity=ERROR, lower-multiplicity=0, upper-multiplicity-infinite=true}, unresolved-reference-restriction=severity=ERROR
              reference tailoring variableAccessedForDebug: in-scope=false, multiplicity-restriction={severity=ERROR, lower-multiplicity=0, upper-multiplicity-infinite=true}, unresolved-reference-restriction=severity=ERROR
      abstract class tailoring BswEvent: multiplicity-restriction={severity=INFO, lower-multiplicity=0, upper-multiplicity-infinite=true}
        class content conditional Invariant
          attribute-tailorings:
            aggregation tailoring disabledInMode: in-scope=false, multiplicity-restriction={severity=ERROR, lower-multiplicity=0, upper-multiplicity-infinite=true}
            reference tailoring startsOnEvent: in-scope=false, multiplicity-restriction={severity=ERROR, lower-multiplicity=0, upper-multiplicity=1}, unresolved-reference-restriction=severity=ERROR
      14 x concrete class tailoring, all with in-scope=false, multiplicity-restriction={severity=INFO, lower-multiplicity=0, upper-multiplicity-infinite=true}, validation-root=false:
        BswExternalTriggerOccurredEvent
          class content conditional Invariant
            attribute-tailorings:
              reference tailoring trigger: in-scope=false, multiplicity-restriction={severity=ERROR, lower-multiplicity=0, upper-multiplicity=1}, unresolved-reference-restriction=severity=ERROR
        BswImplementation
          class content conditional Invariant
            attribute-tailorings:
              primitive attribute tailoring arReleaseVersion: in-scope=false, multiplicity-restriction={severity=ERROR, lower-multiplicity=0, upper-multiplicity=1}, default-value-handling=NO-DEFAULT
              reference tailoring behavior: in-scope=false, multiplicity-restriction={severity=ERROR, lower-multiplicity=0, upper-multiplicity=1}, unresolved-reference-restriction=severity=ERROR
              aggregation tailoring debugInfo: in-scope=false, multiplicity-restriction={severity=ERROR, lower-multiplicity=0, upper-multiplicity=1}, variation-restriction={severity=ERROR, variation=true, valid-binding-times=[BLUEPRINT-DERIVATION-TIME, SYSTEM-DESIGN-TIME, CODE-GENERATION-TIME, PRE-COMPILE-TIME, LINK-TIME, POST-BUILD]}
              reference tailoring preconfiguredConfiguration: in-scope=false, multiplicity-restriction={severity=ERROR, lower-multiplicity=0, upper-multiplicity-infinite=true}, unresolved-reference-restriction=severity=ERROR
              reference tailoring recommendedConfiguration: in-scope=false, multiplicity-restriction={severity=ERROR, lower-multiplicity=0, upper-multiplicity-infinite=true}, unresolved-reference-restriction=severity=ERROR
              primitive attribute tailoring vendorApiInfix: in-scope=false, multiplicity-restriction={severity=ERROR, lower-multiplicity=0, upper-multiplicity=1}, default-value-handling=NO-DEFAULT
                sub-attribute-tailorings:
                  primitive attribute tailoring namePattern: in-scope=false, multiplicity-restriction={severity=ERROR, lower-multiplicity=0, upper-multiplicity=1}, default-value-handling=NO-DEFAULT
              reference tailoring vendorSpecificModuleDef: in-scope=false, multiplicity-restriction={severity=ERROR, lower-multiplicity=0, upper-multiplicity-infinite=true}, unresolved-reference-restriction=severity=ERROR
        BswInternalBehavior
          class content conditional Invariant
            attribute-tailorings:
              9 x aggregation tailoring, all with in-scope=false, multiplicity-restriction={severity=ERROR, lower-multiplicity=0, upper-multiplicity-infinite=true}, variation-restriction={severity=ERROR, variation=true, valid-binding-times=[BLUEPRINT-DERIVATION-TIME, SYSTEM-DESIGN-TIME, CODE-GENERATION-TIME, PRE-COMPILE-TIME, LINK-TIME, POST-BUILD]}:
                entity
                event
                internalTriggeringPoint
                modeReceiverPolicy
                modeSenderPolicy
                perInstanceParameter
                schedulerNamePrefix
                serviceDependency
                triggerDirectImplementation
        BswInternalTriggerOccurredEvent
          class content conditional Invariant
            attribute-tailorings:
              reference tailoring eventSource: in-scope=false, multiplicity-restriction={severity=ERROR, lower-multiplicity=0, upper-multiplicity=1}, unresolved-reference-restriction=severity=ERROR
        BswInternalTriggeringPoint
          class content conditional Invariant
            primitive attribute tailoring swImplPolicy: in-scope=false, multiplicity-restriction={severity=ERROR, lower-multiplicity=0, upper-multiplicity=1}, default-value-handling=NO-DEFAULT
        BswInterruptEntity
          class content conditional Invariant
            primitive attribute tailoring interruptCategory: in-scope=false, multiplicity-restriction={severity=ERROR, lower-multiplicity=0, upper-multiplicity=1}, default-value-handling=NO-DEFAULT
            primitive attribute tailoring interruptSource: in-scope=false, multiplicity-restriction={severity=ERROR, lower-multiplicity=0, upper-multiplicity=1}, default-value-handling=NO-DEFAULT
        BswMgrNeeds
          class content conditional Invariant
        BswModeReceiverPolicy
          class content conditional Invariant
            attribute-tailorings:
              primitive attribute tailoring enhancedModeApi: in-scope=false, multiplicity-restriction={severity=ERROR, lower-multiplicity=0, upper-multiplicity=1}, default-value-handling=NO-DEFAULT
              reference tailoring requiredModeGroup: in-scope=false, multiplicity-restriction={severity=ERROR, lower-multiplicity=0, upper-multiplicity=1}, unresolved-reference-restriction=severity=ERROR
              primitive attribute tailoring supportsAsynchronousModeSwitch: in-scope=false, multiplicity-restriction={severity=ERROR, lower-multiplicity=0, upper-multiplicity=1}, default-value-handling=NO-DEFAULT
        BswModeSenderPolicy
          class content conditional Invariant
            attribute-tailorings:
              aggregation tailoring ackRequest: in-scope=false, multiplicity-restriction={severity=ERROR, lower-multiplicity=0, upper-multiplicity=1}
              primitive attribute tailoring enhancedModeApi: in-scope=false, multiplicity-restriction={severity=ERROR, lower-multiplicity=0, upper-multiplicity=1}, default-value-handling=NO-DEFAULT
              reference tailoring providedModeGroup: in-scope=false, multiplicity-restriction={severity=ERROR, lower-multiplicity=0, upper-multiplicity=1}, unresolved-reference-restriction=severity=ERROR
              primitive attribute tailoring queueLength: in-scope=false, multiplicity-restriction={severity=ERROR, lower-multiplicity=0, upper-multiplicity=1}, default-value-handling=NO-DEFAULT
        BswModeSwitchAckRequest
          class content conditional Invariant
            primitive attribute tailoring timeout: in-scope=false, multiplicity-restriction={severity=ERROR, lower-multiplicity=0, upper-multiplicity=1}, default-value-handling=NO-DEFAULT
        BswModeSwitchEvent
          class content conditional Invariant
            attribute-tailorings:
              primitive attribute tailoring activation: in-scope=false, multiplicity-restriction={severity=ERROR, lower-multiplicity=0, upper-multiplicity=1}, default-value-handling=NO-DEFAULT
              aggregation tailoring mode: in-scope=false, multiplicity-restriction={severity=ERROR, lower-multiplicity=0, upper-multiplicity=2}
        BswModeSwitchedAckEvent
          class content conditional Invariant
            attribute-tailorings:
              reference tailoring modeGroup: in-scope=false, multiplicity-restriction={severity=ERROR, lower-multiplicity=0, upper-multiplicity=1}, unresolved-reference-restriction=severity=ERROR
        BswModuleDependency
          class content conditional Invariant
            attribute-tailorings:
              reference tailoring expectedCallback: in-scope=false, multiplicity-restriction={severity=ERROR, lower-multiplicity=0, upper-multiplicity-infinite=true}, variation-restriction={severity=ERROR, variation=true, valid-binding-times=[BLUEPRINT-DERIVATION-TIME, SYSTEM-DESIGN-TIME, CODE-GENERATION-TIME, PRE-COMPILE-TIME, LINK-TIME, POST-BUILD]}, unresolved-reference-restriction=severity=ERROR
              reference tailoring requiredEntry: in-scope=false, multiplicity-restriction={severity=ERROR, lower-multiplicity=0, upper-multiplicity-infinite=true}, variation-restriction={severity=ERROR, variation=true, valid-binding-times=[BLUEPRINT-DERIVATION-TIME, SYSTEM-DESIGN-TIME, CODE-GENERATION-TIME, PRE-COMPILE-TIME, LINK-TIME, POST-BUILD]}, unresolved-reference-restriction=severity=ERROR
              aggregation tailoring serviceItem: in-scope=false, multiplicity-restriction={severity=WARNING, lower-multiplicity=0, upper-multiplicity=0}  # Spec element has lifecycle state 'obsolete'.
              primitive attribute tailoring targetModuleId: in-scope=false, multiplicity-restriction={severity=ERROR, lower-multiplicity=0, upper-multiplicity=1}, default-value-handling=NO-DEFAULT
        BswModuleDescription
          class content conditional Invariant
            attribute-tailorings:
              aggregation tailoring bswModuleDependency: in-scope=false, multiplicity-restriction={severity=ERROR, lower-multiplicity=0, upper-multiplicity-infinite=true}, variation-restriction={severity=ERROR, variation=true, valid-binding-times=[BLUEPRINT-DERIVATION-TIME, SYSTEM-DESIGN-TIME, CODE-GENERATION-TIME, PRE-COMPILE-TIME, LINK-TIME, POST-BUILD]}
              aggregation tailoring bswModuleDocumentation: in-scope=false, multiplicity-restriction={severity=ERROR, lower-multiplicity=0, upper-multiplicity=1}, variation-restriction={severity=ERROR, variation=true, valid-binding-times=[BLUEPRINT-DERIVATION-TIME, SYSTEM-DESIGN-TIME, CODE-GENERATION-TIME, PRE-COMPILE-TIME, LINK-TIME, POST-BUILD]}
              aggregation tailoring internalBehavior: in-scope=false, multiplicity-restriction={severity=ERROR, lower-multiplicity=0, upper-multiplicity-infinite=true}
              primitive attribute tailoring moduleId: in-scope=false, multiplicity-restriction={severity=ERROR, lower-multiplicity=0, upper-multiplicity=1}, default-value-handling=NO-DEFAULT
              reference tailoring outgoingCallback: in-scope=false, multiplicity-restriction={severity=ERROR, lower-multiplicity=0, upper-multiplicity-infinite=true}, variation-restriction={severity=ERROR, variation=true, valid-binding-times=[BLUEPRINT-DERIVATION-TIME, SYSTEM-DESIGN-TIME, CODE-GENERATION-TIME, PRE-COMPILE-TIME, LINK-TIME, POST-BUILD]}, unresolved-reference-restriction=severity=ERROR
              reference tailoring providedEntry: in-scope=false, multiplicity-restriction={severity=ERROR, lower-multiplicity=0, upper-multiplicity-infinite=true}, variation-restriction={severity=ERROR, variation=true, valid-binding-times=[BLUEPRINT-DERIVATION-TIME, SYSTEM-DESIGN-TIME, CODE-GENERATION-TIME, PRE-COMPILE-TIME, LINK-TIME, POST-BUILD]}, unresolved-reference-restriction=severity=ERROR
              4 x aggregation tailoring, all with in-scope=false, multiplicity-restriction={severity=ERROR, lower-multiplicity=0, upper-multiplicity-infinite=true}, variation-restriction={severity=ERROR, variation=true, valid-binding-times=[BLUEPRINT-DERIVATION-TIME, SYSTEM-DESIGN-TIME, CODE-GENERATION-TIME, PRE-COMPILE-TIME, LINK-TIME, POST-BUILD]}:
                providedModeGroup
                releasedTrigger
                requiredModeGroup
                requiredTrigger
      abstract class tailoring BswModuleEntity: multiplicity-restriction={severity=INFO, lower-multiplicity=0, upper-multiplicity-infinite=true}
        class content conditional Invariant
          attribute-tailorings:
            7 x reference tailoring, all with in-scope=false, unresolved-reference-restriction=severity=ERROR:
              accessedModeGroup: multiplicity-restriction={severity=ERROR, lower-multiplicity=0, upper-multiplicity-infinite=true}, variation-restriction={severity=ERROR, variation=true, valid-binding-times=[BLUEPRINT-DERIVATION-TIME, SYSTEM-DESIGN-TIME, CODE-GENERATION-TIME, PRE-COMPILE-TIME, LINK-TIME, POST-BUILD]}
              activationPoint: multiplicity-restriction={severity=ERROR, lower-multiplicity=0, upper-multiplicity-infinite=true}, variation-restriction={severity=ERROR, variation=true, valid-binding-times=[BLUEPRINT-DERIVATION-TIME, SYSTEM-DESIGN-TIME, CODE-GENERATION-TIME, PRE-COMPILE-TIME, LINK-TIME, POST-BUILD]}
              calledEntry: multiplicity-restriction={severity=ERROR, lower-multiplicity=0, upper-multiplicity-infinite=true}, variation-restriction={severity=ERROR, variation=true, valid-binding-times=[BLUEPRINT-DERIVATION-TIME, SYSTEM-DESIGN-TIME, CODE-GENERATION-TIME, PRE-COMPILE-TIME, LINK-TIME, POST-BUILD]}
              implementedEntry: multiplicity-restriction={severity=ERROR, lower-multiplicity=0, upper-multiplicity=1}
              issuedTrigger: multiplicity-restriction={severity=ERROR, lower-multiplicity=0, upper-multiplicity-infinite=true}, variation-restriction={severity=ERROR, variation=true, valid-binding-times=[BLUEPRINT-DERIVATION-TIME, SYSTEM-DESIGN-TIME, CODE-GENERATION-TIME, PRE-COMPILE-TIME, LINK-TIME, POST-BUILD]}
              managedModeGroup: multiplicity-restriction={severity=ERROR, lower-multiplicity=0, upper-multiplicity-infinite=true}, variation-restriction={severity=ERROR, variation=true, valid-binding-times=[BLUEPRINT-DERIVATION-TIME, SYSTEM-DESIGN-TIME, CODE-GENERATION-TIME, PRE-COMPILE-TIME, LINK-TIME, POST-BUILD]}
              schedulerNamePrefix: multiplicity-restriction={severity=ERROR, lower-multiplicity=0, upper-multiplicity=1}
      8 x concrete class tailoring, all with in-scope=false, multiplicity-restriction={severity=INFO, lower-multiplicity=0, upper-multiplicity-infinite=true}, validation-root=false:
        BswModuleEntry
          class content conditional Invariant
            attribute-tailorings:
              aggregation tailoring argument: in-scope=false, multiplicity-restriction={severity=ERROR, lower-multiplicity=0, upper-multiplicity-infinite=true}
              4 x primitive attribute tailoring, all with in-scope=false, multiplicity-restriction={severity=ERROR, lower-multiplicity=0, upper-multiplicity=1}, default-value-handling=NO-DEFAULT:
                callType
                executionContext
                isReentrant
                isSynchronous
              aggregation tailoring returnType: in-scope=false, multiplicity-restriction={severity=ERROR, lower-multiplicity=0, upper-multiplicity=1}
              primitive attribute tailoring role: in-scope=false, multiplicity-restriction={severity=ERROR, lower-multiplicity=0, upper-multiplicity=1}, default-value-handling=NO-DEFAULT
                sub-attribute-tailorings:
                  primitive attribute tailoring namePattern: in-scope=false, multiplicity-restriction={severity=ERROR, lower-multiplicity=0, upper-multiplicity=1}, default-value-handling=NO-DEFAULT
              primitive attribute tailoring serviceId: in-scope=false, multiplicity-restriction={severity=ERROR, lower-multiplicity=0, upper-multiplicity=1}, default-value-handling=NO-DEFAULT
              primitive attribute tailoring swServiceImplPolicy: in-scope=false, multiplicity-restriction={severity=ERROR, lower-multiplicity=0, upper-multiplicity=1}, default-value-handling=NO-DEFAULT
        BswModuleTiming
          class content conditional Invariant
            attribute-tailorings:
              reference tailoring behavior: in-scope=false, multiplicity-restriction={severity=ERROR, lower-multiplicity=0, upper-multiplicity=1}, unresolved-reference-restriction=severity=ERROR
        BswSchedulableEntity
          class content conditional Invariant
        BswSchedulerNamePrefix
          class content conditional Invariant
        BswServiceDependency
          class content conditional Invariant
            attribute-tailorings:
              aggregation tailoring assignedData: in-scope=false, multiplicity-restriction={severity=ERROR, lower-multiplicity=0, upper-multiplicity-infinite=true}
              aggregation tailoring assignedEntryRole: in-scope=false, multiplicity-restriction={severity=ERROR, lower-multiplicity=0, upper-multiplicity-infinite=true}
              aggregation tailoring serviceNeeds: in-scope=false, multiplicity-restriction={severity=ERROR, lower-multiplicity=0, upper-multiplicity=1}
        BswTimingEvent
          class content conditional Invariant
            primitive attribute tailoring period: in-scope=false, multiplicity-restriction={severity=ERROR, lower-multiplicity=0, upper-multiplicity=1}, default-value-handling=NO-DEFAULT
        BswTriggerDirectImplementation
          class content conditional Invariant
            attribute-tailorings:
              reference tailoring masteredTrigger: in-scope=false, multiplicity-restriction={severity=ERROR, lower-multiplicity=0, upper-multiplicity=1}, unresolved-reference-restriction=severity=ERROR
              primitive attribute tailoring task: in-scope=false, multiplicity-restriction={severity=ERROR, lower-multiplicity=0, upper-multiplicity=1}, default-value-handling=NO-DEFAULT
                sub-attribute-tailorings:
                  primitive attribute tailoring namePattern: in-scope=false, multiplicity-restriction={severity=ERROR, lower-multiplicity=0, upper-multiplicity=1}, default-value-handling=NO-DEFAULT
        BurstPatternEventTriggering
          class content conditional Invariant
            attribute-tailorings:
              primitive attribute tailoring maxNumberOfOccurrences: in-scope=false, multiplicity-restriction={severity=ERROR, lower-multiplicity=0, upper-multiplicity=1}, default-value-handling=NO-DEFAULT
              primitive attribute tailoring minNumberOfOccurrences: in-scope=false, multiplicity-restriction={severity=ERROR, lower-multiplicity=0, upper-multiplicity=1}, default-value-handling=NO-DEFAULT
              4 x aggregation tailoring, all with in-scope=false, multiplicity-restriction={severity=ERROR, lower-multiplicity=0, upper-multiplicity=1}:
                minimumInterArrivalTime
                patternJitter
                patternLength
                patternPeriod
      abstract class tailoring BusspecificNmEcu: multiplicity-restriction={severity=INFO, lower-multiplicity=0, upper-multiplicity-infinite=true}
        class content conditional Invariant
      31 x concrete class tailoring, all with in-scope=false, validation-root=false:
        CalibrationParameterValue: multiplicity-restriction={severity=INFO, lower-multiplicity=0, upper-multiplicity-infinite=true}
          class content conditional Invariant
            attribute-tailorings:
              aggregation tailoring applInitValue: in-scope=false, multiplicity-restriction={severity=ERROR, lower-multiplicity=0, upper-multiplicity=1}
              aggregation tailoring implInitValue: in-scope=false, multiplicity-restriction={severity=ERROR, lower-multiplicity=0, upper-multiplicity=1}
              reference tailoring initializedParameter: in-scope=false, multiplicity-restriction={severity=ERROR, lower-multiplicity=0, upper-multiplicity=1}, unresolved-reference-restriction=severity=ERROR
        CalibrationParameterValueSet: multiplicity-restriction={severity=INFO, lower-multiplicity=0, upper-multiplicity-infinite=true}
          class content conditional Invariant
            attribute-tailorings:
              aggregation tailoring calibrationParameterValue: in-scope=false, multiplicity-restriction={severity=ERROR, lower-multiplicity=0, upper-multiplicity-infinite=true}
        CanCluster: multiplicity-restriction={severity=INFO, lower-multiplicity=0, upper-multiplicity-infinite=true}
          class content conditional Invariant
        CanCommunicationConnector: multiplicity-restriction={severity=INFO, lower-multiplicity=0, upper-multiplicity-infinite=true}
          class content conditional Invariant
            5 x primitive attribute tailoring, all with in-scope=false, multiplicity-restriction={severity=ERROR, lower-multiplicity=0, upper-multiplicity=1}, default-value-handling=NO-DEFAULT:
              pncWakeupCanId
              pncWakeupCanIdExtended
              pncWakeupCanIdMask
              pncWakeupDataMask
              pncWakeupDlc
        CanCommunicationController: multiplicity-restriction={severity=INFO, lower-multiplicity=0, upper-multiplicity-infinite=true}
          class content conditional Invariant
        CanControllerConfiguration: multiplicity-restriction={severity=INFO, lower-multiplicity=0, upper-multiplicity-infinite=true}
          class content conditional Invariant
            primitive attribute tailoring syncJumpWidth: in-scope=false, multiplicity-restriction={severity=ERROR, lower-multiplicity=0, upper-multiplicity=1}, default-value-handling=NO-DEFAULT
            primitive attribute tailoring timeSeg1: in-scope=false, multiplicity-restriction={severity=ERROR, lower-multiplicity=0, upper-multiplicity=1}, default-value-handling=NO-DEFAULT
            primitive attribute tailoring timeSeg2: in-scope=false, multiplicity-restriction={severity=ERROR, lower-multiplicity=0, upper-multiplicity=1}, default-value-handling=NO-DEFAULT
        CanControllerConfigurationRequirements: multiplicity-restriction={severity=INFO, lower-multiplicity=0, upper-multiplicity-infinite=true}
          class content conditional Invariant
            6 x primitive attribute tailoring, all with in-scope=false, multiplicity-restriction={severity=ERROR, lower-multiplicity=0, upper-multiplicity=1}, default-value-handling=NO-DEFAULT:
              maxNumberOfTimeQuantaPerBit
              maxSamplePoint
              maxSyncJumpWidth
              minNumberOfTimeQuantaPerBit
              minSamplePoint
              minSyncJumpWidth
        CanFrame: multiplicity-restriction={severity=INFO, lower-multiplicity=0, upper-multiplicity-infinite=true}
          class content conditional Invariant
        CanFrameTriggering: multiplicity-restriction={severity=INFO, lower-multiplicity=0, upper-multiplicity-infinite=true}
          class content conditional Invariant
            attribute-tailorings:
              aggregation tailoring absolutelyScheduledTiming: in-scope=false, multiplicity-restriction={severity=ERROR, lower-multiplicity=0, upper-multiplicity-infinite=true}
              primitive attribute tailoring canAddressingMode: in-scope=false, multiplicity-restriction={severity=ERROR, lower-multiplicity=0, upper-multiplicity=1}, default-value-handling=NO-DEFAULT
              primitive attribute tailoring identifier: in-scope=false, multiplicity-restriction={severity=ERROR, lower-multiplicity=0, upper-multiplicity=1}, default-value-handling=NO-DEFAULT
              aggregation tailoring rxIdentifierRange: in-scope=false, multiplicity-restriction={severity=ERROR, lower-multiplicity=0, upper-multiplicity=1}
        CanNmCluster: multiplicity-restriction={severity=INFO, lower-multiplicity=0, upper-multiplicity-infinite=true}
          class content conditional Invariant
            17 x primitive attribute tailoring, all with in-scope=false, multiplicity-restriction={severity=ERROR, lower-multiplicity=0, upper-multiplicity=1}, default-value-handling=NO-DEFAULT:
              nmBusloadReductionActive
              nmCarWakeUpBitPosition
              nmCarWakeUpFilterEnabled
              nmCarWakeUpFilterNodeId
              nmCarWakeUpRxEnabled
              nmCbvPosition
              nmChannelActive
              nmImmediateNmCycleTime
              nmImmediateNmTransmissions
              nmMessageTimeoutTime
              nmMsgCycleTime
              nmNetworkTimeout
              nmNidPosition
              nmRemoteSleepIndicationTime
              nmRepeatMessageTime
              nmUserDataLength
              nmWaitBusSleepTime
        CanNmClusterCoupling: multiplicity-restriction={severity=INFO, lower-multiplicity=0, upper-multiplicity-infinite=true}
          class content conditional Invariant
            attribute-tailorings:
              reference tailoring coupledCluster: in-scope=false, multiplicity-restriction={severity=ERROR, lower-multiplicity=0, upper-multiplicity-infinite=true}, unresolved-reference-restriction=severity=ERROR
              primitive attribute tailoring nmBusloadReductionEnabled: in-scope=false, multiplicity-restriction={severity=ERROR, lower-multiplicity=0, upper-multiplicity=1}, default-value-handling=NO-DEFAULT
              primitive attribute tailoring nmImmediateRestartEnabled: in-scope=false, multiplicity-restriction={severity=ERROR, lower-multiplicity=0, upper-multiplicity=1}, default-value-handling=NO-DEFAULT
        CanNmEcu: multiplicity-restriction={severity=INFO, lower-multiplicity=0, upper-multiplicity-infinite=true}
          class content conditional Invariant
            primitive attribute tailoring nmRepeatMsgIndicationEnabled: in-scope=false, multiplicity-restriction={severity=WARNING, lower-multiplicity=0, upper-multiplicity=0}, default-value-handling=NO-DEFAULT  # Spec element has lifecycle state 'obsolete'.
        CanNmNode: multiplicity-restriction={severity=INFO, lower-multiplicity=0, upper-multiplicity-infinite=true}
          class content conditional Invariant
            attribute-tailorings:
              primitive attribute tailoring nmMsgCycleOffset: in-scope=false, multiplicity-restriction={severity=ERROR, lower-multiplicity=0, upper-multiplicity=1}, default-value-handling=NO-DEFAULT
              primitive attribute tailoring nmMsgReducedTime: in-scope=false, multiplicity-restriction={severity=ERROR, lower-multiplicity=0, upper-multiplicity=1}, default-value-handling=NO-DEFAULT
              aggregation tailoring nmRangeConfig: in-scope=false, multiplicity-restriction={severity=ERROR, lower-multiplicity=0, upper-multiplicity=1}
        CanNmRangeConfig: multiplicity-restriction={severity=WARNING, lower-multiplicity=0, upper-multiplicity=0}  # Spec element has lifecycle state 'obsolete'.
          class content conditional Invariant
            primitive attribute tailoring lowerCanId: in-scope=false, multiplicity-restriction={severity=ERROR, lower-multiplicity=0, upper-multiplicity=1}, default-value-handling=NO-DEFAULT
            primitive attribute tailoring upperCanId: in-scope=false, multiplicity-restriction={severity=ERROR, lower-multiplicity=0, upper-multiplicity=1}, default-value-handling=NO-DEFAULT
        CanPhysicalChannel: multiplicity-restriction={severity=INFO, lower-multiplicity=0, upper-multiplicity-infinite=true}
          class content conditional Invariant
        CanTpAddress: multiplicity-restriction={severity=INFO, lower-multiplicity=0, upper-multiplicity-infinite=true}
          class content conditional Invariant
            primitive attribute tailoring tpAddress: in-scope=false, multiplicity-restriction={severity=ERROR, lower-multiplicity=0, upper-multiplicity=1}, default-value-handling=NO-DEFAULT
            primitive attribute tailoring tpAddressExtensionValue: in-scope=false, multiplicity-restriction={severity=ERROR, lower-multiplicity=0, upper-multiplicity=1}, default-value-handling=NO-DEFAULT
        CanTpChannel: multiplicity-restriction={severity=INFO, lower-multiplicity=0, upper-multiplicity-infinite=true}
          class content conditional Invariant
            primitive attribute tailoring channelId: in-scope=false, multiplicity-restriction={severity=ERROR, lower-multiplicity=0, upper-multiplicity=1}, default-value-handling=NO-DEFAULT
            primitive attribute tailoring channelMode: in-scope=false, multiplicity-restriction={severity=ERROR, lower-multiplicity=0, upper-multiplicity=1}, default-value-handling=NO-DEFAULT
        CanTpConfig: multiplicity-restriction={severity=INFO, lower-multiplicity=0, upper-multiplicity-infinite=true}
          class content conditional Invariant
            attribute-tailorings:
              5 x aggregation tailoring, all with in-scope=false, multiplicity-restriction={severity=ERROR, lower-multiplicity=0, upper-multiplicity-infinite=true}:
                tpAddress: variation-restriction={severity=ERROR, variation=true, valid-binding-times=[BLUEPRINT-DERIVATION-TIME, SYSTEM-DESIGN-TIME, CODE-GENERATION-TIME, PRE-COMPILE-TIME, LINK-TIME, POST-BUILD]}
                tpChannel: variation-restriction={severity=ERROR, variation=true, valid-binding-times=[BLUEPRINT-DERIVATION-TIME, SYSTEM-DESIGN-TIME, CODE-GENERATION-TIME, PRE-COMPILE-TIME, LINK-TIME, POST-BUILD]}
                tpConnection
                tpEcu: variation-restriction={severity=ERROR, variation=true, valid-binding-times=[BLUEPRINT-DERIVATION-TIME, SYSTEM-DESIGN-TIME, CODE-GENERATION-TIME, PRE-COMPILE-TIME, LINK-TIME, POST-BUILD]}
                tpNode: variation-restriction={severity=ERROR, variation=true, valid-binding-times=[BLUEPRINT-DERIVATION-TIME, SYSTEM-DESIGN-TIME, CODE-GENERATION-TIME, PRE-COMPILE-TIME, LINK-TIME, POST-BUILD]}
        CanTpConnection: multiplicity-restriction={severity=INFO, lower-multiplicity=0, upper-multiplicity-infinite=true}
          class content conditional Invariant
            attribute-tailorings:
              primitive attribute tailoring addressingFormat: in-scope=false, multiplicity-restriction={severity=ERROR, lower-multiplicity=0, upper-multiplicity=1}, default-value-handling=NO-DEFAULT
              reference tailoring canTpChannel: in-scope=false, multiplicity-restriction={severity=ERROR, lower-multiplicity=0, upper-multiplicity=1}, unresolved-reference-restriction=severity=ERROR
              reference tailoring dataPdu: in-scope=false, multiplicity-restriction={severity=ERROR, lower-multiplicity=0, upper-multiplicity=1}, unresolved-reference-restriction=severity=ERROR
              reference tailoring flowControlPdu: in-scope=false, multiplicity-restriction={severity=ERROR, lower-multiplicity=0, upper-multiplicity=1}, unresolved-reference-restriction=severity=ERROR
              primitive attribute tailoring maxBlockSize: in-scope=false, multiplicity-restriction={severity=ERROR, lower-multiplicity=0, upper-multiplicity=1}, default-value-handling=NO-DEFAULT
              reference tailoring multicast: in-scope=false, multiplicity-restriction={severity=ERROR, lower-multiplicity=0, upper-multiplicity=1}, unresolved-reference-restriction=severity=ERROR
              primitive attribute tailoring paddingActivation: in-scope=false, multiplicity-restriction={severity=ERROR, lower-multiplicity=0, upper-multiplicity=1}, default-value-handling=NO-DEFAULT
              reference tailoring receiver: in-scope=false, multiplicity-restriction={severity=ERROR, lower-multiplicity=0, upper-multiplicity-infinite=true}, unresolved-reference-restriction=severity=ERROR
              5 x primitive attribute tailoring, all with in-scope=false, multiplicity-restriction={severity=ERROR, lower-multiplicity=0, upper-multiplicity=1}, default-value-handling=NO-DEFAULT:
                taType
                timeoutBr
                timeoutBs
                timeoutCr
                timeoutCs
              reference tailoring tpSdu: in-scope=false, multiplicity-restriction={severity=ERROR, lower-multiplicity=0, upper-multiplicity=1}, unresolved-reference-restriction=severity=ERROR
              primitive attribute tailoring transmitCancellation: in-scope=false, multiplicity-restriction={severity=ERROR, lower-multiplicity=0, upper-multiplicity=1}, default-value-handling=NO-DEFAULT
              reference tailoring transmitter: in-scope=false, multiplicity-restriction={severity=ERROR, lower-multiplicity=0, upper-multiplicity=1}, unresolved-reference-restriction=severity=ERROR
        CanTpEcu: multiplicity-restriction={severity=INFO, lower-multiplicity=0, upper-multiplicity-infinite=true}
          class content conditional Invariant
            attribute-tailorings:
              primitive attribute tailoring cycleTimeMainFunction: in-scope=false, multiplicity-restriction={severity=ERROR, lower-multiplicity=0, upper-multiplicity=1}, default-value-handling=NO-DEFAULT
              reference tailoring ecuInstance: in-scope=false, multiplicity-restriction={severity=ERROR, lower-multiplicity=0, upper-multiplicity=1}, unresolved-reference-restriction=severity=ERROR
        CanTpNode: multiplicity-restriction={severity=INFO, lower-multiplicity=0, upper-multiplicity-infinite=true}
          class content conditional Invariant
            attribute-tailorings:
              reference tailoring connector: in-scope=false, multiplicity-restriction={severity=ERROR, lower-multiplicity=0, upper-multiplicity=1}, unresolved-reference-restriction=severity=ERROR
              4 x primitive attribute tailoring, all with in-scope=false, multiplicity-restriction={severity=ERROR, lower-multiplicity=0, upper-multiplicity=1}, default-value-handling=NO-DEFAULT:
                maxFcWait
                stMin
                timeoutAr
                timeoutAs
              reference tailoring tpAddress: in-scope=false, multiplicity-restriction={severity=ERROR, lower-multiplicity=0, upper-multiplicity=1}, unresolved-reference-restriction=severity=ERROR
        Caption: multiplicity-restriction={severity=INFO, lower-multiplicity=0, upper-multiplicity-infinite=true}
          class content conditional Invariant
        Chapter: multiplicity-restriction={severity=INFO, lower-multiplicity=0, upper-multiplicity-infinite=true}
          class content conditional Invariant
            attribute-tailorings:
              aggregation tailoring chapterModel: in-scope=false, multiplicity-restriction={severity=ERROR, lower-multiplicity=0, upper-multiplicity=1}
              primitive attribute tailoring helpEntry: in-scope=false, multiplicity-restriction={severity=ERROR, lower-multiplicity=0, upper-multiplicity=1}, default-value-handling=NO-DEFAULT
        ChapterContent: multiplicity-restriction={severity=INFO, lower-multiplicity=0, upper-multiplicity-infinite=true}
          class content conditional Invariant
            attribute-tailorings:
              aggregation tailoring prms: in-scope=false, multiplicity-restriction={severity=ERROR, lower-multiplicity=0, upper-multiplicity-infinite=true}  # Multiplicity is 0..* since attribute is contained in mixed / mixedString class.
              aggregation tailoring topicContent: in-scope=false, multiplicity-restriction={severity=ERROR, lower-multiplicity=0, upper-multiplicity-infinite=true}  # Multiplicity is 0..* since attribute is contained in mixed / mixedString class.
        ChapterModel: multiplicity-restriction={severity=INFO, lower-multiplicity=0, upper-multiplicity-infinite=true}
          class content conditional Invariant
            attribute-tailorings:
              aggregation tailoring chapter: in-scope=false, multiplicity-restriction={severity=ERROR, lower-multiplicity=0, upper-multiplicity=1}
              aggregation tailoring chapterContent: in-scope=false, multiplicity-restriction={severity=ERROR, lower-multiplicity=0, upper-multiplicity=1}
              aggregation tailoring topic1: in-scope=false, multiplicity-restriction={severity=ERROR, lower-multiplicity=0, upper-multiplicity=1}
        ChapterOrMsrQuery: multiplicity-restriction={severity=INFO, lower-multiplicity=0, upper-multiplicity-infinite=true}
          class content conditional Invariant
            attribute-tailorings:
              aggregation tailoring chapter: in-scope=false, multiplicity-restriction={severity=ERROR, lower-multiplicity=0, upper-multiplicity-infinite=true}, variation-restriction={severity=ERROR, variation=true, valid-binding-times=[BLUEPRINT-DERIVATION-TIME, SYSTEM-DESIGN-TIME, CODE-GENERATION-TIME, PRE-COMPILE-TIME, LINK-TIME, POST-BUILD]}  # Multiplicity is 0..* since attribute is contained in mixed / mixedString class.
              aggregation tailoring msrQueryChapter: in-scope=false, multiplicity-restriction={severity=ERROR, lower-multiplicity=0, upper-multiplicity-infinite=true}  # Multiplicity is 0..* since attribute is contained in mixed / mixedString class.
        ClientComSpec: multiplicity-restriction={severity=INFO, lower-multiplicity=0, upper-multiplicity-infinite=true}
          class content conditional Invariant
            attribute-tailorings:
              reference tailoring operation: in-scope=false, multiplicity-restriction={severity=ERROR, lower-multiplicity=0, upper-multiplicity=1}, unresolved-reference-restriction=severity=ERROR
        ClientIdMapping: multiplicity-restriction={severity=INFO, lower-multiplicity=0, upper-multiplicity-infinite=true}
          class content conditional Invariant
            attribute-tailorings:
              reference tailoring systemSignal: in-scope=false, multiplicity-restriction={severity=ERROR, lower-multiplicity=0, upper-multiplicity=1}, unresolved-reference-restriction=severity=ERROR
        ClientServerAnnotation: multiplicity-restriction={severity=INFO, lower-multiplicity=0, upper-multiplicity-infinite=true}
          class content conditional Invariant
            attribute-tailorings:
              reference tailoring operation: in-scope=false, multiplicity-restriction={severity=ERROR, lower-multiplicity=0, upper-multiplicity=1}, unresolved-reference-restriction=severity=ERROR
        ClientServerArrayElementMapping: multiplicity-restriction={severity=INFO, lower-multiplicity=0, upper-multiplicity-infinite=true}
          class content conditional Invariant
            attribute-tailorings:
              aggregation tailoring complexTypeMapping: in-scope=false, multiplicity-restriction={severity=ERROR, lower-multiplicity=0, upper-multiplicity=1}
              aggregation tailoring indexedArrayElement: in-scope=false, multiplicity-restriction={severity=ERROR, lower-multiplicity=0, upper-multiplicity=1}
              reference tailoring systemSignal: in-scope=false, multiplicity-restriction={severity=ERROR, lower-multiplicity=0, upper-multiplicity=1}, unresolved-reference-restriction=severity=ERROR
        ClientServerArrayTypeMapping: multiplicity-restriction={severity=INFO, lower-multiplicity=0, upper-multiplicity-infinite=true}
          class content conditional Invariant
            attribute-tailorings:
              aggregation tailoring arrayElementMapping: in-scope=false, multiplicity-restriction={severity=ERROR, lower-multiplicity=0, upper-multiplicity-infinite=true}
      abstract class tailoring ClientServerCompositeTypeMapping: multiplicity-restriction={severity=INFO, lower-multiplicity=0, upper-multiplicity-infinite=true}
        class content conditional Invariant
          attribute-tailorings:
            reference tailoring argument: in-scope=false, multiplicity-restriction={severity=ERROR, lower-multiplicity=0, upper-multiplicity=1}, unresolved-reference-restriction=severity=ERROR
      9 x concrete class tailoring, all with in-scope=false, multiplicity-restriction={severity=INFO, lower-multiplicity=0, upper-multiplicity-infinite=true}, validation-root=false:
        ClientServerInterface
          class content conditional Invariant
            attribute-tailorings:
              aggregation tailoring operation: in-scope=false, multiplicity-restriction={severity=ERROR, lower-multiplicity=0, upper-multiplicity-infinite=true}, variation-restriction={severity=ERROR, variation=true, valid-binding-times=[BLUEPRINT-DERIVATION-TIME, SYSTEM-DESIGN-TIME, CODE-GENERATION-TIME, PRE-COMPILE-TIME, LINK-TIME, POST-BUILD]}
              aggregation tailoring possibleError: in-scope=false, multiplicity-restriction={severity=ERROR, lower-multiplicity=0, upper-multiplicity-infinite=true}
        ClientServerInterfaceMapping
          class content conditional Invariant
            attribute-tailorings:
              aggregation tailoring operationMapping: in-scope=false, multiplicity-restriction={severity=ERROR, lower-multiplicity=0, upper-multiplicity-infinite=true}
        ClientServerOperation
          class content conditional Invariant
            attribute-tailorings:
              aggregation tailoring argument: in-scope=false, multiplicity-restriction={severity=ERROR, lower-multiplicity=0, upper-multiplicity-infinite=true}
              reference tailoring possibleError: in-scope=false, multiplicity-restriction={severity=ERROR, lower-multiplicity=0, upper-multiplicity-infinite=true}, unresolved-reference-restriction=severity=ERROR
        ClientServerOperationMapping
          class content conditional Invariant
            attribute-tailorings:
              aggregation tailoring argumentMapping: in-scope=false, multiplicity-restriction={severity=ERROR, lower-multiplicity=0, upper-multiplicity-infinite=true}
              reference tailoring firstOperation: in-scope=false, multiplicity-restriction={severity=ERROR, lower-multiplicity=0, upper-multiplicity=1}, unresolved-reference-restriction=severity=ERROR
              reference tailoring secondOperation: in-scope=false, multiplicity-restriction={severity=ERROR, lower-multiplicity=0, upper-multiplicity=1}, unresolved-reference-restriction=severity=ERROR
        ClientServerPrimitiveTypeMapping
          class content conditional Invariant
            attribute-tailorings:
              reference tailoring argument: in-scope=false, multiplicity-restriction={severity=ERROR, lower-multiplicity=0, upper-multiplicity=1}, unresolved-reference-restriction=severity=ERROR
              reference tailoring systemSignal: in-scope=false, multiplicity-restriction={severity=ERROR, lower-multiplicity=0, upper-multiplicity=1}, unresolved-reference-restriction=severity=ERROR
        ClientServerRecordElementMapping
          class content conditional Invariant
            attribute-tailorings:
              reference tailoring applicationRecordElement: in-scope=false, multiplicity-restriction={severity=ERROR, lower-multiplicity=0, upper-multiplicity=1}, unresolved-reference-restriction=severity=ERROR
              aggregation tailoring complexTypeMapping: in-scope=false, multiplicity-restriction={severity=ERROR, lower-multiplicity=0, upper-multiplicity=1}
              reference tailoring implementationRecordElement: in-scope=false, multiplicity-restriction={severity=ERROR, lower-multiplicity=0, upper-multiplicity=1}, unresolved-reference-restriction=severity=ERROR
              reference tailoring systemSignal: in-scope=false, multiplicity-restriction={severity=ERROR, lower-multiplicity=0, upper-multiplicity=1}, unresolved-reference-restriction=severity=ERROR
        ClientServerRecordTypeMapping
          class content conditional Invariant
            attribute-tailorings:
              aggregation tailoring recordElementMapping: in-scope=false, multiplicity-restriction={severity=ERROR, lower-multiplicity=0, upper-multiplicity-infinite=true}
        ClientServerToSignalGroupMapping
          class content conditional Invariant
            attribute-tailorings:
              6 x aggregation tailoring, all with in-scope=false:
                applicationError: multiplicity-restriction={severity=ERROR, lower-multiplicity=0, upper-multiplicity=1}
                clientID: multiplicity-restriction={severity=ERROR, lower-multiplicity=0, upper-multiplicity=1}
                compositeTypeMapping: multiplicity-restriction={severity=ERROR, lower-multiplicity=0, upper-multiplicity-infinite=true}
                emptySignal: multiplicity-restriction={severity=ERROR, lower-multiplicity=0, upper-multiplicity=1}
                mappedOperation: multiplicity-restriction={severity=ERROR, lower-multiplicity=0, upper-multiplicity=1}
                primitiveTypeMapping: multiplicity-restriction={severity=ERROR, lower-multiplicity=0, upper-multiplicity-infinite=true}
              reference tailoring requestGroup: in-scope=false, multiplicity-restriction={severity=ERROR, lower-multiplicity=0, upper-multiplicity=1}, unresolved-reference-restriction=severity=ERROR
              reference tailoring responseGroup: in-scope=false, multiplicity-restriction={severity=ERROR, lower-multiplicity=0, upper-multiplicity=1}, unresolved-reference-restriction=severity=ERROR
              aggregation tailoring sequenceCounter: in-scope=false, multiplicity-restriction={severity=ERROR, lower-multiplicity=0, upper-multiplicity=1}
        Code
          class content conditional Invariant
            attribute-tailorings:
              aggregation tailoring artifactDescriptor: in-scope=false, multiplicity-restriction={severity=ERROR, lower-multiplicity=0, upper-multiplicity-infinite=true}
      abstract class tailoring CollectableElement: multiplicity-restriction={severity=INFO, lower-multiplicity=0, upper-multiplicity-infinite=true}
        class content conditional Invariant
      concrete class tailoring Collection: in-scope=false, multiplicity-restriction={severity=INFO, lower-multiplicity=0, upper-multiplicity-infinite=true}, validation-root=false
        class content conditional Invariant
          attribute-tailorings:
            reference tailoring element: in-scope=false, multiplicity-restriction={severity=ERROR, lower-multiplicity=0, upper-multiplicity-infinite=true}, unresolved-reference-restriction=severity=ERROR
      concrete class tailoring Colspec: in-scope=false, multiplicity-restriction={severity=INFO, lower-multiplicity=0, upper-multiplicity-infinite=true}, validation-root=false
        class content conditional Invariant
          6 x primitive attribute tailoring, all with in-scope=false, multiplicity-restriction={severity=ERROR, lower-multiplicity=0, upper-multiplicity=1}, default-value-handling=NO-DEFAULT:
            align
            colname
            colnum
            colsep
            colwidth
            rowsep
      concrete class tailoring ComMgrUserNeeds: in-scope=false, multiplicity-restriction={severity=INFO, lower-multiplicity=0, upper-multiplicity-infinite=true}, validation-root=false
        class content conditional Invariant
          primitive attribute tailoring maxCommMode: in-scope=false, multiplicity-restriction={severity=ERROR, lower-multiplicity=0, upper-multiplicity=1}, default-value-handling=NO-DEFAULT
      abstract class tailoring CommConnectorPort: multiplicity-restriction={severity=INFO, lower-multiplicity=0, upper-multiplicity-infinite=true}
        class content conditional Invariant
          primitive attribute tailoring communicationDirection: in-scope=false, multiplicity-restriction={severity=ERROR, lower-multiplicity=0, upper-multiplicity=1}, default-value-handling=NO-DEFAULT
      concrete class tailoring CommonSignalPath: in-scope=false, multiplicity-restriction={severity=INFO, lower-multiplicity=0, upper-multiplicity-infinite=true}, validation-root=false
        class content conditional Invariant
          attribute-tailorings:
            aggregation tailoring operation: in-scope=false, multiplicity-restriction={severity=ERROR, lower-multiplicity=0, upper-multiplicity-infinite=true}
            aggregation tailoring signal: in-scope=false, multiplicity-restriction={severity=ERROR, lower-multiplicity=0, upper-multiplicity-infinite=true}
      abstract class tailoring CommunicationCluster: multiplicity-restriction={severity=INFO, lower-multiplicity=0, upper-multiplicity-infinite=true}, variation-restriction={severity=ERROR, variation=true, valid-binding-times=[BLUEPRINT-DERIVATION-TIME, SYSTEM-DESIGN-TIME, CODE-GENERATION-TIME, PRE-COMPILE-TIME, LINK-TIME, POST-BUILD]}
        class content conditional Invariant
          attribute-tailorings:
            aggregation tailoring physicalChannel: in-scope=false, multiplicity-restriction={severity=ERROR, lower-multiplicity=0, upper-multiplicity-infinite=true}, variation-restriction={severity=ERROR, variation=true, valid-binding-times=[BLUEPRINT-DERIVATION-TIME, SYSTEM-DESIGN-TIME, CODE-GENERATION-TIME, PRE-COMPILE-TIME, LINK-TIME, POST-BUILD]}
            primitive attribute tailoring protocolName: in-scope=false, multiplicity-restriction={severity=ERROR, lower-multiplicity=0, upper-multiplicity=1}, default-value-handling=NO-DEFAULT
            primitive attribute tailoring protocolVersion: in-scope=false, multiplicity-restriction={severity=ERROR, lower-multiplicity=0, upper-multiplicity=1}, default-value-handling=NO-DEFAULT
            primitive attribute tailoring speed: in-scope=false, multiplicity-restriction={severity=ERROR, lower-multiplicity=0, upper-multiplicity=1}, default-value-handling=NO-DEFAULT
      abstract class tailoring CommunicationConnector: multiplicity-restriction={severity=INFO, lower-multiplicity=0, upper-multiplicity-infinite=true}
        class content conditional Invariant
          attribute-tailorings:
            reference tailoring commController: in-scope=false, multiplicity-restriction={severity=ERROR, lower-multiplicity=0, upper-multiplicity=1}, unresolved-reference-restriction=severity=ERROR
            aggregation tailoring ecuCommPortInstance: in-scope=false, multiplicity-restriction={severity=ERROR, lower-multiplicity=0, upper-multiplicity-infinite=true}, variation-restriction={severity=ERROR, variation=true, valid-binding-times=[BLUEPRINT-DERIVATION-TIME, SYSTEM-DESIGN-TIME, CODE-GENERATION-TIME, PRE-COMPILE-TIME, LINK-TIME, POST-BUILD]}
            primitive attribute tailoring pncGatewayType: in-scope=false, multiplicity-restriction={severity=ERROR, lower-multiplicity=0, upper-multiplicity=1}, default-value-handling=NO-DEFAULT
      abstract class tailoring CommunicationController: multiplicity-restriction={severity=INFO, lower-multiplicity=0, upper-multiplicity-infinite=true}, variation-restriction={severity=ERROR, variation=true, valid-binding-times=[BLUEPRINT-DERIVATION-TIME, SYSTEM-DESIGN-TIME, CODE-GENERATION-TIME, PRE-COMPILE-TIME, LINK-TIME, POST-BUILD]}
        class content conditional Invariant
      concrete class tailoring CommunicationControllerMapping: in-scope=false, multiplicity-restriction={severity=INFO, lower-multiplicity=0, upper-multiplicity-infinite=true}, validation-root=false
        class content conditional Invariant
          attribute-tailorings:
            reference tailoring communicationController: in-scope=false, multiplicity-restriction={severity=ERROR, lower-multiplicity=0, upper-multiplicity=1}, unresolved-reference-restriction=severity=ERROR
            reference tailoring hwCommunicationController: in-scope=false, multiplicity-restriction={severity=ERROR, lower-multiplicity=0, upper-multiplicity=1}, unresolved-reference-restriction=severity=ERROR
      abstract class tailoring CommunicationCycle: multiplicity-restriction={severity=INFO, lower-multiplicity=0, upper-multiplicity-infinite=true}
        class content conditional Invariant
      11 x concrete class tailoring, all with in-scope=false, multiplicity-restriction={severity=INFO, lower-multiplicity=0, upper-multiplicity-infinite=true}, validation-root=false:
        CompanyData
          class content conditional Invariant
        CompanyDocInfo
          class content conditional Invariant
        Compiler
          class content conditional Invariant
            4 x primitive attribute tailoring, all with in-scope=false, multiplicity-restriction={severity=ERROR, lower-multiplicity=0, upper-multiplicity=1}, default-value-handling=NO-DEFAULT:
              name
              options
              vendor
              version
        ComplexDeviceDriverSwComponentType
          class content conditional Invariant
            attribute-tailorings:
              reference tailoring hardwareElement: in-scope=false, multiplicity-restriction={severity=ERROR, lower-multiplicity=0, upper-multiplicity-infinite=true}, unresolved-reference-restriction=severity=ERROR
        ComponentClustering
          class content conditional Invariant
            attribute-tailorings:
              aggregation tailoring clusteredComponent: in-scope=false, multiplicity-restriction={severity=ERROR, lower-multiplicity=0, upper-multiplicity-infinite=true}
        ComponentInCompositionInstanceRef
          class content conditional Invariant
            attribute-tailorings:
              reference tailoring contextComponent: in-scope=false, multiplicity-restriction={severity=ERROR, lower-multiplicity=0, upper-multiplicity-infinite=true}, unresolved-reference-restriction=severity=ERROR
              reference tailoring targetComponent: in-scope=false, multiplicity-restriction={severity=ERROR, lower-multiplicity=0, upper-multiplicity=1}, unresolved-reference-restriction=severity=ERROR
        ComponentInSystemInstanceRef
          class content conditional Invariant
            attribute-tailorings:
              reference tailoring contextComponent: in-scope=false, multiplicity-restriction={severity=ERROR, lower-multiplicity=0, upper-multiplicity-infinite=true}, unresolved-reference-restriction=severity=ERROR
              reference tailoring contextComposition: in-scope=false, multiplicity-restriction={severity=ERROR, lower-multiplicity=0, upper-multiplicity=1}, unresolved-reference-restriction=severity=ERROR
              reference tailoring targetComponent: in-scope=false, multiplicity-restriction={severity=ERROR, lower-multiplicity=0, upper-multiplicity=1}, unresolved-reference-restriction=severity=ERROR
        ComponentSeparation
          class content conditional Invariant
            attribute-tailorings:
              aggregation tailoring separatedComponent: in-scope=false, multiplicity-restriction={severity=ERROR, lower-multiplicity=0, upper-multiplicity=2}
        CompositionSwComponentType
          class content conditional Invariant
            attribute-tailorings:
              aggregation tailoring component: in-scope=false, multiplicity-restriction={severity=ERROR, lower-multiplicity=0, upper-multiplicity-infinite=true}, variation-restriction={severity=ERROR, variation=true, valid-binding-times=[BLUEPRINT-DERIVATION-TIME, SYSTEM-DESIGN-TIME, CODE-GENERATION-TIME, PRE-COMPILE-TIME, LINK-TIME, POST-BUILD]}
              aggregation tailoring connector: in-scope=false, multiplicity-restriction={severity=ERROR, lower-multiplicity=0, upper-multiplicity-infinite=true}, variation-restriction={severity=ERROR, variation=true, valid-binding-times=[BLUEPRINT-DERIVATION-TIME, SYSTEM-DESIGN-TIME, CODE-GENERATION-TIME, PRE-COMPILE-TIME, LINK-TIME, POST-BUILD]}
              reference tailoring constantValueMapping: in-scope=false, multiplicity-restriction={severity=ERROR, lower-multiplicity=0, upper-multiplicity-infinite=true}, unresolved-reference-restriction=severity=ERROR
              reference tailoring dataTypeMapping: in-scope=false, multiplicity-restriction={severity=ERROR, lower-multiplicity=0, upper-multiplicity-infinite=true}, unresolved-reference-restriction=severity=ERROR
        Compu
          class content conditional Invariant
            attribute-tailorings:
              aggregation tailoring compuContent: in-scope=false, multiplicity-restriction={severity=ERROR, lower-multiplicity=0, upper-multiplicity=1}
              aggregation tailoring compuDefaultValue: in-scope=false, multiplicity-restriction={severity=ERROR, lower-multiplicity=0, upper-multiplicity=1}
        CompuConst
          class content conditional Invariant
            attribute-tailorings:
              aggregation tailoring compuConstContentType: in-scope=false, multiplicity-restriction={severity=ERROR, lower-multiplicity=0, upper-multiplicity=1}
      abstract class tailoring CompuConstContent: multiplicity-restriction={severity=INFO, lower-multiplicity=0, upper-multiplicity-infinite=true}
        class content conditional Invariant
      concrete class tailoring CompuConstFormulaContent: in-scope=false, multiplicity-restriction={severity=INFO, lower-multiplicity=0, upper-multiplicity-infinite=true}, validation-root=false
        class content conditional Invariant
          primitive attribute tailoring vf: in-scope=false, multiplicity-restriction={severity=ERROR, lower-multiplicity=0, upper-multiplicity=1}, variation-restriction={severity=ERROR, variation=true, valid-binding-times=[BLUEPRINT-DERIVATION-TIME, SYSTEM-DESIGN-TIME, CODE-GENERATION-TIME, PRE-COMPILE-TIME, LINK-TIME, POST-BUILD]}, default-value-handling=NO-DEFAULT
      concrete class tailoring CompuConstNumericContent: in-scope=false, multiplicity-restriction={severity=INFO, lower-multiplicity=0, upper-multiplicity-infinite=true}, validation-root=false
        class content conditional Invariant
          primitive attribute tailoring v: in-scope=false, multiplicity-restriction={severity=ERROR, lower-multiplicity=0, upper-multiplicity=1}, default-value-handling=NO-DEFAULT
      concrete class tailoring CompuConstTextContent: in-scope=false, multiplicity-restriction={severity=INFO, lower-multiplicity=0, upper-multiplicity-infinite=true}, validation-root=false
        class content conditional Invariant
          primitive attribute tailoring vt: in-scope=false, multiplicity-restriction={severity=ERROR, lower-multiplicity=0, upper-multiplicity=1}, default-value-handling=NO-DEFAULT
      abstract class tailoring CompuContent: multiplicity-restriction={severity=INFO, lower-multiplicity=0, upper-multiplicity-infinite=true}
        class content conditional Invariant
      6 x concrete class tailoring, all with in-scope=false, multiplicity-restriction={severity=INFO, lower-multiplicity=0, upper-multiplicity-infinite=true}, validation-root=false:
        CompuGenericMath
          class content conditional Invariant
            primitive attribute tailoring level: in-scope=false, multiplicity-restriction={severity=ERROR, lower-multiplicity=0, upper-multiplicity-infinite=true}, default-value-handling=NO-DEFAULT  # Multiplicity is 0..* since attribute is contained in mixed / mixedString class.
              sub-attribute-tailorings:
                primitive attribute tailoring namePattern: in-scope=false, multiplicity-restriction={severity=ERROR, lower-multiplicity=0, upper-multiplicity=1}, default-value-handling=NO-DEFAULT
        CompuMethod
          class content conditional Invariant
            attribute-tailorings:
              aggregation tailoring compuInternalToPhys: in-scope=false, multiplicity-restriction={severity=ERROR, lower-multiplicity=0, upper-multiplicity=1}
              aggregation tailoring compuPhysToInternal: in-scope=false, multiplicity-restriction={severity=ERROR, lower-multiplicity=0, upper-multiplicity=1}
              primitive attribute tailoring displayFormat: in-scope=false, multiplicity-restriction={severity=ERROR, lower-multiplicity=0, upper-multiplicity=1}, default-value-handling=NO-DEFAULT
              reference tailoring unit: in-scope=false, multiplicity-restriction={severity=ERROR, lower-multiplicity=0, upper-multiplicity=1}, unresolved-reference-restriction=severity=ERROR
        CompuNominatorDenominator
          class content conditional Invariant
            primitive attribute tailoring v: in-scope=false, multiplicity-restriction={severity=ERROR, lower-multiplicity=0, upper-multiplicity-infinite=true}, variation-restriction={severity=ERROR, variation=true, valid-binding-times=[BLUEPRINT-DERIVATION-TIME, SYSTEM-DESIGN-TIME, CODE-GENERATION-TIME, PRE-COMPILE-TIME, LINK-TIME, POST-BUILD]}, default-value-handling=NO-DEFAULT
        CompuRationalCoeffs
          class content conditional Invariant
            attribute-tailorings:
              aggregation tailoring compuDenominator: in-scope=false, multiplicity-restriction={severity=ERROR, lower-multiplicity=0, upper-multiplicity=1}
              aggregation tailoring compuNumerator: in-scope=false, multiplicity-restriction={severity=ERROR, lower-multiplicity=0, upper-multiplicity=1}
        CompuScale
          class content conditional Invariant
            attribute-tailorings:
              4 x aggregation tailoring, all with in-scope=false, multiplicity-restriction={severity=ERROR, lower-multiplicity=0, upper-multiplicity=1}:
                compuInverseValue
                compuScaleContents
                desc
                lowerLimit
              primitive attribute tailoring mask: in-scope=false, multiplicity-restriction={severity=ERROR, lower-multiplicity=0, upper-multiplicity=1}, default-value-handling=NO-DEFAULT
              primitive attribute tailoring shortLabel: in-scope=false, multiplicity-restriction={severity=ERROR, lower-multiplicity=0, upper-multiplicity=1}, default-value-handling=NO-DEFAULT
                sub-attribute-tailorings:
                  primitive attribute tailoring namePattern: in-scope=false, multiplicity-restriction={severity=ERROR, lower-multiplicity=0, upper-multiplicity=1}, default-value-handling=NO-DEFAULT
              primitive attribute tailoring symbol: in-scope=false, multiplicity-restriction={severity=ERROR, lower-multiplicity=0, upper-multiplicity=1}, default-value-handling=NO-DEFAULT
                sub-attribute-tailorings:
                  primitive attribute tailoring namePattern: in-scope=false, multiplicity-restriction={severity=ERROR, lower-multiplicity=0, upper-multiplicity=1}, default-value-handling=NO-DEFAULT
              aggregation tailoring upperLimit: in-scope=false, multiplicity-restriction={severity=ERROR, lower-multiplicity=0, upper-multiplicity=1}
        CompuScaleConstantContents
          class content conditional Invariant
            attribute-tailorings:
              aggregation tailoring compuConst: in-scope=false, multiplicity-restriction={severity=ERROR, lower-multiplicity=0, upper-multiplicity=1}
      abstract class tailoring CompuScaleContents: multiplicity-restriction={severity=INFO, lower-multiplicity=0, upper-multiplicity-infinite=true}
        class content conditional Invariant
      16 x concrete class tailoring, all with in-scope=false, multiplicity-restriction={severity=INFO, lower-multiplicity=0, upper-multiplicity-infinite=true}, validation-root=false:
        CompuScaleRationalFormula
          class content conditional Invariant
            attribute-tailorings:
              aggregation tailoring compuRationalCoeffs: in-scope=false, multiplicity-restriction={severity=ERROR, lower-multiplicity=0, upper-multiplicity=1}
        CompuScales
          class content conditional Invariant
            attribute-tailorings:
              aggregation tailoring compuScale: in-scope=false, multiplicity-restriction={severity=ERROR, lower-multiplicity=0, upper-multiplicity-infinite=true}, variation-restriction={severity=ERROR, variation=true, valid-binding-times=[BLUEPRINT-DERIVATION-TIME, SYSTEM-DESIGN-TIME, CODE-GENERATION-TIME, PRE-COMPILE-TIME, LINK-TIME, POST-BUILD]}
        ConcretePatternEventTriggering
          class content conditional Invariant
            attribute-tailorings:
              aggregation tailoring offset: in-scope=false, multiplicity-restriction={severity=ERROR, lower-multiplicity=0, upper-multiplicity-infinite=true}
              aggregation tailoring patternLength: in-scope=false, multiplicity-restriction={severity=ERROR, lower-multiplicity=0, upper-multiplicity=1}
        ConditionByFormula
          class content conditional Invariant
            primitive attribute tailoring bindingTime: in-scope=false, multiplicity-restriction={severity=ERROR, lower-multiplicity=0, upper-multiplicity=1}, default-value-handling=NO-DEFAULT
        ConditionalChangeNad
          class content conditional Invariant
            5 x primitive attribute tailoring, all with in-scope=false, multiplicity-restriction={severity=ERROR, lower-multiplicity=0, upper-multiplicity=1}, default-value-handling=NO-DEFAULT:
              byte
              id
              invert
              mask
              newNad
        ConfCond
          class content conditional Invariant
            attribute-tailorings:
              reference tailoring confItem: in-scope=false, multiplicity-restriction={severity=ERROR, lower-multiplicity=0, upper-multiplicity=1}, unresolved-reference-restriction=severity=ERROR
        ConfDefaultValue
          class content conditional Invariant
        ConfDefaultValueFormula
          class content conditional Invariant
        ConfDefaultValuePointer
          class content conditional Invariant
        ConfDefaultValueValue
          class content conditional Invariant
        ConfForwarding
          class content conditional Invariant
        ConfItem
          class content conditional Invariant
        ConfItemFormula
          class content conditional Invariant
        ConfItemNumber
          class content conditional Invariant
        ConfItemPointer
          class content conditional Invariant
        ConfItemText
          class content conditional Invariant
      abstract class tailoring ConfItemValue: multiplicity-restriction={severity=INFO, lower-multiplicity=0, upper-multiplicity-infinite=true}
        class content conditional Invariant
      30 x concrete class tailoring, all with in-scope=false, multiplicity-restriction={severity=INFO, lower-multiplicity=0, upper-multiplicity-infinite=true}, validation-root=false:
        ConfItems
          class content conditional Invariant
        ConfKeySpec
          class content conditional Invariant
        ConfProValue
          class content conditional Invariant
        ConfProValueFormula
          class content conditional Invariant
        ConfProValuePointer
          class content conditional Invariant
        ConfProValueValue
          class content conditional Invariant
        ConfRule
          class content conditional Invariant
        ConfRuleRef
          class content conditional Invariant
            attribute-tailorings:
              reference tailoring confRule: in-scope=false, multiplicity-restriction={severity=ERROR, lower-multiplicity=0, upper-multiplicity=1}, unresolved-reference-restriction=severity=ERROR
        ConfSource
          class content conditional Invariant
        ConfSources
          class content conditional Invariant
        ConfSourcesScope
          class content conditional Invariant
            attribute-tailorings:
              aggregation tailoring swInterfaceExportScope: in-scope=false, multiplicity-restriction={severity=ERROR, lower-multiplicity=0, upper-multiplicity=1}
        ConfSpec
          class content conditional Invariant
        ConfValueConstr
          class content conditional Invariant
        ConfValueProps
          class content conditional Invariant
        ConfidenceInterval
          class content conditional Invariant
            attribute-tailorings:
              aggregation tailoring lowerBound: in-scope=false, multiplicity-restriction={severity=ERROR, lower-multiplicity=0, upper-multiplicity=1}
              primitive attribute tailoring propability: in-scope=false, multiplicity-restriction={severity=ERROR, lower-multiplicity=0, upper-multiplicity=1}, default-value-handling=NO-DEFAULT
              aggregation tailoring upperBound: in-scope=false, multiplicity-restriction={severity=ERROR, lower-multiplicity=0, upper-multiplicity=1}
        ConstantReference
          class content conditional Invariant
            attribute-tailorings:
              reference tailoring constant: in-scope=false, multiplicity-restriction={severity=ERROR, lower-multiplicity=0, upper-multiplicity=1}, unresolved-reference-restriction=severity=ERROR
        ConstantSpecification
          class content conditional Invariant
            attribute-tailorings:
              aggregation tailoring valueSpec: in-scope=false, multiplicity-restriction={severity=ERROR, lower-multiplicity=0, upper-multiplicity=1}
        ConstantSpecificationMapping
          class content conditional Invariant
            attribute-tailorings:
              reference tailoring applConstant: in-scope=false, multiplicity-restriction={severity=ERROR, lower-multiplicity=0, upper-multiplicity=1}, unresolved-reference-restriction=severity=ERROR
              reference tailoring implConstant: in-scope=false, multiplicity-restriction={severity=ERROR, lower-multiplicity=0, upper-multiplicity=1}, unresolved-reference-restriction=severity=ERROR
        ConstantSpecificationMappingSet
          class content conditional Invariant
            attribute-tailorings:
              aggregation tailoring mapping: in-scope=false, multiplicity-restriction={severity=ERROR, lower-multiplicity=0, upper-multiplicity-infinite=true}
        ContractAspects
          class content conditional Invariant
        CountConstr
          class content conditional Invariant
            attribute-tailorings:
              aggregation tailoring lowerLimit: in-scope=false, multiplicity-restriction={severity=ERROR, lower-multiplicity=0, upper-multiplicity=1}
              aggregation tailoring upperLimit: in-scope=false, multiplicity-restriction={severity=ERROR, lower-multiplicity=0, upper-multiplicity=1}
        CryptoServiceNeeds
          class content conditional Invariant
            primitive attribute tailoring maximumKeyLength: in-scope=false, multiplicity-restriction={severity=ERROR, lower-multiplicity=0, upper-multiplicity=1}, default-value-handling=NO-DEFAULT
        CsEntry
          class content conditional Invariant
            attribute-tailorings:
              7 x primitive attribute tailoring, all with in-scope=false, multiplicity-restriction={severity=ERROR, lower-multiplicity=0, upper-multiplicity=1}, default-value-handling=NO-DEFAULT:
                csdi
                cspi
                cspr
                csto
                cstv
                csus
                cswp
              aggregation tailoring date: in-scope=false, multiplicity-restriction={severity=ERROR, lower-multiplicity=0, upper-multiplicity=1}
              aggregation tailoring sd: in-scope=false, multiplicity-restriction={severity=ERROR, lower-multiplicity=0, upper-multiplicity-infinite=true}
              aggregation tailoring state: in-scope=false, multiplicity-restriction={severity=ERROR, lower-multiplicity=0, upper-multiplicity=1}
        CycleCounter
          class content conditional Invariant
            primitive attribute tailoring CycleCounter: in-scope=false, multiplicity-restriction={severity=ERROR, lower-multiplicity=0, upper-multiplicity=1}, default-value-handling=NO-DEFAULT
        CycleRepetition
          class content conditional Invariant
            primitive attribute tailoring BaseCycle: in-scope=false, multiplicity-restriction={severity=ERROR, lower-multiplicity=0, upper-multiplicity=1}, default-value-handling=NO-DEFAULT
            primitive attribute tailoring CycleRepetition: in-scope=false, multiplicity-restriction={severity=ERROR, lower-multiplicity=0, upper-multiplicity=1}, default-value-handling=NO-DEFAULT
        CyclicTiming
          class content conditional Invariant
            attribute-tailorings:
              aggregation tailoring timeOffset: in-scope=false, multiplicity-restriction={severity=ERROR, lower-multiplicity=0, upper-multiplicity=1}
              aggregation tailoring timePeriod: in-scope=false, multiplicity-restriction={severity=ERROR, lower-multiplicity=0, upper-multiplicity=1}
        DataConstr
          class content conditional Invariant
            attribute-tailorings:
              aggregation tailoring dataConstrRule: in-scope=false, multiplicity-restriction={severity=ERROR, lower-multiplicity=0, upper-multiplicity-infinite=true}
        DataConstrRule
          class content conditional Invariant
            attribute-tailorings:
              primitive attribute tailoring constrLevel: in-scope=false, multiplicity-restriction={severity=ERROR, lower-multiplicity=0, upper-multiplicity=1}, default-value-handling=NO-DEFAULT
              aggregation tailoring internalConstrs: in-scope=false, multiplicity-restriction={severity=ERROR, lower-multiplicity=0, upper-multiplicity=1}
              aggregation tailoring physConstrs: in-scope=false, multiplicity-restriction={severity=ERROR, lower-multiplicity=0, upper-multiplicity=1}
        DataDumpEntry
          class content conditional Invariant
            primitive attribute tailoring byteValue: in-scope=false, multiplicity-restriction={severity=ERROR, lower-multiplicity=0, upper-multiplicity=5}, default-value-handling=NO-DEFAULT
        DataFilter
          class content conditional Invariant
            7 x primitive attribute tailoring, all with in-scope=false, multiplicity-restriction={severity=ERROR, lower-multiplicity=0, upper-multiplicity=1}, default-value-handling=NO-DEFAULT:
              dataFilterType
              mask
              max
              min
              offset
              period
              x
      abstract class tailoring DataInterface: multiplicity-restriction={severity=INFO, lower-multiplicity=0, upper-multiplicity-infinite=true}
        class content conditional Invariant
      abstract class tailoring DataMapping: multiplicity-restriction={severity=INFO, lower-multiplicity=0, upper-multiplicity-infinite=true}
        class content conditional Invariant
          attribute-tailorings:
            aggregation tailoring introduction: in-scope=false, multiplicity-restriction={severity=ERROR, lower-multiplicity=0, upper-multiplicity=1}
      abstract class tailoring DataPrototype: multiplicity-restriction={severity=INFO, lower-multiplicity=0, upper-multiplicity-infinite=true}
        class content conditional Invariant
          attribute-tailorings:
            aggregation tailoring swDataDefProps: in-scope=false, multiplicity-restriction={severity=ERROR, lower-multiplicity=0, upper-multiplicity=1}
      18 x concrete class tailoring, all with in-scope=false, multiplicity-restriction={severity=INFO, lower-multiplicity=0, upper-multiplicity-infinite=true}, validation-root=false:
        DataPrototypeMapping
          class content conditional Invariant
            attribute-tailorings:
              reference tailoring firstDataPrototype: in-scope=false, multiplicity-restriction={severity=ERROR, lower-multiplicity=0, upper-multiplicity=1}, unresolved-reference-restriction=severity=ERROR
              reference tailoring secondDataPrototype: in-scope=false, multiplicity-restriction={severity=ERROR, lower-multiplicity=0, upper-multiplicity=1}, unresolved-reference-restriction=severity=ERROR
              aggregation tailoring subElementMapping: in-scope=false, multiplicity-restriction={severity=ERROR, lower-multiplicity=0, upper-multiplicity-infinite=true}
              aggregation tailoring textTableMapping: in-scope=false, multiplicity-restriction={severity=ERROR, lower-multiplicity=0, upper-multiplicity=2}
        DataReceiveErrorEvent
          class content conditional Invariant
            attribute-tailorings:
              aggregation tailoring data: in-scope=false, multiplicity-restriction={severity=ERROR, lower-multiplicity=0, upper-multiplicity=1}
        DataReceivedEvent
          class content conditional Invariant
            attribute-tailorings:
              aggregation tailoring data: in-scope=false, multiplicity-restriction={severity=ERROR, lower-multiplicity=0, upper-multiplicity=1}
        DataRequirements
          class content conditional Invariant
        DataSendCompletedEvent
          class content conditional Invariant
            attribute-tailorings:
              reference tailoring eventSource: in-scope=false, multiplicity-restriction={severity=ERROR, lower-multiplicity=0, upper-multiplicity=1}, unresolved-reference-restriction=severity=ERROR
        DataTypeMap
          class content conditional Invariant
            attribute-tailorings:
              reference tailoring applicationDataType: in-scope=false, multiplicity-restriction={severity=ERROR, lower-multiplicity=0, upper-multiplicity=1}, unresolved-reference-restriction=severity=ERROR
              reference tailoring implementationDataType: in-scope=false, multiplicity-restriction={severity=ERROR, lower-multiplicity=0, upper-multiplicity=1}, unresolved-reference-restriction=severity=ERROR
        DataTypeMappingSet
          class content conditional Invariant
            attribute-tailorings:
              aggregation tailoring dataTypeMap: in-scope=false, multiplicity-restriction={severity=ERROR, lower-multiplicity=0, upper-multiplicity-infinite=true}
              aggregation tailoring modeRequestTypeMap: in-scope=false, multiplicity-restriction={severity=ERROR, lower-multiplicity=0, upper-multiplicity-infinite=true}
        DataWriteCompletedEvent
          class content conditional Invariant
            attribute-tailorings:
              reference tailoring eventSource: in-scope=false, multiplicity-restriction={severity=ERROR, lower-multiplicity=0, upper-multiplicity=1}, unresolved-reference-restriction=severity=ERROR
        DciEnum
          class content conditional Invariant
        DciEnumEntry
          class content conditional Invariant
        DcmIPdu
          class content conditional Invariant
            primitive attribute tailoring DiagPduType: in-scope=false, multiplicity-restriction={severity=ERROR, lower-multiplicity=0, upper-multiplicity=1}, default-value-handling=NO-DEFAULT
        DefItem
          class content conditional Invariant
            attribute-tailorings:
              aggregation tailoring def: in-scope=false, multiplicity-restriction={severity=ERROR, lower-multiplicity=0, upper-multiplicity=1}
              primitive attribute tailoring helpEntry: in-scope=false, multiplicity-restriction={severity=ERROR, lower-multiplicity=0, upper-multiplicity=1}, default-value-handling=NO-DEFAULT
        DefList
          class content conditional Invariant
            attribute-tailorings:
              aggregation tailoring defItem: in-scope=false, multiplicity-restriction={severity=ERROR, lower-multiplicity=0, upper-multiplicity-infinite=true}, variation-restriction={severity=ERROR, variation=true, valid-binding-times=[BLUEPRINT-DERIVATION-TIME, SYSTEM-DESIGN-TIME, CODE-GENERATION-TIME, PRE-COMPILE-TIME, LINK-TIME, POST-BUILD]}
        DefaultAttributes
          class content conditional Invariant
            7 x primitive attribute tailoring, all with in-scope=false, multiplicity-restriction={severity=ERROR, lower-multiplicity=0, upper-multiplicity=1}, default-value-handling=NO-DEFAULT:
              c
              s
              si
              syscond
              t
              ti
              view
        DefaultValueElement
          class content conditional Invariant
            primitive attribute tailoring elementByteValue: in-scope=false, multiplicity-restriction={severity=ERROR, lower-multiplicity=0, upper-multiplicity=1}, default-value-handling=NO-DEFAULT
            primitive attribute tailoring elementPosition: in-scope=false, multiplicity-restriction={severity=ERROR, lower-multiplicity=0, upper-multiplicity=1}, default-value-handling=NO-DEFAULT
        DelegatedPortAnnotation
          class content conditional Invariant
            primitive attribute tailoring signalFan: in-scope=false, multiplicity-restriction={severity=ERROR, lower-multiplicity=0, upper-multiplicity=1}, default-value-handling=NO-DEFAULT
        DelegationSwConnector
          class content conditional Invariant
            attribute-tailorings:
              aggregation tailoring innerPort: in-scope=false, multiplicity-restriction={severity=ERROR, lower-multiplicity=0, upper-multiplicity=1}
              reference tailoring outerPort: in-scope=false, multiplicity-restriction={severity=ERROR, lower-multiplicity=0, upper-multiplicity=1}, unresolved-reference-restriction=severity=ERROR
        DependencyOnArtifact
          class content conditional Invariant
            attribute-tailorings:
              aggregation tailoring artifactDescriptor: in-scope=false, multiplicity-restriction={severity=ERROR, lower-multiplicity=0, upper-multiplicity=1}
              primitive attribute tailoring usage: in-scope=false, multiplicity-restriction={severity=ERROR, lower-multiplicity=0, upper-multiplicity-infinite=true}, default-value-handling=NO-DEFAULT
      abstract class tailoring Describable: multiplicity-restriction={severity=INFO, lower-multiplicity=0, upper-multiplicity-infinite=true}
        class content conditional Invariant
          attribute-tailorings:
            aggregation tailoring desc: in-scope=false, multiplicity-restriction={severity=ERROR, lower-multiplicity=0, upper-multiplicity=1}
            aggregation tailoring introduction: in-scope=false, multiplicity-restriction={severity=ERROR, lower-multiplicity=0, upper-multiplicity=1}
      concrete class tailoring DesignRequirements: in-scope=false, multiplicity-restriction={severity=INFO, lower-multiplicity=0, upper-multiplicity-infinite=true}, validation-root=false
        class content conditional Invariant
      abstract class tailoring DiagEventDebounceAlgorithm: multiplicity-restriction={severity=INFO, lower-multiplicity=0, upper-multiplicity-infinite=true}
        class content conditional Invariant
      concrete class tailoring DiagEventDebounceCounterBased: in-scope=false, multiplicity-restriction={severity=INFO, lower-multiplicity=0, upper-multiplicity-infinite=true}, validation-root=false
        class content conditional Invariant
          8 x primitive attribute tailoring, all with in-scope=false, multiplicity-restriction={severity=ERROR, lower-multiplicity=0, upper-multiplicity=1}, default-value-handling=NO-DEFAULT:
            counterDecrementStepSize
            counterFailedThreshold
            counterIncrementStepSize
            counterJumpDown
            counterJumpDownValue
            counterJumpUp
            counterJumpUpValue
            counterPassedThreshold
      concrete class tailoring DiagEventDebounceMonitorInternal: in-scope=false, multiplicity-restriction={severity=INFO, lower-multiplicity=0, upper-multiplicity-infinite=true}, validation-root=false
        class content conditional Invariant
      concrete class tailoring DiagEventDebounceTimeBased: in-scope=false, multiplicity-restriction={severity=INFO, lower-multiplicity=0, upper-multiplicity-infinite=true}, validation-root=false
        class content conditional Invariant
          primitive attribute tailoring timeFailedThreshold: in-scope=false, multiplicity-restriction={severity=ERROR, lower-multiplicity=0, upper-multiplicity=1}, default-value-handling=NO-DEFAULT
          primitive attribute tailoring timePassedThreshold: in-scope=false, multiplicity-restriction={severity=ERROR, lower-multiplicity=0, upper-multiplicity=1}, default-value-handling=NO-DEFAULT
      abstract class tailoring DiagnosticCapabilityElement: multiplicity-restriction={severity=INFO, lower-multiplicity=0, upper-multiplicity-infinite=true}
        class content conditional Invariant
          primitive attribute tailoring audience: in-scope=false, multiplicity-restriction={severity=ERROR, lower-multiplicity=0, upper-multiplicity-infinite=true}, default-value-handling=NO-DEFAULT
          primitive attribute tailoring diagRequirement: in-scope=false, multiplicity-restriction={severity=ERROR, lower-multiplicity=0, upper-multiplicity=1}, default-value-handling=NO-DEFAULT
          primitive attribute tailoring securityAccessLevel: in-scope=false, multiplicity-restriction={severity=ERROR, lower-multiplicity=0, upper-multiplicity=1}, default-value-handling=NO-DEFAULT
      8 x concrete class tailoring, all with in-scope=false, multiplicity-restriction={severity=INFO, lower-multiplicity=0, upper-multiplicity-infinite=true}, validation-root=false:
        DiagnosticCommunicationManagerNeeds
          class content conditional Invariant
        DiagnosticEventManagerNeeds
          class content conditional Invariant
        DiagnosticEventNeeds
          class content conditional Invariant
            attribute-tailorings:
              primitive attribute tailoring considerPtoStatus: in-scope=false, multiplicity-restriction={severity=ERROR, lower-multiplicity=0, upper-multiplicity=1}, default-value-handling=NO-DEFAULT
              aggregation tailoring diagEventDebounceAlgorithm: in-scope=false, multiplicity-restriction={severity=ERROR, lower-multiplicity=0, upper-multiplicity=1}
              primitive attribute tailoring dtcKind: in-scope=false, multiplicity-restriction={severity=ERROR, lower-multiplicity=0, upper-multiplicity=1}, default-value-handling=NO-DEFAULT
              primitive attribute tailoring dtcNumber: in-scope=false, multiplicity-restriction={severity=ERROR, lower-multiplicity=0, upper-multiplicity=1}, default-value-handling=NO-DEFAULT
              reference tailoring inhibitingFid: in-scope=false, multiplicity-restriction={severity=ERROR, lower-multiplicity=0, upper-multiplicity=1}, unresolved-reference-restriction=severity=ERROR
              reference tailoring inhibitingSecondaryFid: in-scope=false, multiplicity-restriction={severity=ERROR, lower-multiplicity=0, upper-multiplicity-infinite=true}, unresolved-reference-restriction=severity=ERROR
        DiagnosticIoControlNeeds
          class content conditional Invariant
            primitive attribute tailoring didNumber: in-scope=false, multiplicity-restriction={severity=ERROR, lower-multiplicity=0, upper-multiplicity=1}, default-value-handling=NO-DEFAULT
            primitive attribute tailoring freezeCurrentStateSupported: in-scope=false, multiplicity-restriction={severity=ERROR, lower-multiplicity=0, upper-multiplicity=1}, default-value-handling=NO-DEFAULT
            primitive attribute tailoring shortTermAdjustmentSupported: in-scope=false, multiplicity-restriction={severity=ERROR, lower-multiplicity=0, upper-multiplicity=1}, default-value-handling=NO-DEFAULT
        DiagnosticRoutineNeeds
          class content conditional Invariant
            primitive attribute tailoring diagRoutineType: in-scope=false, multiplicity-restriction={severity=ERROR, lower-multiplicity=0, upper-multiplicity=1}, default-value-handling=NO-DEFAULT
            primitive attribute tailoring ridNumber: in-scope=false, multiplicity-restriction={severity=ERROR, lower-multiplicity=0, upper-multiplicity=1}, default-value-handling=NO-DEFAULT
        DiagnosticValueNeeds
          class content conditional Invariant
            primitive attribute tailoring DiagnosticValueAccess: in-scope=false, multiplicity-restriction={severity=ERROR, lower-multiplicity=0, upper-multiplicity=1}, default-value-handling=NO-DEFAULT
            primitive attribute tailoring dataLength: in-scope=false, multiplicity-restriction={severity=ERROR, lower-multiplicity=0, upper-multiplicity=1}, default-value-handling=NO-DEFAULT
            primitive attribute tailoring didNumber: in-scope=false, multiplicity-restriction={severity=ERROR, lower-multiplicity=0, upper-multiplicity=1}, default-value-handling=NO-DEFAULT
        DltUserNeeds
          class content conditional Invariant
        DocRevision
          class content conditional Invariant
            attribute-tailorings:
              primitive attribute tailoring date: in-scope=false, multiplicity-restriction={severity=ERROR, lower-multiplicity=0, upper-multiplicity=1}, default-value-handling=NO-DEFAULT
              primitive attribute tailoring issuedBy: in-scope=false, multiplicity-restriction={severity=ERROR, lower-multiplicity=0, upper-multiplicity=1}, default-value-handling=NO-DEFAULT
              aggregation tailoring modification: in-scope=false, multiplicity-restriction={severity=ERROR, lower-multiplicity=0, upper-multiplicity-infinite=true}
              4 x primitive attribute tailoring, all with in-scope=false, multiplicity-restriction={severity=ERROR, lower-multiplicity=0, upper-multiplicity=1}, default-value-handling=NO-DEFAULT:
                revisionLabel
                revisionLabelP1
                revisionLabelP2
                state
      abstract class tailoring DocumentViewSelectable: multiplicity-restriction={severity=INFO, lower-multiplicity=0, upper-multiplicity-infinite=true}
        class content conditional Invariant
          primitive attribute tailoring si: in-scope=false, multiplicity-restriction={severity=ERROR, lower-multiplicity=0, upper-multiplicity=1}, default-value-handling=NO-DEFAULT
          primitive attribute tailoring view: in-scope=false, multiplicity-restriction={severity=ERROR, lower-multiplicity=0, upper-multiplicity=1}, default-value-handling=NO-DEFAULT
      13 x concrete class tailoring, all with in-scope=false, multiplicity-restriction={severity=INFO, lower-multiplicity=0, upper-multiplicity-infinite=true}, validation-root=false:
        Documentation
          class content conditional Invariant
            attribute-tailorings:
              aggregation tailoring context: in-scope=false, multiplicity-restriction={severity=ERROR, lower-multiplicity=0, upper-multiplicity-infinite=true}
              aggregation tailoring documentationContent: in-scope=false, multiplicity-restriction={severity=ERROR, lower-multiplicity=0, upper-multiplicity=1}
        DocumentationBlock
          class content conditional Invariant
            attribute-tailorings:
              10 x aggregation tailoring, all with in-scope=false, multiplicity-restriction={severity=ERROR, lower-multiplicity=0, upper-multiplicity-infinite=true}, variation-restriction={severity=ERROR, variation=true, valid-binding-times=[BLUEPRINT-DERIVATION-TIME, SYSTEM-DESIGN-TIME, CODE-GENERATION-TIME, PRE-COMPILE-TIME, LINK-TIME, POST-BUILD]}:
                defList  # Multiplicity is 0..* since attribute is contained in mixed / mixedString class.
                figure  # Multiplicity is 0..* since attribute is contained in mixed / mixedString class.
                formula  # Multiplicity is 0..* since attribute is contained in mixed / mixedString class.
                labeledList  # Multiplicity is 0..* since attribute is contained in mixed / mixedString class.
                list  # Multiplicity is 0..* since attribute is contained in mixed / mixedString class.
                note  # Multiplicity is 0..* since attribute is contained in mixed / mixedString class.
                p  # Multiplicity is 0..* since attribute is contained in mixed / mixedString class.
                structuredReq  # Multiplicity is 0..* since attribute is contained in mixed / mixedString class.
                trace  # Multiplicity is 0..* since attribute is contained in mixed / mixedString class.
                verbatim  # Multiplicity is 0..* since attribute is contained in mixed / mixedString class.
        DocumentationContext
          class content conditional Invariant
            attribute-tailorings:
              aggregation tailoring feature: in-scope=false, multiplicity-restriction={severity=ERROR, lower-multiplicity=0, upper-multiplicity=1}
              reference tailoring identifiable: in-scope=false, multiplicity-restriction={severity=ERROR, lower-multiplicity=0, upper-multiplicity=1}, unresolved-reference-restriction=severity=ERROR
        DynamicPart
          class content conditional Invariant
            attribute-tailorings:
              aggregation tailoring dynamicPartAlternative: in-scope=false, multiplicity-restriction={severity=ERROR, lower-multiplicity=0, upper-multiplicity-infinite=true}
        DynamicPartAlternative
          class content conditional Invariant
            attribute-tailorings:
              reference tailoring iPdu: in-scope=false, multiplicity-restriction={severity=ERROR, lower-multiplicity=0, upper-multiplicity=1}, unresolved-reference-restriction=severity=ERROR
              primitive attribute tailoring initialDynamicPart: in-scope=false, multiplicity-restriction={severity=ERROR, lower-multiplicity=0, upper-multiplicity=1}, default-value-handling=NO-DEFAULT
              primitive attribute tailoring selectorFieldCode: in-scope=false, multiplicity-restriction={severity=ERROR, lower-multiplicity=0, upper-multiplicity=1}, default-value-handling=NO-DEFAULT
        ECUMapping
          class content conditional Invariant
            attribute-tailorings:
              aggregation tailoring commControllerMapping: in-scope=false, multiplicity-restriction={severity=ERROR, lower-multiplicity=0, upper-multiplicity-infinite=true}
              reference tailoring ecu: in-scope=false, multiplicity-restriction={severity=ERROR, lower-multiplicity=0, upper-multiplicity=1}, unresolved-reference-restriction=severity=ERROR
              reference tailoring ecuInstance: in-scope=false, multiplicity-restriction={severity=ERROR, lower-multiplicity=0, upper-multiplicity=1}, unresolved-reference-restriction=severity=ERROR
              aggregation tailoring hwPortMapping: in-scope=false, multiplicity-restriction={severity=ERROR, lower-multiplicity=0, upper-multiplicity-infinite=true}
        EOCExecutableEntityRef
          class content conditional Invariant
            attribute-tailorings:
              aggregation tailoring component: in-scope=false, multiplicity-restriction={severity=ERROR, lower-multiplicity=0, upper-multiplicity=1}
              reference tailoring executable: in-scope=false, multiplicity-restriction={severity=ERROR, lower-multiplicity=0, upper-multiplicity=1}, unresolved-reference-restriction=severity=ERROR
              reference tailoring successor: in-scope=false, multiplicity-restriction={severity=ERROR, lower-multiplicity=0, upper-multiplicity-infinite=true}, unresolved-reference-restriction=severity=ERROR
        EcuAbstractionSwComponentType
          class content conditional Invariant
            attribute-tailorings:
              reference tailoring hardwareElement: in-scope=false, multiplicity-restriction={severity=ERROR, lower-multiplicity=0, upper-multiplicity-infinite=true}, unresolved-reference-restriction=severity=ERROR
        EcuInstance
          class content conditional Invariant
            attribute-tailorings:
              reference tailoring associatedComIPduGroup: in-scope=false, multiplicity-restriction={severity=ERROR, lower-multiplicity=0, upper-multiplicity-infinite=true}, unresolved-reference-restriction=severity=ERROR
              reference tailoring associatedPdurIPduGroup: in-scope=false, multiplicity-restriction={severity=ERROR, lower-multiplicity=0, upper-multiplicity-infinite=true}, unresolved-reference-restriction=severity=ERROR
              reference tailoring canTpAddress: in-scope=false, multiplicity-restriction={severity=ERROR, lower-multiplicity=0, upper-multiplicity-infinite=true}, unresolved-reference-restriction=severity=ERROR
              4 x primitive attribute tailoring, all with in-scope=false, multiplicity-restriction={severity=ERROR, lower-multiplicity=0, upper-multiplicity=1}, default-value-handling=NO-DEFAULT:
                comConfigurationGwTimeBase
                comConfigurationRxTimeBase
                comConfigurationTxTimeBase
                comEnableMDTForCyclicTransmission
              aggregation tailoring commController: in-scope=false, multiplicity-restriction={severity=ERROR, lower-multiplicity=0, upper-multiplicity-infinite=true}
              aggregation tailoring connector: in-scope=false, multiplicity-restriction={severity=ERROR, lower-multiplicity=0, upper-multiplicity-infinite=true}
              primitive attribute tailoring diagnosticAddress: in-scope=false, multiplicity-restriction={severity=ERROR, lower-multiplicity=0, upper-multiplicity=1}, default-value-handling=NO-DEFAULT
              aggregation tailoring partition: in-scope=false, multiplicity-restriction={severity=ERROR, lower-multiplicity=0, upper-multiplicity-infinite=true}
              primitive attribute tailoring sleepModeSupported: in-scope=false, multiplicity-restriction={severity=ERROR, lower-multiplicity=0, upper-multiplicity=1}, default-value-handling=NO-DEFAULT
              reference tailoring tpAddress: in-scope=false, multiplicity-restriction={severity=ERROR, lower-multiplicity=0, upper-multiplicity-infinite=true}, unresolved-reference-restriction=severity=ERROR
              primitive attribute tailoring wakeUpOverBusSupported: in-scope=false, multiplicity-restriction={severity=ERROR, lower-multiplicity=0, upper-multiplicity=1}, default-value-handling=NO-DEFAULT
        EcuPartition
          class content conditional Invariant
            primitive attribute tailoring execInUserMode: in-scope=false, multiplicity-restriction={severity=ERROR, lower-multiplicity=0, upper-multiplicity=1}, default-value-handling=NO-DEFAULT
        EcuResourceEstimation
          class content conditional Invariant
            attribute-tailorings:
              aggregation tailoring bswResourceEstimation: in-scope=false, multiplicity-restriction={severity=ERROR, lower-multiplicity=0, upper-multiplicity=1}
              reference tailoring ecuInstance: in-scope=false, multiplicity-restriction={severity=ERROR, lower-multiplicity=0, upper-multiplicity=1}, unresolved-reference-restriction=severity=ERROR
              aggregation tailoring introduction: in-scope=false, multiplicity-restriction={severity=ERROR, lower-multiplicity=0, upper-multiplicity=1}
              aggregation tailoring rteResourceEstimation: in-scope=false, multiplicity-restriction={severity=ERROR, lower-multiplicity=0, upper-multiplicity=1}
              reference tailoring swCompToEcuMapping: in-scope=false, multiplicity-restriction={severity=ERROR, lower-multiplicity=0, upper-multiplicity-infinite=true}, unresolved-reference-restriction=severity=ERROR
        EcuStateMgrUserNeeds
          class content conditional Invariant
        EcuTiming
          class content conditional Invariant
            attribute-tailorings:
              reference tailoring ecuConfiguration: in-scope=false, multiplicity-restriction={severity=ERROR, lower-multiplicity=0, upper-multiplicity=1}, unresolved-reference-restriction=severity=ERROR
      abstract class tailoring EcucAbstractReferenceDef: multiplicity-restriction={severity=INFO, lower-multiplicity=0, upper-multiplicity-infinite=true}
        class content conditional Invariant
      abstract class tailoring EcucAbstractReferenceValue: multiplicity-restriction={severity=INFO, lower-multiplicity=0, upper-multiplicity-infinite=true}
        class content conditional Invariant
          attribute-tailorings:
            aggregation tailoring annotation: in-scope=false, multiplicity-restriction={severity=ERROR, lower-multiplicity=0, upper-multiplicity-infinite=true}
            reference tailoring definition: in-scope=false, multiplicity-restriction={severity=ERROR, lower-multiplicity=0, upper-multiplicity=1}, unresolved-reference-restriction=severity=ERROR
      abstract class tailoring EcucAbstractStringParamDef: multiplicity-restriction={severity=INFO, lower-multiplicity=0, upper-multiplicity-infinite=true}, variation-restriction={severity=ERROR, variation=true, valid-binding-times=[BLUEPRINT-DERIVATION-TIME, SYSTEM-DESIGN-TIME, CODE-GENERATION-TIME, PRE-COMPILE-TIME, LINK-TIME, POST-BUILD]}
        class content conditional Invariant
          4 x primitive attribute tailoring, all with in-scope=false, multiplicity-restriction={severity=ERROR, lower-multiplicity=0, upper-multiplicity=1}, default-value-handling=NO-DEFAULT:
            defaultValue
            maxLength
            minLength
            regularExpression
      5 x concrete class tailoring, all with in-scope=false, multiplicity-restriction={severity=INFO, lower-multiplicity=0, upper-multiplicity-infinite=true}, validation-root=false:
        EcucAddInfoParamDef
          class content conditional Invariant
        EcucAddInfoParamValue
          class content conditional Invariant
            attribute-tailorings:
              aggregation tailoring value: in-scope=false, multiplicity-restriction={severity=ERROR, lower-multiplicity=0, upper-multiplicity=1}
        EcucBooleanParamDef
          class content conditional Invariant
            primitive attribute tailoring defaultValue: in-scope=false, multiplicity-restriction={severity=ERROR, lower-multiplicity=0, upper-multiplicity=1}, variation-restriction={severity=ERROR, variation=true, valid-binding-times=[BLUEPRINT-DERIVATION-TIME, SYSTEM-DESIGN-TIME, CODE-GENERATION-TIME, PRE-COMPILE-TIME, LINK-TIME, POST-BUILD]}, default-value-handling=NO-DEFAULT
        EcucChoiceContainerDef
          class content conditional Invariant
            attribute-tailorings:
              aggregation tailoring choice: in-scope=false, multiplicity-restriction={severity=ERROR, lower-multiplicity=0, upper-multiplicity-infinite=true}
        EcucChoiceReferenceDef
          class content conditional Invariant
            attribute-tailorings:
              reference tailoring destination: in-scope=false, multiplicity-restriction={severity=ERROR, lower-multiplicity=0, upper-multiplicity-infinite=true}, unresolved-reference-restriction=severity=ERROR
      abstract class tailoring EcucCommonAttributes: multiplicity-restriction={severity=INFO, lower-multiplicity=0, upper-multiplicity-infinite=true}
        class content conditional Invariant
          attribute-tailorings:
            aggregation tailoring configurationClassAffection: in-scope=false, multiplicity-restriction={severity=ERROR, lower-multiplicity=0, upper-multiplicity=1}
            aggregation tailoring implementationConfigClass: in-scope=false, multiplicity-restriction={severity=ERROR, lower-multiplicity=0, upper-multiplicity-infinite=true}
            primitive attribute tailoring origin: in-scope=false, multiplicity-restriction={severity=ERROR, lower-multiplicity=0, upper-multiplicity=1}, default-value-handling=NO-DEFAULT
            primitive attribute tailoring requiresIndex: in-scope=false, multiplicity-restriction={severity=ERROR, lower-multiplicity=0, upper-multiplicity=1}, default-value-handling=NO-DEFAULT
      concrete class tailoring EcucConditionFormula: in-scope=false, multiplicity-restriction={severity=INFO, lower-multiplicity=0, upper-multiplicity-infinite=true}, validation-root=false
        class content conditional Invariant
          attribute-tailorings:
            reference tailoring ecucQuery: in-scope=false, multiplicity-restriction={severity=ERROR, lower-multiplicity=0, upper-multiplicity=1}, unresolved-reference-restriction=severity=ERROR
            reference tailoring ecucQueryString: in-scope=false, multiplicity-restriction={severity=ERROR, lower-multiplicity=0, upper-multiplicity=1}, unresolved-reference-restriction=severity=ERROR
      concrete class tailoring EcucConditionSpecification: in-scope=false, multiplicity-restriction={severity=INFO, lower-multiplicity=0, upper-multiplicity-infinite=true}, validation-root=false
        class content conditional Invariant
          attribute-tailorings:
            aggregation tailoring conditionFormula: in-scope=false, multiplicity-restriction={severity=ERROR, lower-multiplicity=0, upper-multiplicity=1}
            aggregation tailoring ecucQuery: in-scope=false, multiplicity-restriction={severity=ERROR, lower-multiplicity=0, upper-multiplicity-infinite=true}
            aggregation tailoring informalFormula: in-scope=false, multiplicity-restriction={severity=ERROR, lower-multiplicity=0, upper-multiplicity=1}
      concrete class tailoring EcucConfigurationClassAffection: in-scope=false, multiplicity-restriction={severity=INFO, lower-multiplicity=0, upper-multiplicity-infinite=true}, validation-root=false
        class content conditional Invariant
          attribute-tailorings:
            reference tailoring affected: in-scope=false, multiplicity-restriction={severity=ERROR, lower-multiplicity=0, upper-multiplicity-infinite=true}, unresolved-reference-restriction=severity=ERROR
            primitive attribute tailoring affectionKind: in-scope=false, multiplicity-restriction={severity=WARNING, lower-multiplicity=0, upper-multiplicity=0}, default-value-handling=NO-DEFAULT  # Spec element has lifecycle state 'obsolete'.
      abstract class tailoring EcucContainerDef: multiplicity-restriction={severity=INFO, lower-multiplicity=0, upper-multiplicity-infinite=true}
        class content conditional Invariant
          primitive attribute tailoring postBuildChangeable: in-scope=false, multiplicity-restriction={severity=ERROR, lower-multiplicity=0, upper-multiplicity=1}, default-value-handling=NO-DEFAULT
      concrete class tailoring EcucContainerValue: in-scope=false, multiplicity-restriction={severity=INFO, lower-multiplicity=0, upper-multiplicity-infinite=true}, validation-root=false
        class content conditional Invariant
          attribute-tailorings:
            reference tailoring definition: in-scope=false, multiplicity-restriction={severity=ERROR, lower-multiplicity=0, upper-multiplicity=1}, unresolved-reference-restriction=severity=ERROR
            aggregation tailoring parameterValue: in-scope=false, multiplicity-restriction={severity=ERROR, lower-multiplicity=0, upper-multiplicity-infinite=true}, variation-restriction={severity=ERROR, variation=true, valid-binding-times=[BLUEPRINT-DERIVATION-TIME, SYSTEM-DESIGN-TIME, CODE-GENERATION-TIME, PRE-COMPILE-TIME, LINK-TIME, POST-BUILD]}
            aggregation tailoring referenceValue: in-scope=false, multiplicity-restriction={severity=ERROR, lower-multiplicity=0, upper-multiplicity-infinite=true}, variation-restriction={severity=ERROR, variation=true, valid-binding-times=[BLUEPRINT-DERIVATION-TIME, SYSTEM-DESIGN-TIME, CODE-GENERATION-TIME, PRE-COMPILE-TIME, LINK-TIME, POST-BUILD]}
            aggregation tailoring subContainer: in-scope=false, multiplicity-restriction={severity=ERROR, lower-multiplicity=0, upper-multiplicity-infinite=true}, variation-restriction={severity=ERROR, variation=true, valid-binding-times=[BLUEPRINT-DERIVATION-TIME, SYSTEM-DESIGN-TIME, CODE-GENERATION-TIME, PRE-COMPILE-TIME, LINK-TIME, POST-BUILD]}
      concrete class tailoring EcucDefinitionCollection: in-scope=false, multiplicity-restriction={severity=INFO, lower-multiplicity=0, upper-multiplicity-infinite=true}, validation-root=false
        class content conditional Invariant
          attribute-tailorings:
            reference tailoring module: in-scope=false, multiplicity-restriction={severity=ERROR, lower-multiplicity=0, upper-multiplicity-infinite=true}, unresolved-reference-restriction=severity=ERROR
      abstract class tailoring EcucDefinitionElement: multiplicity-restriction={severity=INFO, lower-multiplicity=0, upper-multiplicity-infinite=true}
        class content conditional Invariant
          attribute-tailorings:
            aggregation tailoring ecucCond: in-scope=false, multiplicity-restriction={severity=ERROR, lower-multiplicity=0, upper-multiplicity=1}
            primitive attribute tailoring lowerMultiplicity: in-scope=false, multiplicity-restriction={severity=ERROR, lower-multiplicity=0, upper-multiplicity=1}, variation-restriction={severity=ERROR, variation=true, valid-binding-times=[BLUEPRINT-DERIVATION-TIME, SYSTEM-DESIGN-TIME, CODE-GENERATION-TIME, PRE-COMPILE-TIME, LINK-TIME, POST-BUILD]}, default-value-handling=NO-DEFAULT
            primitive attribute tailoring upperMultiplicity: in-scope=false, multiplicity-restriction={severity=ERROR, lower-multiplicity=0, upper-multiplicity=1}, variation-restriction={severity=ERROR, variation=true, valid-binding-times=[BLUEPRINT-DERIVATION-TIME, SYSTEM-DESIGN-TIME, CODE-GENERATION-TIME, PRE-COMPILE-TIME, LINK-TIME, POST-BUILD]}, default-value-handling=NO-DEFAULT
            primitive attribute tailoring upperMultiplicityInfinite: in-scope=false, multiplicity-restriction={severity=ERROR, lower-multiplicity=0, upper-multiplicity=1}, variation-restriction={severity=ERROR, variation=true, valid-binding-times=[BLUEPRINT-DERIVATION-TIME, SYSTEM-DESIGN-TIME, CODE-GENERATION-TIME, PRE-COMPILE-TIME, LINK-TIME, POST-BUILD]}, default-value-handling=NO-DEFAULT
      7 x concrete class tailoring, all with in-scope=false, multiplicity-restriction={severity=INFO, lower-multiplicity=0, upper-multiplicity-infinite=true}, validation-root=false:
        EcucDerivationSpecification
          class content conditional Invariant
            attribute-tailorings:
              aggregation tailoring calculationFormula: in-scope=false, multiplicity-restriction={severity=ERROR, lower-multiplicity=0, upper-multiplicity=1}
              aggregation tailoring ecucQuery: in-scope=false, multiplicity-restriction={severity=ERROR, lower-multiplicity=0, upper-multiplicity-infinite=true}
              aggregation tailoring informalFormula: in-scope=false, multiplicity-restriction={severity=ERROR, lower-multiplicity=0, upper-multiplicity=1}
        EcucEnumerationLiteralDef
          class content conditional Invariant
            attribute-tailorings:
              aggregation tailoring ecucCond: in-scope=false, multiplicity-restriction={severity=ERROR, lower-multiplicity=0, upper-multiplicity=1}
              primitive attribute tailoring origin: in-scope=false, multiplicity-restriction={severity=ERROR, lower-multiplicity=0, upper-multiplicity=1}, default-value-handling=NO-DEFAULT
        EcucEnumerationParamDef
          class content conditional Invariant
            attribute-tailorings:
              primitive attribute tailoring defaultValue: in-scope=false, multiplicity-restriction={severity=ERROR, lower-multiplicity=0, upper-multiplicity=1}, default-value-handling=NO-DEFAULT
                sub-attribute-tailorings:
                  primitive attribute tailoring namePattern: in-scope=false, multiplicity-restriction={severity=ERROR, lower-multiplicity=0, upper-multiplicity=1}, default-value-handling=NO-DEFAULT
              aggregation tailoring literal: in-scope=false, multiplicity-restriction={severity=ERROR, lower-multiplicity=0, upper-multiplicity-infinite=true}
        EcucFloatParamDef
          class content conditional Invariant
            primitive attribute tailoring defaultValue: in-scope=false, multiplicity-restriction={severity=ERROR, lower-multiplicity=0, upper-multiplicity=1}, variation-restriction={severity=ERROR, variation=true, valid-binding-times=[BLUEPRINT-DERIVATION-TIME, SYSTEM-DESIGN-TIME, CODE-GENERATION-TIME, PRE-COMPILE-TIME, LINK-TIME, POST-BUILD]}, default-value-handling=NO-DEFAULT
            primitive attribute tailoring max: in-scope=false, multiplicity-restriction={severity=ERROR, lower-multiplicity=0, upper-multiplicity=1}, variation-restriction={severity=ERROR, variation=true, valid-binding-times=[BLUEPRINT-DERIVATION-TIME, SYSTEM-DESIGN-TIME, CODE-GENERATION-TIME, PRE-COMPILE-TIME, LINK-TIME, POST-BUILD]}, default-value-handling=NO-DEFAULT
            primitive attribute tailoring min: in-scope=false, multiplicity-restriction={severity=ERROR, lower-multiplicity=0, upper-multiplicity=1}, variation-restriction={severity=ERROR, variation=true, valid-binding-times=[BLUEPRINT-DERIVATION-TIME, SYSTEM-DESIGN-TIME, CODE-GENERATION-TIME, PRE-COMPILE-TIME, LINK-TIME, POST-BUILD]}, default-value-handling=NO-DEFAULT
        EcucForeignReferenceDef
          class content conditional Invariant
            primitive attribute tailoring destinationType: in-scope=false, multiplicity-restriction={severity=ERROR, lower-multiplicity=0, upper-multiplicity=1}, default-value-handling=NO-DEFAULT
        EcucFunctionNameDef
          class content conditional Invariant
        EcucImplementationConfigurationClass
          class content conditional Invariant
            primitive attribute tailoring configClass: in-scope=false, multiplicity-restriction={severity=ERROR, lower-multiplicity=0, upper-multiplicity=1}, default-value-handling=NO-DEFAULT
            primitive attribute tailoring configVariant: in-scope=false, multiplicity-restriction={severity=ERROR, lower-multiplicity=0, upper-multiplicity=1}, default-value-handling=NO-DEFAULT
      abstract class tailoring EcucIndexableValue: multiplicity-restriction={severity=INFO, lower-multiplicity=0, upper-multiplicity-infinite=true}
        class content conditional Invariant
          primitive attribute tailoring index: in-scope=false, multiplicity-restriction={severity=ERROR, lower-multiplicity=0, upper-multiplicity=1}, default-value-handling=NO-DEFAULT
      9 x concrete class tailoring, all with in-scope=false, multiplicity-restriction={severity=INFO, lower-multiplicity=0, upper-multiplicity-infinite=true}, validation-root=false:
        EcucInstanceReferenceDef
          class content conditional Invariant
            primitive attribute tailoring destinationContext: in-scope=false, multiplicity-restriction={severity=ERROR, lower-multiplicity=0, upper-multiplicity=1}, default-value-handling=NO-DEFAULT
            primitive attribute tailoring destinationType: in-scope=false, multiplicity-restriction={severity=ERROR, lower-multiplicity=0, upper-multiplicity=1}, default-value-handling=NO-DEFAULT
        EcucInstanceReferenceValue
          class content conditional Invariant
            attribute-tailorings:
              aggregation tailoring value: in-scope=false, multiplicity-restriction={severity=ERROR, lower-multiplicity=0, upper-multiplicity=1}
        EcucIntegerParamDef
          class content conditional Invariant
            primitive attribute tailoring defaultValue: in-scope=false, multiplicity-restriction={severity=ERROR, lower-multiplicity=0, upper-multiplicity=1}, variation-restriction={severity=ERROR, variation=true, valid-binding-times=[BLUEPRINT-DERIVATION-TIME, SYSTEM-DESIGN-TIME, CODE-GENERATION-TIME, PRE-COMPILE-TIME, LINK-TIME, POST-BUILD]}, default-value-handling=NO-DEFAULT
            primitive attribute tailoring max: in-scope=false, multiplicity-restriction={severity=ERROR, lower-multiplicity=0, upper-multiplicity=1}, variation-restriction={severity=ERROR, variation=true, valid-binding-times=[BLUEPRINT-DERIVATION-TIME, SYSTEM-DESIGN-TIME, CODE-GENERATION-TIME, PRE-COMPILE-TIME, LINK-TIME, POST-BUILD]}, default-value-handling=NO-DEFAULT
            primitive attribute tailoring min: in-scope=false, multiplicity-restriction={severity=ERROR, lower-multiplicity=0, upper-multiplicity=1}, variation-restriction={severity=ERROR, variation=true, valid-binding-times=[BLUEPRINT-DERIVATION-TIME, SYSTEM-DESIGN-TIME, CODE-GENERATION-TIME, PRE-COMPILE-TIME, LINK-TIME, POST-BUILD]}, default-value-handling=NO-DEFAULT
        EcucLinkerSymbolDef
          class content conditional Invariant
        EcucModuleConfigurationValues
          class content conditional Invariant
            attribute-tailorings:
              aggregation tailoring container: in-scope=false, multiplicity-restriction={severity=ERROR, lower-multiplicity=0, upper-multiplicity-infinite=true}, variation-restriction={severity=ERROR, variation=true, valid-binding-times=[BLUEPRINT-DERIVATION-TIME, SYSTEM-DESIGN-TIME, CODE-GENERATION-TIME, PRE-COMPILE-TIME, LINK-TIME, POST-BUILD]}
              reference tailoring definition: in-scope=false, multiplicity-restriction={severity=ERROR, lower-multiplicity=0, upper-multiplicity=1}, unresolved-reference-restriction=severity=ERROR
              primitive attribute tailoring ecucDefEdition: in-scope=false, multiplicity-restriction={severity=ERROR, lower-multiplicity=0, upper-multiplicity=1}, default-value-handling=NO-DEFAULT
              primitive attribute tailoring implementationConfigVariant: in-scope=false, multiplicity-restriction={severity=ERROR, lower-multiplicity=0, upper-multiplicity=1}, default-value-handling=NO-DEFAULT
              reference tailoring moduleDescription: in-scope=false, multiplicity-restriction={severity=ERROR, lower-multiplicity=0, upper-multiplicity=1}, unresolved-reference-restriction=severity=ERROR
        EcucModuleDef
          class content conditional Invariant
            attribute-tailorings:
              primitive attribute tailoring apiServicePrefix: in-scope=false, multiplicity-restriction={severity=ERROR, lower-multiplicity=0, upper-multiplicity=1}, default-value-handling=NO-DEFAULT
                sub-attribute-tailorings:
                  primitive attribute tailoring namePattern: in-scope=false, multiplicity-restriction={severity=ERROR, lower-multiplicity=0, upper-multiplicity=1}, default-value-handling=NO-DEFAULT
              aggregation tailoring container: in-scope=false, multiplicity-restriction={severity=ERROR, lower-multiplicity=0, upper-multiplicity-infinite=true}
              reference tailoring refinedModuleDef: in-scope=false, multiplicity-restriction={severity=ERROR, lower-multiplicity=0, upper-multiplicity=1}, unresolved-reference-restriction=severity=ERROR
              primitive attribute tailoring supportedConfigVariant: in-scope=false, multiplicity-restriction={severity=ERROR, lower-multiplicity=0, upper-multiplicity-infinite=true}, default-value-handling=NO-DEFAULT
        EcucMultilineStringParamDef
          class content conditional Invariant
        EcucNumericalParamValue
          class content conditional Invariant
            primitive attribute tailoring value: in-scope=false, multiplicity-restriction={severity=ERROR, lower-multiplicity=0, upper-multiplicity=1}, variation-restriction={severity=ERROR, variation=true, valid-binding-times=[BLUEPRINT-DERIVATION-TIME, SYSTEM-DESIGN-TIME, CODE-GENERATION-TIME, PRE-COMPILE-TIME, LINK-TIME, POST-BUILD]}, default-value-handling=NO-DEFAULT
        EcucParamConfContainerDef
          class content conditional Invariant
            attribute-tailorings:
              primitive attribute tailoring multipleConfigurationContainer: in-scope=false, multiplicity-restriction={severity=ERROR, lower-multiplicity=0, upper-multiplicity=1}, default-value-handling=NO-DEFAULT
              aggregation tailoring parameter: in-scope=false, multiplicity-restriction={severity=ERROR, lower-multiplicity=0, upper-multiplicity-infinite=true}
              aggregation tailoring reference: in-scope=false, multiplicity-restriction={severity=ERROR, lower-multiplicity=0, upper-multiplicity-infinite=true}
              aggregation tailoring subContainer: in-scope=false, multiplicity-restriction={severity=ERROR, lower-multiplicity=0, upper-multiplicity-infinite=true}
      abstract class tailoring EcucParameterDef: multiplicity-restriction={severity=INFO, lower-multiplicity=0, upper-multiplicity-infinite=true}
        class content conditional Invariant
          attribute-tailorings:
            aggregation tailoring derivation: in-scope=false, multiplicity-restriction={severity=ERROR, lower-multiplicity=0, upper-multiplicity=1}
            primitive attribute tailoring symbolicNameValue: in-scope=false, multiplicity-restriction={severity=ERROR, lower-multiplicity=0, upper-multiplicity=1}, default-value-handling=NO-DEFAULT
            primitive attribute tailoring withAuto: in-scope=false, multiplicity-restriction={severity=ERROR, lower-multiplicity=0, upper-multiplicity=1}, default-value-handling=NO-DEFAULT
      concrete class tailoring EcucParameterDerivationFormula: in-scope=false, multiplicity-restriction={severity=INFO, lower-multiplicity=0, upper-multiplicity-infinite=true}, validation-root=false
        class content conditional Invariant
          attribute-tailorings:
            reference tailoring ecucQuery: in-scope=false, multiplicity-restriction={severity=ERROR, lower-multiplicity=0, upper-multiplicity-infinite=true}, unresolved-reference-restriction=severity=ERROR  # Multiplicity is 0..* since attribute is contained in mixed / mixedString class.
            reference tailoring ecucQueryString: in-scope=false, multiplicity-restriction={severity=ERROR, lower-multiplicity=0, upper-multiplicity-infinite=true}, unresolved-reference-restriction=severity=ERROR  # Multiplicity is 0..* since attribute is contained in mixed / mixedString class.
      abstract class tailoring EcucParameterValue: multiplicity-restriction={severity=INFO, lower-multiplicity=0, upper-multiplicity-infinite=true}
        class content conditional Invariant
          attribute-tailorings:
            aggregation tailoring annotation: in-scope=false, multiplicity-restriction={severity=ERROR, lower-multiplicity=0, upper-multiplicity-infinite=true}
            reference tailoring definition: in-scope=false, multiplicity-restriction={severity=ERROR, lower-multiplicity=0, upper-multiplicity=1}, unresolved-reference-restriction=severity=ERROR
            primitive attribute tailoring isAutoValue: in-scope=false, multiplicity-restriction={severity=ERROR, lower-multiplicity=0, upper-multiplicity=1}, default-value-handling=NO-DEFAULT
      15 x concrete class tailoring, all with in-scope=false, multiplicity-restriction={severity=INFO, lower-multiplicity=0, upper-multiplicity-infinite=true}, validation-root=false:
        EcucQuery
          class content conditional Invariant
            attribute-tailorings:
              aggregation tailoring ecucQueryExpression: in-scope=false, multiplicity-restriction={severity=ERROR, lower-multiplicity=0, upper-multiplicity=1}
        EcucQueryExpression
          class content conditional Invariant
            attribute-tailorings:
              reference tailoring configElementDefGlobal: in-scope=false, multiplicity-restriction={severity=ERROR, lower-multiplicity=0, upper-multiplicity-infinite=true}, unresolved-reference-restriction=severity=ERROR  # Multiplicity is 0..* since attribute is contained in mixed / mixedString class.
              reference tailoring configElementDefLocal: in-scope=false, multiplicity-restriction={severity=ERROR, lower-multiplicity=0, upper-multiplicity-infinite=true}, unresolved-reference-restriction=severity=ERROR  # Multiplicity is 0..* since attribute is contained in mixed / mixedString class.
        EcucReferenceDef
          class content conditional Invariant
            attribute-tailorings:
              reference tailoring destination: in-scope=false, multiplicity-restriction={severity=ERROR, lower-multiplicity=0, upper-multiplicity=1}, unresolved-reference-restriction=severity=ERROR
        EcucReferenceValue
          class content conditional Invariant
            attribute-tailorings:
              reference tailoring value: in-scope=false, multiplicity-restriction={severity=ERROR, lower-multiplicity=0, upper-multiplicity=1}, unresolved-reference-restriction=severity=ERROR
        EcucStringParamDef
          class content conditional Invariant
        EcucSymbolicNameReferenceDef
          class content conditional Invariant
            attribute-tailorings:
              reference tailoring destination: in-scope=false, multiplicity-restriction={severity=ERROR, lower-multiplicity=0, upper-multiplicity=1}, unresolved-reference-restriction=severity=ERROR
        EcucTextualParamValue
          class content conditional Invariant
            primitive attribute tailoring value: in-scope=false, multiplicity-restriction={severity=ERROR, lower-multiplicity=0, upper-multiplicity=1}, default-value-handling=NO-DEFAULT
        EcucValueCollection
          class content conditional Invariant
            attribute-tailorings:
              reference tailoring ecuExtract: in-scope=false, multiplicity-restriction={severity=ERROR, lower-multiplicity=0, upper-multiplicity=1}, unresolved-reference-restriction=severity=ERROR
              reference tailoring ecucValue: in-scope=false, multiplicity-restriction={severity=ERROR, lower-multiplicity=0, upper-multiplicity-infinite=true}, variation-restriction={severity=ERROR, variation=true, valid-binding-times=[BLUEPRINT-DERIVATION-TIME, SYSTEM-DESIGN-TIME, CODE-GENERATION-TIME, PRE-COMPILE-TIME, LINK-TIME, POST-BUILD]}, unresolved-reference-restriction=severity=ERROR
        EmphasisText
          class content conditional Invariant
            5 x primitive attribute tailoring, all with in-scope=false, multiplicity-restriction={severity=ERROR, lower-multiplicity=0, upper-multiplicity-infinite=true}, default-value-handling=NO-DEFAULT:
              color  # Multiplicity is 0..* since attribute is contained in mixed / mixedString class.
              font  # Multiplicity is 0..* since attribute is contained in mixed / mixedString class.
              sub  # Multiplicity is 0..* since attribute is contained in mixed / mixedString class.
              sup  # Multiplicity is 0..* since attribute is contained in mixed / mixedString class.
              type  # Multiplicity is 0..* since attribute is contained in mixed / mixedString class.
        EmptySignalMapping
          class content conditional Invariant
            attribute-tailorings:
              reference tailoring systemSignal: in-scope=false, multiplicity-restriction={severity=ERROR, lower-multiplicity=0, upper-multiplicity=1}, unresolved-reference-restriction=severity=ERROR
        EndToEndDescription
          class content conditional Invariant
            7 x primitive attribute tailoring, all with in-scope=false, default-value-handling=NO-DEFAULT:
              category: multiplicity-restriction={severity=ERROR, lower-multiplicity=0, upper-multiplicity=1}
              counterOffset: multiplicity-restriction={severity=ERROR, lower-multiplicity=0, upper-multiplicity=1}
              crcOffset: multiplicity-restriction={severity=ERROR, lower-multiplicity=0, upper-multiplicity=1}
              dataId: multiplicity-restriction={severity=ERROR, lower-multiplicity=0, upper-multiplicity-infinite=true}
              dataIdMode: multiplicity-restriction={severity=ERROR, lower-multiplicity=0, upper-multiplicity=1}
              dataLength: multiplicity-restriction={severity=ERROR, lower-multiplicity=0, upper-multiplicity=1}
              maxDeltaCounterInit: multiplicity-restriction={severity=ERROR, lower-multiplicity=0, upper-multiplicity=1}
        EndToEndProtection
          class content conditional Invariant
            attribute-tailorings:
              aggregation tailoring endToEndProfile: in-scope=false, multiplicity-restriction={severity=ERROR, lower-multiplicity=0, upper-multiplicity=1}
              aggregation tailoring endToEndProtectionISignalIPdu: in-scope=false, multiplicity-restriction={severity=ERROR, lower-multiplicity=0, upper-multiplicity-infinite=true}, variation-restriction={severity=ERROR, variation=true, valid-binding-times=[BLUEPRINT-DERIVATION-TIME, SYSTEM-DESIGN-TIME, CODE-GENERATION-TIME, PRE-COMPILE-TIME, LINK-TIME, POST-BUILD]}
              aggregation tailoring endToEndProtectionVariablePrototype: in-scope=false, multiplicity-restriction={severity=ERROR, lower-multiplicity=0, upper-multiplicity-infinite=true}, variation-restriction={severity=ERROR, variation=true, valid-binding-times=[BLUEPRINT-DERIVATION-TIME, SYSTEM-DESIGN-TIME, CODE-GENERATION-TIME, PRE-COMPILE-TIME, LINK-TIME, POST-BUILD]}
        EndToEndProtectionISignalIPdu
          class content conditional Invariant
            attribute-tailorings:
              primitive attribute tailoring dataOffset: in-scope=false, multiplicity-restriction={severity=ERROR, lower-multiplicity=0, upper-multiplicity=1}, default-value-handling=NO-DEFAULT
              reference tailoring iSignalGroup: in-scope=false, multiplicity-restriction={severity=ERROR, lower-multiplicity=0, upper-multiplicity=1}, unresolved-reference-restriction=severity=ERROR
              reference tailoring iSignalIPdu: in-scope=false, multiplicity-restriction={severity=ERROR, lower-multiplicity=0, upper-multiplicity=1}, unresolved-reference-restriction=severity=ERROR
        EndToEndProtectionSet
          class content conditional Invariant
            attribute-tailorings:
              aggregation tailoring endToEndProtection: in-scope=false, multiplicity-restriction={severity=ERROR, lower-multiplicity=0, upper-multiplicity-infinite=true}, variation-restriction={severity=ERROR, variation=true, valid-binding-times=[BLUEPRINT-DERIVATION-TIME, SYSTEM-DESIGN-TIME, CODE-GENERATION-TIME, PRE-COMPILE-TIME, LINK-TIME, POST-BUILD]}
        EndToEndProtectionVariablePrototype
          class content conditional Invariant
            attribute-tailorings:
              aggregation tailoring receiver: in-scope=false, multiplicity-restriction={severity=ERROR, lower-multiplicity=0, upper-multiplicity-infinite=true}
              aggregation tailoring sender: in-scope=false, multiplicity-restriction={severity=ERROR, lower-multiplicity=0, upper-multiplicity=1}
              primitive attribute tailoring shortLabel: in-scope=false, multiplicity-restriction={severity=ERROR, lower-multiplicity=0, upper-multiplicity=1}, default-value-handling=NO-DEFAULT
                sub-attribute-tailorings:
                  primitive attribute tailoring namePattern: in-scope=false, multiplicity-restriction={severity=ERROR, lower-multiplicity=0, upper-multiplicity=1}, default-value-handling=NO-DEFAULT
      abstract class tailoring EngineeringObject: multiplicity-restriction={severity=INFO, lower-multiplicity=0, upper-multiplicity-infinite=true}
        class content conditional Invariant
          4 x primitive attribute tailoring, all with in-scope=false, default-value-handling=NO-DEFAULT:
            category: multiplicity-restriction={severity=ERROR, lower-multiplicity=0, upper-multiplicity=1}
            domain: multiplicity-restriction={severity=ERROR, lower-multiplicity=0, upper-multiplicity=1}
            revisionLabel: multiplicity-restriction={severity=ERROR, lower-multiplicity=0, upper-multiplicity-infinite=true}
            shortLabel: multiplicity-restriction={severity=ERROR, lower-multiplicity=0, upper-multiplicity=1}
      9 x concrete class tailoring, all with in-scope=false, multiplicity-restriction={severity=INFO, lower-multiplicity=0, upper-multiplicity-infinite=true}, validation-root=false:
        Entry
          class content conditional Invariant
            attribute-tailorings:
              primitive attribute tailoring align: in-scope=false, multiplicity-restriction={severity=ERROR, lower-multiplicity=0, upper-multiplicity=1}, default-value-handling=NO-DEFAULT
              primitive attribute tailoring colname: in-scope=false, multiplicity-restriction={severity=ERROR, lower-multiplicity=0, upper-multiplicity=1}, default-value-handling=NO-DEFAULT
              primitive attribute tailoring colsep: in-scope=false, multiplicity-restriction={severity=ERROR, lower-multiplicity=0, upper-multiplicity=1}, default-value-handling=NO-DEFAULT
              aggregation tailoring entryContents: in-scope=false, multiplicity-restriction={severity=ERROR, lower-multiplicity=0, upper-multiplicity=1}
              7 x primitive attribute tailoring, all with in-scope=false, multiplicity-restriction={severity=ERROR, lower-multiplicity=0, upper-multiplicity=1}, default-value-handling=NO-DEFAULT:
                morerows
                nameend
                namest
                rotate
                rowsep
                spanname
                valign
        EthernetCluster
          class content conditional Invariant
        EthernetCommunicationConnector
          class content conditional Invariant
        EthernetCommunicationController
          class content conditional Invariant
            primitive attribute tailoring maximumReceiveBufferLength: in-scope=false, multiplicity-restriction={severity=ERROR, lower-multiplicity=0, upper-multiplicity=1}, default-value-handling=NO-DEFAULT
            primitive attribute tailoring maximumTransmitBufferLength: in-scope=false, multiplicity-restriction={severity=ERROR, lower-multiplicity=0, upper-multiplicity=1}, default-value-handling=NO-DEFAULT
        EthernetFrame
          class content conditional Invariant
        EthernetFrameTriggering
          class content conditional Invariant
        EthernetPhysicalChannel
          class content conditional Invariant
            attribute-tailorings:
              aggregation tailoring soAdConfig: in-scope=false, multiplicity-restriction={severity=ERROR, lower-multiplicity=0, upper-multiplicity=1}
        EvaluatedVariantSet
          class content conditional Invariant
            attribute-tailorings:
              primitive attribute tailoring approvalStatus: in-scope=false, multiplicity-restriction={severity=ERROR, lower-multiplicity=0, upper-multiplicity=1}, default-value-handling=NO-DEFAULT
              reference tailoring evaluatedElement: in-scope=false, multiplicity-restriction={severity=ERROR, lower-multiplicity=0, upper-multiplicity-infinite=true}, unresolved-reference-restriction=severity=ERROR
              reference tailoring evaluatedVariant: in-scope=false, multiplicity-restriction={severity=ERROR, lower-multiplicity=0, upper-multiplicity-infinite=true}, unresolved-reference-restriction=severity=ERROR
        EventControlledTiming
          class content conditional Invariant
            attribute-tailorings:
              primitive attribute tailoring numberOfRepetitions: in-scope=false, multiplicity-restriction={severity=ERROR, lower-multiplicity=0, upper-multiplicity=1}, default-value-handling=NO-DEFAULT
              aggregation tailoring repetitionPeriod: in-scope=false, multiplicity-restriction={severity=ERROR, lower-multiplicity=0, upper-multiplicity=1}
      abstract class tailoring EventTriggeringConstraint: multiplicity-restriction={severity=INFO, lower-multiplicity=0, upper-multiplicity-infinite=true}
        class content conditional Invariant
          attribute-tailorings:
            reference tailoring event: in-scope=false, multiplicity-restriction={severity=ERROR, lower-multiplicity=0, upper-multiplicity=1}, unresolved-reference-restriction=severity=ERROR
      concrete class tailoring ExclusiveArea: in-scope=false, multiplicity-restriction={severity=INFO, lower-multiplicity=0, upper-multiplicity-infinite=true}, validation-root=false
        class content conditional Invariant
      abstract class tailoring ExecutableEntity: multiplicity-restriction={severity=INFO, lower-multiplicity=0, upper-multiplicity-infinite=true}
        class content conditional Invariant
          attribute-tailorings:
            reference tailoring canEnterExclusiveArea: in-scope=false, multiplicity-restriction={severity=ERROR, lower-multiplicity=0, upper-multiplicity-infinite=true}, unresolved-reference-restriction=severity=ERROR
            primitive attribute tailoring minimumStartInterval: in-scope=false, multiplicity-restriction={severity=ERROR, lower-multiplicity=0, upper-multiplicity=1}, default-value-handling=NO-DEFAULT
            reference tailoring runsInsideExclusiveArea: in-scope=false, multiplicity-restriction={severity=ERROR, lower-multiplicity=0, upper-multiplicity-infinite=true}, unresolved-reference-restriction=severity=ERROR
            reference tailoring swAddrMethod: in-scope=false, multiplicity-restriction={severity=ERROR, lower-multiplicity=0, upper-multiplicity=1}, unresolved-reference-restriction=severity=ERROR
      concrete class tailoring ExecutionOrderConstraint: in-scope=false, multiplicity-restriction={severity=INFO, lower-multiplicity=0, upper-multiplicity-infinite=true}, validation-root=false
        class content conditional Invariant
          attribute-tailorings:
            aggregation tailoring orderedElement: in-scope=false, multiplicity-restriction={severity=ERROR, lower-multiplicity=0, upper-multiplicity-infinite=true}
      abstract class tailoring ExecutionTime: multiplicity-restriction={severity=INFO, lower-multiplicity=0, upper-multiplicity-infinite=true}
        class content conditional Invariant
          attribute-tailorings:
            reference tailoring exclusiveArea: in-scope=false, multiplicity-restriction={severity=ERROR, lower-multiplicity=0, upper-multiplicity=1}, unresolved-reference-restriction=severity=ERROR
            reference tailoring executableEntity: in-scope=false, multiplicity-restriction={severity=ERROR, lower-multiplicity=0, upper-multiplicity=1}, unresolved-reference-restriction=severity=ERROR
            aggregation tailoring hardwareConfiguration: in-scope=false, multiplicity-restriction={severity=ERROR, lower-multiplicity=0, upper-multiplicity=1}
            reference tailoring hwElement: in-scope=false, multiplicity-restriction={severity=ERROR, lower-multiplicity=0, upper-multiplicity=1}, unresolved-reference-restriction=severity=ERROR
            reference tailoring includedLibrary: in-scope=false, multiplicity-restriction={severity=ERROR, lower-multiplicity=0, upper-multiplicity-infinite=true}, unresolved-reference-restriction=severity=ERROR
            aggregation tailoring memorySectionLocation: in-scope=false, multiplicity-restriction={severity=ERROR, lower-multiplicity=0, upper-multiplicity-infinite=true}
            aggregation tailoring softwareContext: in-scope=false, multiplicity-restriction={severity=ERROR, lower-multiplicity=0, upper-multiplicity=1}
      4 x concrete class tailoring, all with in-scope=false, multiplicity-restriction={severity=INFO, lower-multiplicity=0, upper-multiplicity-infinite=true}, validation-root=false:
        ExecutionTimeConstraint
          class content conditional Invariant
            attribute-tailorings:
              aggregation tailoring component: in-scope=false, multiplicity-restriction={severity=ERROR, lower-multiplicity=0, upper-multiplicity=1}
              reference tailoring executable: in-scope=false, multiplicity-restriction={severity=ERROR, lower-multiplicity=0, upper-multiplicity=1}, unresolved-reference-restriction=severity=ERROR
              primitive attribute tailoring executionTimeType: in-scope=false, multiplicity-restriction={severity=ERROR, lower-multiplicity=0, upper-multiplicity=1}, default-value-handling=NO-DEFAULT
              aggregation tailoring maximum: in-scope=false, multiplicity-restriction={severity=ERROR, lower-multiplicity=0, upper-multiplicity=1}
              aggregation tailoring minimum: in-scope=false, multiplicity-restriction={severity=ERROR, lower-multiplicity=0, upper-multiplicity=1}
        ExternalTriggerOccurredEvent
          class content conditional Invariant
            attribute-tailorings:
              aggregation tailoring trigger: in-scope=false, multiplicity-restriction={severity=ERROR, lower-multiplicity=0, upper-multiplicity=1}
        ExternalTriggeringPoint
          class content conditional Invariant
            attribute-tailorings:
              aggregation tailoring trigger: in-scope=false, multiplicity-restriction={severity=ERROR, lower-multiplicity=0, upper-multiplicity=1}
        FailureManagement
          class content conditional Invariant
      abstract class tailoring FibexElement: multiplicity-restriction={severity=INFO, lower-multiplicity=0, upper-multiplicity-infinite=true}
        class content conditional Invariant
