[part 1 of 4: package /AUTOSAR/DataExchangePoints]
AUTOSAR XML (schema 00046)
package /AUTOSAR/DataExchangePoints
  data exchange point Default: kind=AGREED, referenced-baseline=standard-revisions=CP 4.1.3  # Profile of Default Data Exchange Point
    data-format-tailoring:
      abstract class tailoring ARElement: multiplicity-restriction={severity=INFO, lower-multiplicity=0, upper-multiplicity-infinite=true}
        class content conditional Invariant
      abstract class tailoring ARObject: multiplicity-restriction={severity=INFO, lower-multiplicity=0, upper-multiplicity-infinite=true}
        class content conditional Invariant
          primitive attribute tailoring checksum: in-scope=false, multiplicity-restriction={severity=ERROR, lower-multiplicity=0, upper-multiplicity=1}, default-value-handling=NO-DEFAULT
          primitive attribute tailoring timestamp: in-scope=false, multiplicity-restriction={severity=ERROR, lower-multiplicity=0, upper-multiplicity=1}, default-value-handling=NO-DEFAULT
      concrete class tailoring ARPackage: in-scope=false, multiplicity-restriction={severity=INFO, lower-multiplicity=0, upper-multiplicity-infinite=true}, validation-root=false
        class content conditional Invariant
          attribute-tailorings:
            aggregation tailoring arPackage: in-scope=false, multiplicity-restriction={severity=ERROR, lower-multiplicity=0, upper-multiplicity-infinite=true}, variation-restriction={severity=ERROR, variation=true, valid-binding-times=BLUEPRINT-DERIVATION-TIME}
            aggregation tailoring element: in-scope=false, multiplicity-restriction={severity=ERROR, lower-multiplicity=0, upper-multiplicity-infinite=true}, variation-restriction={severity=ERROR, variation=true, valid-binding-times=[BLUEPRINT-DERIVATION-TIME, SYSTEM-DESIGN-TIME]}
            aggregation tailoring referenceBase: in-scope=false, multiplicity-restriction={severity=ERROR, lower-multiplicity=0, upper-multiplicity-infinite=true}
      concrete class tailoring AUTOSAR: in-scope=false, multiplicity-restriction={severity=INFO, lower-multiplicity=0, upper-multiplicity-infinite=true}, validation-root=false
        class content conditional Invariant
          attribute-tailorings:
            aggregation tailoring adminData: in-scope=false, multiplicity-restriction={severity=ERROR, lower-multiplicity=0, upper-multiplicity=1}
            aggregation tailoring arPackage: in-scope=false, multiplicity-restriction={severity=ERROR, lower-multiplicity=0, upper-multiplicity-infinite=true}, variation-restriction={severity=ERROR, variation=true, valid-binding-times=BLUEPRINT-DERIVATION-TIME}
            aggregation tailoring introduction: in-scope=false, multiplicity-restriction={severity=ERROR, lower-multiplicity=0, upper-multiplicity=1}
      concrete class tailoring AbsoluteTolerance: in-scope=false, multiplicity-restriction={severity=INFO, lower-multiplicity=0, upper-multiplicity-infinite=true}, validation-root=false
        class content conditional Invariant
          primitive attribute tailoring absolute: in-scope=false, multiplicity-restriction={severity=ERROR, lower-multiplicity=0, upper-multiplicity=1}, default-value-handling=NO-DEFAULT
      11 x abstract class tailoring, all with multiplicity-restriction={severity=INFO, lower-multiplicity=0, upper-multiplicity-infinite=true}:
        AbstractCanCluster
          class content conditional Invariant
            primitive attribute tailoring canFdBaudrate: in-scope=false, multiplicity-restriction={severity=ERROR, lower-multiplicity=0, upper-multiplicity=1}, default-value-handling=NO-DEFAULT
        AbstractCanCommunicationConnector
          class content conditional Invariant
        AbstractCanCommunicationController
          class content conditional Invariant
            attribute-tailorings:
              aggregation tailoring canControllerAttributes: in-scope=false, multiplicity-restriction={severity=ERROR, lower-multiplicity=0, upper-multiplicity=1}
        AbstractCanCommunicationControllerAttributes
          class content conditional Invariant
            attribute-tailorings:
              aggregation tailoring canControllerFdAttributes: in-scope=false, multiplicity-restriction={severity=ERROR, lower-multiplicity=0, upper-multiplicity=1}
        AbstractCanPhysicalChannel
          class content conditional Invariant
        AbstractEvent
          class content conditional Invariant
            attribute-tailorings:
              reference tailoring activationReasonRepresentation: in-scope=false, multiplicity-restriction={severity=ERROR, lower-multiplicity=0, upper-multiplicity=1}, unresolved-reference-restriction=severity=ERROR
        AbstractNumericalVariationPoint
          class content conditional Invariant
        AbstractProvidedPortPrototype
          class content conditional Invariant
            attribute-tailorings:
              aggregation tailoring providedComSpec: in-scope=false, multiplicity-restriction={severity=ERROR, lower-multiplicity=0, upper-multiplicity-infinite=true}
        AbstractRequiredPortPrototype
          class content conditional Invariant
            attribute-tailorings:
              aggregation tailoring requiredComSpec: in-scope=false, multiplicity-restriction={severity=ERROR, lower-multiplicity=0, upper-multiplicity-infinite=true}
        AbstractRuleBasedValueSpecification
          class content conditional Invariant
        AbstractServiceInstance
          class content conditional Invariant
            attribute-tailorings:
              reference tailoring routingGroup: in-scope=false, multiplicity-restriction={severity=ERROR, lower-multiplicity=0, upper-multiplicity-infinite=true}, unresolved-reference-restriction=severity=ERROR
      13 x concrete class tailoring, all with in-scope=false, multiplicity-restriction={severity=INFO, lower-multiplicity=0, upper-multiplicity-infinite=true}, validation-root=false:
        AclObjectSet
          class content conditional Invariant
            attribute-tailorings:
              primitive attribute tailoring aclObjectClass: in-scope=false, multiplicity-restriction={severity=ERROR, lower-multiplicity=0, upper-multiplicity-infinite=true}, default-value-handling=NO-DEFAULT
              primitive attribute tailoring aclScope: in-scope=false, multiplicity-restriction={severity=ERROR, lower-multiplicity=0, upper-multiplicity=1}, default-value-handling=NO-DEFAULT
              reference tailoring collection: in-scope=false, multiplicity-restriction={severity=ERROR, lower-multiplicity=0, upper-multiplicity=1}, unresolved-reference-restriction=severity=ERROR
              reference tailoring derivedFromBlueprint: in-scope=false, multiplicity-restriction={severity=ERROR, lower-multiplicity=0, upper-multiplicity-infinite=true}, unresolved-reference-restriction=severity=ERROR
              aggregation tailoring engineeringObject: in-scope=false, multiplicity-restriction={severity=ERROR, lower-multiplicity=0, upper-multiplicity-infinite=true}
              reference tailoring object: in-scope=false, multiplicity-restriction={severity=ERROR, lower-multiplicity=0, upper-multiplicity-infinite=true}, unresolved-reference-restriction=severity=ERROR
              reference tailoring objectDefintion: in-scope=false, multiplicity-restriction={severity=ERROR, lower-multiplicity=0, upper-multiplicity-infinite=true}, unresolved-reference-restriction=severity=ERROR
        AclOperation
          class content conditional Invariant
            attribute-tailorings:
              reference tailoring impliedOperation: in-scope=false, multiplicity-restriction={severity=ERROR, lower-multiplicity=0, upper-multiplicity-infinite=true}, unresolved-reference-restriction=severity=ERROR
        AclPermission
          class content conditional Invariant
            attribute-tailorings:
              primitive attribute tailoring aclContext: in-scope=false, multiplicity-restriction={severity=ERROR, lower-multiplicity=0, upper-multiplicity-infinite=true}, default-value-handling=NO-DEFAULT
              reference tailoring aclObject: in-scope=false, multiplicity-restriction={severity=ERROR, lower-multiplicity=0, upper-multiplicity-infinite=true}, unresolved-reference-restriction=severity=ERROR
              reference tailoring aclOperation: in-scope=false, multiplicity-restriction={severity=ERROR, lower-multiplicity=0, upper-multiplicity-infinite=true}, unresolved-reference-restriction=severity=ERROR
              reference tailoring aclRole: in-scope=false, multiplicity-restriction={severity=ERROR, lower-multiplicity=0, upper-multiplicity-infinite=true}, unresolved-reference-restriction=severity=ERROR
              primitive attribute tailoring aclScope: in-scope=false, multiplicity-restriction={severity=ERROR, lower-multiplicity=0, upper-multiplicity=1}, default-value-handling=NO-DEFAULT
        AclRole
          class content conditional Invariant
            primitive attribute tailoring ldapUrl: in-scope=false, multiplicity-restriction={severity=ERROR, lower-multiplicity=0, upper-multiplicity=1}, default-value-handling=NO-DEFAULT
        AdminData
          class content conditional Invariant
            attribute-tailorings:
              aggregation tailoring docRevision: in-scope=false, multiplicity-restriction={severity=ERROR, lower-multiplicity=0, upper-multiplicity-infinite=true}
              primitive attribute tailoring language: in-scope=false, multiplicity-restriction={severity=ERROR, lower-multiplicity=0, upper-multiplicity=1}, default-value-handling=NO-DEFAULT
              aggregation tailoring sdg: in-scope=false, multiplicity-restriction={severity=ERROR, lower-multiplicity=0, upper-multiplicity-infinite=true}
              aggregation tailoring usedLanguages: in-scope=false, multiplicity-restriction={severity=ERROR, lower-multiplicity=0, upper-multiplicity=1}
        AgeConstraint
          class content conditional Invariant
            attribute-tailorings:
              aggregation tailoring maximum: in-scope=false, multiplicity-restriction={severity=ERROR, lower-multiplicity=0, upper-multiplicity=1}
              aggregation tailoring minimum: in-scope=false, multiplicity-restriction={severity=ERROR, lower-multiplicity=0, upper-multiplicity=1}
              reference tailoring scope_: alternative-name=scope, in-scope=false, multiplicity-restriction={severity=ERROR, lower-multiplicity=0, upper-multiplicity=1}, unresolved-reference-restriction=severity=ERROR
        AliasNameAssignment
          class content conditional Invariant
            attribute-tailorings:
              reference tailoring flatInstance: in-scope=false, multiplicity-restriction={severity=ERROR, lower-multiplicity=0, upper-multiplicity=1}, unresolved-reference-restriction=severity=ERROR
              reference tailoring identifiable: in-scope=false, multiplicity-restriction={severity=ERROR, lower-multiplicity=0, upper-multiplicity=1}, unresolved-reference-restriction=severity=ERROR
              aggregation tailoring label: in-scope=false, multiplicity-restriction={severity=ERROR, lower-multiplicity=0, upper-multiplicity=1}
              primitive attribute tailoring shortLabel: in-scope=false, multiplicity-restriction={severity=ERROR, lower-multiplicity=0, upper-multiplicity=1}, default-value-handling=NO-DEFAULT
        AliasNameSet
          class content conditional Invariant
            attribute-tailorings:
              aggregation tailoring aliasName: in-scope=false, multiplicity-restriction={severity=ERROR, lower-multiplicity=0, upper-multiplicity-infinite=true}, variation-restriction={severity=ERROR, variation=true, valid-binding-times=[BLUEPRINT-DERIVATION-TIME, SYSTEM-DESIGN-TIME, CODE-GENERATION-TIME, PRE-COMPILE-TIME]}
        AnalyzedExecutionTime
          class content conditional Invariant
            attribute-tailorings:
              aggregation tailoring bestCaseExecutionTime: in-scope=false, multiplicity-restriction={severity=ERROR, lower-multiplicity=0, upper-multiplicity=1}
              aggregation tailoring worstCaseExecutionTime: in-scope=false, multiplicity-restriction={severity=ERROR, lower-multiplicity=0, upper-multiplicity=1}
        Annotation
          class content conditional Invariant
        AnyInstanceRef
          class content conditional Invariant
            attribute-tailorings:
              reference tailoring contextElement: in-scope=false, multiplicity-restriction={severity=ERROR, lower-multiplicity=0, upper-multiplicity-infinite=true}, unresolved-reference-restriction=severity=ERROR
              reference tailoring target: in-scope=false, multiplicity-restriction={severity=ERROR, lower-multiplicity=0, upper-multiplicity=1}, unresolved-reference-restriction=severity=ERROR
        ApplicationArrayDataType
          class content conditional Invariant
            attribute-tailorings:
              aggregation tailoring element: in-scope=false, multiplicity-restriction={severity=ERROR, lower-multiplicity=0, upper-multiplicity=1}
        ApplicationArrayElement
          class content conditional Invariant
            primitive attribute tailoring arraySizeSemantics: in-scope=false, multiplicity-restriction={severity=ERROR, lower-multiplicity=0, upper-multiplicity=1}, default-value-handling=NO-DEFAULT
            primitive attribute tailoring maxNumberOfElements: in-scope=false, multiplicity-restriction={severity=ERROR, lower-multiplicity=0, upper-multiplicity=1}, variation-restriction={severity=ERROR, variation=true, valid-binding-times=[BLUEPRINT-DERIVATION-TIME, SYSTEM-DESIGN-TIME, CODE-GENERATION-TIME, PRE-COMPILE-TIME]}, default-value-handling=NO-DEFAULT
      abstract class tailoring ApplicationCompositeDataType: multiplicity-restriction={severity=INFO, lower-multiplicity=0, upper-multiplicity-infinite=true}
        class content conditional Invariant
      concrete class tailoring ApplicationCompositeDataTypeSubElementRef: in-scope=false, multiplicity-restriction={severity=INFO, lower-multiplicity=0, upper-multiplicity-infinite=true}, validation-root=false
        class content conditional Invariant
          attribute-tailorings:
            aggregation tailoring applicationCompositeElement: in-scope=false, multiplicity-restriction={severity=ERROR, lower-multiplicity=0, upper-multiplicity=1}
      abstract class tailoring ApplicationCompositeElementDataPrototype: multiplicity-restriction={severity=INFO, lower-multiplicity=0, upper-multiplicity-infinite=true}
        class content conditional Invariant
          attribute-tailorings:
            reference tailoring type: in-scope=false, multiplicity-restriction={severity=ERROR, lower-multiplicity=0, upper-multiplicity=1}, unresolved-reference-restriction=severity=ERROR
      concrete class tailoring ApplicationCompositeElementInPortInterfaceInstanceRef: in-scope=false, multiplicity-restriction={severity=INFO, lower-multiplicity=0, upper-multiplicity-infinite=true}, validation-root=false
        class content conditional Invariant
          attribute-tailorings:
            reference tailoring contextDataPrototype: in-scope=false, multiplicity-restriction={severity=ERROR, lower-multiplicity=0, upper-multiplicity-infinite=true}, unresolved-reference-restriction=severity=ERROR
            reference tailoring rootDataPrototype: in-scope=false, multiplicity-restriction={severity=ERROR, lower-multiplicity=0, upper-multiplicity=1}, unresolved-reference-restriction=severity=ERROR
            reference tailoring targetDataPrototype: in-scope=false, multiplicity-restriction={severity=ERROR, lower-multiplicity=0, upper-multiplicity=1}, unresolved-reference-restriction=severity=ERROR
      abstract class tailoring ApplicationDataType: multiplicity-restriction={severity=INFO, lower-multiplicity=0, upper-multiplicity-infinite=true}
        class content conditional Invariant
      22 x concrete class tailoring, all with in-scope=false, multiplicity-restriction={severity=INFO, lower-multiplicity=0, upper-multiplicity-infinite=true}, validation-root=false:
        ApplicationEndpoint
          class content conditional Invariant
            attribute-tailorings:
              aggregation tailoring consumedServiceInstance: in-scope=false, multiplicity-restriction={severity=ERROR, lower-multiplicity=0, upper-multiplicity-infinite=true}
              aggregation tailoring discoveryTechnology: in-scope=false, multiplicity-restriction={severity=ERROR, lower-multiplicity=0, upper-multiplicity=1}
              reference tailoring networkEndpoint: in-scope=false, multiplicity-restriction={severity=ERROR, lower-multiplicity=0, upper-multiplicity=1}, unresolved-reference-restriction=severity=ERROR
              primitive attribute tailoring priority: in-scope=false, multiplicity-restriction={severity=ERROR, lower-multiplicity=0, upper-multiplicity=1}, default-value-handling=NO-DEFAULT
              aggregation tailoring providedServiceInstance: in-scope=false, multiplicity-restriction={severity=ERROR, lower-multiplicity=0, upper-multiplicity-infinite=true}
              aggregation tailoring remotingTechnology: in-scope=false, multiplicity-restriction={severity=ERROR, lower-multiplicity=0, upper-multiplicity=1}
              reference tailoring serializationTechnology: in-scope=false, multiplicity-restriction={severity=ERROR, lower-multiplicity=0, upper-multiplicity=1}, unresolved-reference-restriction=severity=ERROR
              aggregation tailoring tpConfiguration: in-scope=false, multiplicity-restriction={severity=ERROR, lower-multiplicity=0, upper-multiplicity=1}
        ApplicationEntry
          class content conditional Invariant
            attribute-tailorings:
              reference tailoring frameTriggering: in-scope=false, multiplicity-restriction={severity=ERROR, lower-multiplicity=0, upper-multiplicity=1}, unresolved-reference-restriction=severity=ERROR
        ApplicationError
          class content conditional Invariant
            primitive attribute tailoring errorCode: in-scope=false, multiplicity-restriction={severity=ERROR, lower-multiplicity=0, upper-multiplicity=1}, default-value-handling=NO-DEFAULT
        ApplicationErrorMapping
          class content conditional Invariant
            attribute-tailorings:
              reference tailoring systemSignal: in-scope=false, multiplicity-restriction={severity=ERROR, lower-multiplicity=0, upper-multiplicity=1}, unresolved-reference-restriction=severity=ERROR
        ApplicationPrimitiveDataType
          class content conditional Invariant
        ApplicationRecordDataType
          class content conditional Invariant
            attribute-tailorings:
              aggregation tailoring element: in-scope=false, multiplicity-restriction={severity=ERROR, lower-multiplicity=0, upper-multiplicity-infinite=true}, variation-restriction={severity=ERROR, variation=true, valid-binding-times=[BLUEPRINT-DERIVATION-TIME, SYSTEM-DESIGN-TIME, CODE-GENERATION-TIME, PRE-COMPILE-TIME]}
        ApplicationRecordElement
          class content conditional Invariant
        ApplicationRuleBasedValueSpecification
          class content conditional Invariant
            attribute-tailorings:
              primitive attribute tailoring category: in-scope=false, multiplicity-restriction={severity=ERROR, lower-multiplicity=0, upper-multiplicity=1}, default-value-handling=NO-DEFAULT
                sub-attribute-tailorings:
                  primitive attribute tailoring namePattern: in-scope=false, multiplicity-restriction={severity=ERROR, lower-multiplicity=0, upper-multiplicity=1}, default-value-handling=NO-DEFAULT
              aggregation tailoring swAxisCont: in-scope=false, multiplicity-restriction={severity=ERROR, lower-multiplicity=0, upper-multiplicity-infinite=true}
              aggregation tailoring swValueCont: in-scope=false, multiplicity-restriction={severity=ERROR, lower-multiplicity=0, upper-multiplicity=1}
        ApplicationSwComponentType
          class content conditional Invariant
        ApplicationValueSpecification
          class content conditional Invariant
            attribute-tailorings:
              primitive attribute tailoring category: in-scope=false, multiplicity-restriction={severity=ERROR, lower-multiplicity=0, upper-multiplicity=1}, default-value-handling=NO-DEFAULT
                sub-attribute-tailorings:
                  primitive attribute tailoring namePattern: in-scope=false, multiplicity-restriction={severity=ERROR, lower-multiplicity=0, upper-multiplicity=1}, default-value-handling=NO-DEFAULT
              aggregation tailoring swAxisCont: in-scope=false, multiplicity-restriction={severity=ERROR, lower-multiplicity=0, upper-multiplicity-infinite=true}
              aggregation tailoring swValueCont: in-scope=false, multiplicity-restriction={severity=ERROR, lower-multiplicity=0, upper-multiplicity=1}
        ArVariableInImplementationDataInstanceRef
          class content conditional Invariant
            attribute-tailorings:
              4 x reference tailoring, all with in-scope=false, unresolved-reference-restriction=severity=ERROR:
                contextDataPrototype: multiplicity-restriction={severity=ERROR, lower-multiplicity=0, upper-multiplicity-infinite=true}
                portPrototype: multiplicity-restriction={severity=ERROR, lower-multiplicity=0, upper-multiplicity=1}
                rootVariableDataPrototype: multiplicity-restriction={severity=ERROR, lower-multiplicity=0, upper-multiplicity=1}
                targetDataPrototype: multiplicity-restriction={severity=ERROR, lower-multiplicity=0, upper-multiplicity=1}
        ArbitraryEventTriggering
          class content conditional Invariant
            attribute-tailorings:
              aggregation tailoring confidenceInterval: in-scope=false, multiplicity-restriction={severity=ERROR, lower-multiplicity=0, upper-multiplicity-infinite=true}
              aggregation tailoring maximumDistance: in-scope=false, multiplicity-restriction={severity=ERROR, lower-multiplicity=0, upper-multiplicity-infinite=true}
              aggregation tailoring minimumDistance: in-scope=false, multiplicity-restriction={severity=ERROR, lower-multiplicity=0, upper-multiplicity-infinite=true}
        Area
          class content conditional Invariant
            22 x primitive attribute tailoring, all with in-scope=false, multiplicity-restriction={severity=ERROR, lower-multiplicity=0, upper-multiplicity=1}, default-value-handling=NO-DEFAULT:
              accesskey
              alt
              class
              coords
              href
              nohref
              onblur
              onclick
              ondblclick
              onfocus
              onkeydown
              onkeypress
              onkeyup
              onmousedown
              onmousemove
              onmouseout
              onmouseover
              onmouseup
              shape
              style
              tabindex
              title
        ArgumentDataPrototype
          class content conditional Invariant
            attribute-tailorings:
              primitive attribute tailoring direction: in-scope=false, multiplicity-restriction={severity=ERROR, lower-multiplicity=0, upper-multiplicity=1}, default-value-handling=NO-DEFAULT
              primitive attribute tailoring serverArgumentImplPolicy: in-scope=false, multiplicity-restriction={severity=ERROR, lower-multiplicity=0, upper-multiplicity=1}, default-value-handling=NO-DEFAULT
              reference tailoring typeBlueprint: in-scope=false, multiplicity-restriction={severity=ERROR, lower-multiplicity=0, upper-multiplicity=1}, variation-restriction={severity=ERROR, variation=true, valid-binding-times=BLUEPRINT-DERIVATION-TIME}, unresolved-reference-restriction=severity=ERROR
        ArrayValueSpecification
          class content conditional Invariant
            attribute-tailorings:
              aggregation tailoring element: in-scope=false, multiplicity-restriction={severity=ERROR, lower-multiplicity=0, upper-multiplicity-infinite=true}, variation-restriction={severity=ERROR, variation=true, valid-binding-times=[BLUEPRINT-DERIVATION-TIME, SYSTEM-DESIGN-TIME, CODE-GENERATION-TIME, PRE-COMPILE-TIME]}
        AssemblySwConnector
          class content conditional Invariant
            attribute-tailorings:
              aggregation tailoring provider: in-scope=false, multiplicity-restriction={severity=ERROR, lower-multiplicity=0, upper-multiplicity=1}
              aggregation tailoring requester: in-scope=false, multiplicity-restriction={severity=ERROR, lower-multiplicity=0, upper-multiplicity=1}
        AssignFrameId
          class content conditional Invariant
            attribute-tailorings:
              reference tailoring assignedFrameTriggering: in-scope=false, multiplicity-restriction={severity=ERROR, lower-multiplicity=0, upper-multiplicity=1}, unresolved-reference-restriction=severity=ERROR
        AssignFrameIdRange
          class content conditional Invariant
            attribute-tailorings:
              aggregation tailoring framePid: in-scope=false, multiplicity-restriction={severity=ERROR, lower-multiplicity=0, upper-multiplicity=4}
              primitive attribute tailoring startIndex: in-scope=false, multiplicity-restriction={severity=ERROR, lower-multiplicity=0, upper-multiplicity=1}, default-value-handling=NO-DEFAULT
        AssignNad
          class content conditional Invariant
            primitive attribute tailoring newNad: in-scope=false, multiplicity-restriction={severity=ERROR, lower-multiplicity=0, upper-multiplicity=1}, default-value-handling=NO-DEFAULT
        AsynchronousServerCallPoint
          class content conditional Invariant
        AsynchronousServerCallResultPoint
          class content conditional Invariant
            attribute-tailorings:
              reference tailoring asynchronousServerCallPoint: in-scope=false, multiplicity-restriction={severity=ERROR, lower-multiplicity=0, upper-multiplicity=1}, unresolved-reference-restriction=severity=ERROR
        AsynchronousServerCallReturnsEvent
          class content conditional Invariant
            attribute-tailorings:
              reference tailoring eventSource: in-scope=false, multiplicity-restriction={severity=ERROR, lower-multiplicity=0, upper-multiplicity=1}, unresolved-reference-restriction=severity=ERROR
      14 x abstract class tailoring, all with multiplicity-restriction={severity=INFO, lower-multiplicity=0, upper-multiplicity-infinite=true}:
        AtomicSwComponentType
          class content conditional Invariant
            attribute-tailorings:
              aggregation tailoring internalBehavior: in-scope=false, multiplicity-restriction={severity=ERROR, lower-multiplicity=0, upper-multiplicity=1}, variation-restriction={severity=ERROR, variation=true, valid-binding-times=[BLUEPRINT-DERIVATION-TIME, SYSTEM-DESIGN-TIME, CODE-GENERATION-TIME, PRE-COMPILE-TIME]}
              aggregation tailoring symbolProps: in-scope=false, multiplicity-restriction={severity=ERROR, lower-multiplicity=0, upper-multiplicity=1}
        AtpBlueprint
          class content conditional Invariant
            primitive attribute tailoring shortNamePattern: in-scope=false, multiplicity-restriction={severity=WARNING, lower-multiplicity=0, upper-multiplicity=0}, default-value-handling=NO-DEFAULT  # Spec element has lifecycle state 'obsolete'.
        AtpBlueprintMapping
          class content conditional Invariant
        AtpBlueprintable
          class content conditional Invariant
        AtpClassifier
          class content conditional Invariant
        AtpDefinition
          class content conditional Invariant
        AtpFeature
          class content conditional Invariant
        AtpInstanceRef
          class content conditional Invariant
        AtpPrototype
          class content conditional Invariant
        AtpStructureElement
          class content conditional Invariant
        AtpType
          class content conditional Invariant
        AttributeValueVariationPoint
          class content conditional Invariant
            4 x primitive attribute tailoring, all with in-scope=false, multiplicity-restriction={severity=ERROR, lower-multiplicity=0, upper-multiplicity=1}, default-value-handling=NO-DEFAULT:
              bindingTime
              blueprintValue
              sd
              shortLabel
        AutosarDataPrototype
          class content conditional Invariant
            attribute-tailorings:
              reference tailoring type: in-scope=false, multiplicity-restriction={severity=ERROR, lower-multiplicity=0, upper-multiplicity=1}, unresolved-reference-restriction=severity=ERROR
        AutosarDataType
          class content conditional Invariant
            attribute-tailorings:
              aggregation tailoring swDataDefProps: in-scope=false, multiplicity-restriction={severity=ERROR, lower-multiplicity=0, upper-multiplicity=1}
      6 x concrete class tailoring, all with in-scope=false, multiplicity-restriction={severity=INFO, lower-multiplicity=0, upper-multiplicity-infinite=true}, validation-root=false:
        AutosarEngineeringObject
          class content conditional Invariant
        AutosarOperationArgumentInstance
          class content conditional Invariant
            attribute-tailorings:
              aggregation tailoring operationArgumentInstance: in-scope=false, multiplicity-restriction={severity=ERROR, lower-multiplicity=0, upper-multiplicity=1}
        AutosarParameterRef
          class content conditional Invariant
            attribute-tailorings:
              aggregation tailoring autosarParameter: in-scope=false, multiplicity-restriction={severity=ERROR, lower-multiplicity=0, upper-multiplicity=1}
              reference tailoring localParameter: in-scope=false, multiplicity-restriction={severity=ERROR, lower-multiplicity=0, upper-multiplicity=1}, unresolved-reference-restriction=severity=ERROR
        AutosarVariableInstance
          class content conditional Invariant
            attribute-tailorings:
              aggregation tailoring variableInstance: in-scope=false, multiplicity-restriction={severity=ERROR, lower-multiplicity=0, upper-multiplicity=1}
        AutosarVariableRef
          class content conditional Invariant
            attribute-tailorings:
              aggregation tailoring autosarVariable: in-scope=false, multiplicity-restriction={severity=ERROR, lower-multiplicity=0, upper-multiplicity=1}
              aggregation tailoring autosarVariableInImplDatatype: in-scope=false, multiplicity-restriction={severity=ERROR, lower-multiplicity=0, upper-multiplicity=1}
              reference tailoring localVariable: in-scope=false, multiplicity-restriction={severity=ERROR, lower-multiplicity=0, upper-multiplicity=1}, unresolved-reference-restriction=severity=ERROR
        BackgroundEvent
          class content conditional Invariant
      abstract class tailoring BaseType: multiplicity-restriction={severity=INFO, lower-multiplicity=0, upper-multiplicity-infinite=true}
        class content conditional Invariant
          attribute-tailorings:
            aggregation tailoring baseTypeDefinition: in-scope=false, multiplicity-restriction={severity=ERROR, lower-multiplicity=0, upper-multiplicity=1}
      abstract class tailoring BaseTypeDefinition: multiplicity-restriction={severity=INFO, lower-multiplicity=0, upper-multiplicity-infinite=true}
        class content conditional Invariant
      12 x concrete class tailoring, all with in-scope=false, multiplicity-restriction={severity=INFO, lower-multiplicity=0, upper-multiplicity-infinite=true}, validation-root=false:
        BaseTypeDirectDefinition
          class content conditional Invariant
            6 x primitive attribute tailoring, all with in-scope=false, multiplicity-restriction={severity=ERROR, lower-multiplicity=0, upper-multiplicity=1}, default-value-handling=NO-DEFAULT:
              baseTypeEncoding
              baseTypeSize
              byteOrder
              maxBaseTypeSize
              memAlignment
              nativeDeclaration
        BlueprintFormula
          class content conditional Invariant
            attribute-tailorings:
              reference tailoring ecucQuery: in-scope=false, multiplicity-restriction={severity=ERROR, lower-multiplicity=0, upper-multiplicity-infinite=true}, unresolved-reference-restriction=severity=ERROR  # Multiplicity is 0..* since attribute is contained in mixed / mixedString class.
              aggregation tailoring verbatim: in-scope=false, multiplicity-restriction={severity=ERROR, lower-multiplicity=0, upper-multiplicity-infinite=true}  # Multiplicity is 0..* since attribute is contained in mixed / mixedString class.
        BlueprintMapping
          class content conditional Invariant
            attribute-tailorings:
              reference tailoring blueprint: in-scope=false, multiplicity-restriction={severity=ERROR, lower-multiplicity=0, upper-multiplicity=1}, unresolved-reference-restriction=severity=ERROR
              reference tailoring derivedObject: in-scope=false, multiplicity-restriction={severity=ERROR, lower-multiplicity=0, upper-multiplicity=1}, unresolved-reference-restriction=severity=ERROR
        BlueprintMappingSet
          class content conditional Invariant
            attribute-tailorings:
              aggregation tailoring blueprintMap: in-scope=false, multiplicity-restriction={severity=ERROR, lower-multiplicity=0, upper-multiplicity-infinite=true}
        BooleanValueVariationPoint
          class content conditional Invariant
        Br
          class content conditional Invariant
        BswAsynchronousServerCallPoint
          class content conditional Invariant
            attribute-tailorings:
              reference tailoring calledEntry: in-scope=false, multiplicity-restriction={severity=ERROR, lower-multiplicity=0, upper-multiplicity=1}, unresolved-reference-restriction=severity=ERROR
        BswAsynchronousServerCallResultPoint
          class content conditional Invariant
            attribute-tailorings:
              reference tailoring asynchronousServerCallPoint: in-scope=false, multiplicity-restriction={severity=ERROR, lower-multiplicity=0, upper-multiplicity=1}, unresolved-reference-restriction=severity=ERROR
        BswAsynchronousServerCallReturnsEvent
          class content conditional Invariant
            attribute-tailorings:
              reference tailoring eventSource: in-scope=false, multiplicity-restriction={severity=ERROR, lower-multiplicity=0, upper-multiplicity=1}, unresolved-reference-restriction=severity=ERROR
        BswBackgroundEvent
          class content conditional Invariant
        BswCalledEntity
          class content conditional Invariant
        BswDataReceivedEvent
          class content conditional Invariant
            attribute-tailorings:
              reference tailoring data: in-scope=false, multiplicity-restriction={severity=ERROR, lower-multiplicity=0, upper-multiplicity=1}, unresolved-reference-restriction=severity=ERROR
      abstract class tailoring BswDataReceptionPolicy: multiplicity-restriction={severity=INFO, lower-multiplicity=0, upper-multiplicity-infinite=true}
        class content conditional Invariant
          attribute-tailorings:
            reference tailoring receivedData: in-scope=false, multiplicity-restriction={severity=ERROR, lower-multiplicity=0, upper-multiplicity=1}, unresolved-reference-restriction=severity=ERROR
      concrete class tailoring BswDebugInfo: in-scope=false, multiplicity-restriction={severity=INFO, lower-multiplicity=0, upper-multiplicity-infinite=true}, validation-root=false
        class content conditional Invariant
          attribute-tailorings:
            aggregation tailoring localDebugData: in-scope=false, multiplicity-restriction={severity=ERROR, lower-multiplicity=0, upper-multiplicity-infinite=true}
            reference tailoring parameterAccessedForDebug: in-scope=false, multiplicity-restriction={severity=ERROR, lower-multiplicity=0, upper-multiplicity-infinite=true}, unresolved-reference-restriction=severity=ERROR
            reference tailoring variableAccessedForDebug: in-scope=false, multiplicity-restriction={severity=ERROR, lower-multiplicity=0, upper-multiplicity-infinite=true}, unresolved-reference-restriction=severity=ERROR
      concrete class tailoring BswDirectCallPoint: in-scope=false, multiplicity-restriction={severity=INFO, lower-multiplicity=0, upper-multiplicity-infinite=true}, validation-root=false
        class content conditional Invariant
          attribute-tailorings:
            reference tailoring calledEntry: in-scope=false, multiplicity-restriction={severity=ERROR, lower-multiplicity=0, upper-multiplicity=1}, unresolved-reference-restriction=severity=ERROR
            reference tailoring calledFromWithinExclusiveArea: in-scope=false, multiplicity-restriction={severity=ERROR, lower-multiplicity=0, upper-multiplicity=1}, unresolved-reference-restriction=severity=ERROR
      concrete class tailoring BswDistinguishedPartition: in-scope=false, multiplicity-restriction={severity=INFO, lower-multiplicity=0, upper-multiplicity-infinite=true}, validation-root=false
        class content conditional Invariant
      abstract class tailoring BswEvent: multiplicity-restriction={severity=INFO, lower-multiplicity=0, upper-multiplicity-infinite=true}
        class content conditional Invariant
          attribute-tailorings:
            reference tailoring contextLimitation: in-scope=false, multiplicity-restriction={severity=ERROR, lower-multiplicity=0, upper-multiplicity-infinite=true}, unresolved-reference-restriction=severity=ERROR
            aggregation tailoring disabledInMode: in-scope=false, multiplicity-restriction={severity=ERROR, lower-multiplicity=0, upper-multiplicity-infinite=true}
            reference tailoring startsOnEvent: in-scope=false, multiplicity-restriction={severity=ERROR, lower-multiplicity=0, upper-multiplicity=1}, unresolved-reference-restriction=severity=ERROR
      13 x concrete class tailoring, all with in-scope=false, multiplicity-restriction={severity=INFO, lower-multiplicity=0, upper-multiplicity-infinite=true}, validation-root=false:
        BswExternalTriggerOccurredEvent
          class content conditional Invariant
            attribute-tailorings:
              reference tailoring trigger: in-scope=false, multiplicity-restriction={severity=ERROR, lower-multiplicity=0, upper-multiplicity=1}, unresolved-reference-restriction=severity=ERROR
        BswImplementation
          class content conditional Invariant
            attribute-tailorings:
              primitive attribute tailoring arReleaseVersion: in-scope=false, multiplicity-restriction={severity=ERROR, lower-multiplicity=0, upper-multiplicity=1}, default-value-handling=NO-DEFAULT
              reference tailoring behavior: in-scope=false, multiplicity-restriction={severity=ERROR, lower-multiplicity=0, upper-multiplicity=1}, unresolved-reference-restriction=severity=ERROR
              aggregation tailoring debugInfo: in-scope=false, multiplicity-restriction={severity=ERROR, lower-multiplicity=0, upper-multiplicity=1}, variation-restriction={severity=ERROR, variation=true, valid-binding-times=[BLUEPRINT-DERIVATION-TIME, SYSTEM-DESIGN-TIME, CODE-GENERATION-TIME, PRE-COMPILE-TIME]}
              reference tailoring preconfiguredConfiguration: in-scope=false, multiplicity-restriction={severity=ERROR, lower-multiplicity=0, upper-multiplicity-infinite=true}, unresolved-reference-restriction=severity=ERROR
              reference tailoring recommendedConfiguration: in-scope=false, multiplicity-restriction={severity=ERROR, lower-multiplicity=0, upper-multiplicity-infinite=true}, unresolved-reference-restriction=severity=ERROR
              primitive attribute tailoring vendorApiInfix: in-scope=false, multiplicity-restriction={severity=ERROR, lower-multiplicity=0, upper-multiplicity=1}, default-value-handling=NO-DEFAULT
                sub-attribute-tailorings:
                  primitive attribute tailoring namePattern: in-scope=false, multiplicity-restriction={severity=ERROR, lower-multiplicity=0, upper-multiplicity=1}, default-value-handling=NO-DEFAULT
              reference tailoring vendorSpecificModuleDef: in-scope=false, multiplicity-restriction={severity=ERROR, lower-multiplicity=0, upper-multiplicity-infinite=true}, unresolved-reference-restriction=severity=ERROR
        BswInternalBehavior
          class content conditional Invariant
            attribute-tailorings:
              11 x aggregation tailoring, all with in-scope=false, multiplicity-restriction={severity=ERROR, lower-multiplicity=0, upper-multiplicity-infinite=true}, variation-restriction={severity=ERROR, variation=true, valid-binding-times=[BLUEPRINT-DERIVATION-TIME, SYSTEM-DESIGN-TIME, CODE-GENERATION-TIME, PRE-COMPILE-TIME]}:
                distinguishedPartition
                entity
                event
                internalTriggeringPoint
                modeReceiverPolicy
                modeSenderPolicy
                perInstanceParameter
                receptionPolicy
                schedulerNamePrefix
                serviceDependency
                triggerDirectImplementation
        BswInternalTriggerOccurredEvent
          class content conditional Invariant
            attribute-tailorings:
              reference tailoring eventSource: in-scope=false, multiplicity-restriction={severity=ERROR, lower-multiplicity=0, upper-multiplicity=1}, unresolved-reference-restriction=severity=ERROR
        BswInternalTriggeringPoint
          class content conditional Invariant
            primitive attribute tailoring swImplPolicy: in-scope=false, multiplicity-restriction={severity=ERROR, lower-multiplicity=0, upper-multiplicity=1}, default-value-handling=NO-DEFAULT
        BswInterruptEntity
          class content conditional Invariant
            primitive attribute tailoring interruptCategory: in-scope=false, multiplicity-restriction={severity=ERROR, lower-multiplicity=0, upper-multiplicity=1}, default-value-handling=NO-DEFAULT
            primitive attribute tailoring interruptSource: in-scope=false, multiplicity-restriction={severity=ERROR, lower-multiplicity=0, upper-multiplicity=1}, default-value-handling=NO-DEFAULT
        BswMgrNeeds
          class content conditional Invariant
        BswModeManagerErrorEvent
          class content conditional Invariant
            attribute-tailorings:
              reference tailoring modeGroup: in-scope=false, multiplicity-restriction={severity=ERROR, lower-multiplicity=0, upper-multiplicity=1}, unresolved-reference-restriction=severity=ERROR
        BswModeReceiverPolicy
          class content conditional Invariant
            attribute-tailorings:
              primitive attribute tailoring enhancedModeApi: in-scope=false, multiplicity-restriction={severity=ERROR, lower-multiplicity=0, upper-multiplicity=1}, default-value-handling=NO-DEFAULT
              reference tailoring requiredModeGroup: in-scope=false, multiplicity-restriction={severity=ERROR, lower-multiplicity=0, upper-multiplicity=1}, unresolved-reference-restriction=severity=ERROR
              primitive attribute tailoring supportsAsynchronousModeSwitch: in-scope=false, multiplicity-restriction={severity=ERROR, lower-multiplicity=0, upper-multiplicity=1}, default-value-handling=NO-DEFAULT
        BswModeSenderPolicy
          class content conditional Invariant
            attribute-tailorings:
              aggregation tailoring ackRequest: in-scope=false, multiplicity-restriction={severity=ERROR, lower-multiplicity=0, upper-multiplicity=1}
              primitive attribute tailoring enhancedModeApi: in-scope=false, multiplicity-restriction={severity=ERROR, lower-multiplicity=0, upper-multiplicity=1}, default-value-handling=NO-DEFAULT
              reference tailoring providedModeGroup: in-scope=false, multiplicity-restriction={severity=ERROR, lower-multiplicity=0, upper-multiplicity=1}, unresolved-reference-restriction=severity=ERROR
              primitive attribute tailoring queueLength: in-scope=false, multiplicity-restriction={severity=ERROR, lower-multiplicity=0, upper-multiplicity=1}, default-value-handling=NO-DEFAULT
        BswModeSwitchAckRequest
          class content conditional Invariant
            primitive attribute tailoring timeout: in-scope=false, multiplicity-restriction={severity=ERROR, lower-multiplicity=0, upper-multiplicity=1}, default-value-handling=NO-DEFAULT
        BswModeSwitchEvent
          class content conditional Invariant
            attribute-tailorings:
              primitive attribute tailoring activation: in-scope=false, multiplicity-restriction={severity=ERROR, lower-multiplicity=0, upper-multiplicity=1}, default-value-handling=NO-DEFAULT
              aggregation tailoring mode: in-scope=false, multiplicity-restriction={severity=ERROR, lower-multiplicity=0, upper-multiplicity=2}
        BswModeSwitchedAckEvent
          class content conditional Invariant
            attribute-tailorings:
              reference tailoring modeGroup: in-scope=false, multiplicity-restriction={severity=ERROR, lower-multiplicity=0, upper-multiplicity=1}, unresolved-reference-restriction=severity=ERROR
      abstract class tailoring BswModuleCallPoint: multiplicity-restriction={severity=INFO, lower-multiplicity=0, upper-multiplicity-infinite=true}
        class content conditional Invariant
          attribute-tailorings:
            reference tailoring contextLimitation: in-scope=false, multiplicity-restriction={severity=ERROR, lower-multiplicity=0, upper-multiplicity-infinite=true}, unresolved-reference-restriction=severity=ERROR
      concrete class tailoring BswModuleClientServerEntry: in-scope=false, multiplicity-restriction={severity=INFO, lower-multiplicity=0, upper-multiplicity-infinite=true}, validation-root=false
        class content conditional Invariant
          attribute-tailorings:
            reference tailoring encapsulatedEntry: in-scope=false, multiplicity-restriction={severity=ERROR, lower-multiplicity=0, upper-multiplicity=1}, unresolved-reference-restriction=severity=ERROR
            primitive attribute tailoring isReentrant: in-scope=false, multiplicity-restriction={severity=ERROR, lower-multiplicity=0, upper-multiplicity=1}, default-value-handling=NO-DEFAULT
            primitive attribute tailoring isSynchronous: in-scope=false, multiplicity-restriction={severity=ERROR, lower-multiplicity=0, upper-multiplicity=1}, default-value-handling=NO-DEFAULT
      concrete class tailoring BswModuleDependency: in-scope=false, multiplicity-restriction={severity=INFO, lower-multiplicity=0, upper-multiplicity-infinite=true}, validation-root=false
        class content conditional Invariant
          attribute-tailorings:
            reference tailoring expectedCallback: in-scope=false, multiplicity-restriction={severity=ERROR, lower-multiplicity=0, upper-multiplicity-infinite=true}, variation-restriction={severity=ERROR, variation=true, valid-binding-times=[BLUEPRINT-DERIVATION-TIME, SYSTEM-DESIGN-TIME, CODE-GENERATION-TIME, PRE-COMPILE-TIME]}, unresolved-reference-restriction=severity=ERROR
            reference tailoring requiredEntry: in-scope=false, multiplicity-restriction={severity=ERROR, lower-multiplicity=0, upper-multiplicity-infinite=true}, variation-restriction={severity=ERROR, variation=true, valid-binding-times=[BLUEPRINT-DERIVATION-TIME, SYSTEM-DESIGN-TIME, CODE-GENERATION-TIME, PRE-COMPILE-TIME]}, unresolved-reference-restriction=severity=ERROR
            aggregation tailoring serviceItem: in-scope=false, multiplicity-restriction={severity=WARNING, lower-multiplicity=0, upper-multiplicity=0}  # Spec element has lifecycle state 'obsolete'.
            primitive attribute tailoring targetModuleId: in-scope=false, multiplicity-restriction={severity=ERROR, lower-multiplicity=0, upper-multiplicity=1}, default-value-handling=NO-DEFAULT
            reference tailoring targetModuleRef: in-scope=false, multiplicity-restriction={severity=ERROR, lower-multiplicity=0, upper-multiplicity=1}, variation-restriction={severity=ERROR, variation=true, valid-binding-times=[BLUEPRINT-DERIVATION-TIME, SYSTEM-DESIGN-TIME, CODE-GENERATION-TIME, PRE-COMPILE-TIME]}, unresolved-reference-restriction=severity=ERROR
      concrete class tailoring BswModuleDescription: in-scope=false, multiplicity-restriction={severity=INFO, lower-multiplicity=0, upper-multiplicity-infinite=true}, validation-root=false
        class content conditional Invariant
          attribute-tailorings:
            aggregation tailoring bswModuleDependency: in-scope=false, multiplicity-restriction={severity=ERROR, lower-multiplicity=0, upper-multiplicity-infinite=true}, variation-restriction={severity=ERROR, variation=true, valid-binding-times=[BLUEPRINT-DERIVATION-TIME, SYSTEM-DESIGN-TIME, CODE-GENERATION-TIME, PRE-COMPILE-TIME]}
            aggregation tailoring bswModuleDocumentation: in-scope=false, multiplicity-restriction={severity=ERROR, lower-multiplicity=0, upper-multiplicity=1}, variation-restriction={severity=ERROR, variation=true, valid-binding-times=[BLUEPRINT-DERIVATION-TIME, SYSTEM-DESIGN-TIME, CODE-GENERATION-TIME, PRE-COMPILE-TIME]}
            aggregation tailoring internalBehavior: in-scope=false, multiplicity-restriction={severity=ERROR, lower-multiplicity=0, upper-multiplicity-infinite=true}
            primitive attribute tailoring moduleId: in-scope=false, multiplicity-restriction={severity=ERROR, lower-multiplicity=0, upper-multiplicity=1}, default-value-handling=NO-DEFAULT
            reference tailoring outgoingCallback: in-scope=false, multiplicity-restriction={severity=ERROR, lower-multiplicity=0, upper-multiplicity-infinite=true}, variation-restriction={severity=ERROR, variation=true, valid-binding-times=[BLUEPRINT-DERIVATION-TIME, SYSTEM-DESIGN-TIME, CODE-GENERATION-TIME, PRE-COMPILE-TIME]}, unresolved-reference-restriction=severity=ERROR
            aggregation tailoring providedClientServerEntry: in-scope=false, multiplicity-restriction={severity=ERROR, lower-multiplicity=0, upper-multiplicity-infinite=true}, variation-restriction={severity=ERROR, variation=true, valid-binding-times=[BLUEPRINT-DERIVATION-TIME, SYSTEM-DESIGN-TIME, CODE-GENERATION-TIME, PRE-COMPILE-TIME]}
            aggregation tailoring providedData: in-scope=false, multiplicity-restriction={severity=ERROR, lower-multiplicity=0, upper-multiplicity-infinite=true}, variation-restriction={severity=ERROR, variation=true, valid-binding-times=[BLUEPRINT-DERIVATION-TIME, SYSTEM-DESIGN-TIME, CODE-GENERATION-TIME, PRE-COMPILE-TIME]}
            reference tailoring providedEntry: in-scope=false, multiplicity-restriction={severity=ERROR, lower-multiplicity=0, upper-multiplicity-infinite=true}, variation-restriction={severity=ERROR, variation=true, valid-binding-times=[BLUEPRINT-DERIVATION-TIME, SYSTEM-DESIGN-TIME, CODE-GENERATION-TIME, PRE-COMPILE-TIME]}, unresolved-reference-restriction=severity=ERROR
            6 x aggregation tailoring, all with in-scope=false, multiplicity-restriction={severity=ERROR, lower-multiplicity=0, upper-multiplicity-infinite=true}, variation-restriction={severity=ERROR, variation=true, valid-binding-times=[BLUEPRINT-DERIVATION-TIME, SYSTEM-DESIGN-TIME, CODE-GENERATION-TIME, PRE-COMPILE-TIME]}:
              providedModeGroup
              releasedTrigger
              requiredClientServerEntry
              requiredData
              requiredModeGroup
              requiredTrigger
      abstract class tailoring BswModuleEntity: multiplicity-restriction={severity=INFO, lower-multiplicity=0, upper-multiplicity-infinite=true}
        class content conditional Invariant
          attribute-tailorings:
            reference tailoring accessedModeGroup: in-scope=false, multiplicity-restriction={severity=ERROR, lower-multiplicity=0, upper-multiplicity-infinite=true}, variation-restriction={severity=ERROR, variation=true, valid-binding-times=[BLUEPRINT-DERIVATION-TIME, SYSTEM-DESIGN-TIME, CODE-GENERATION-TIME, PRE-COMPILE-TIME]}, unresolved-reference-restriction=severity=ERROR
            reference tailoring activationPoint: in-scope=false, multiplicity-restriction={severity=ERROR, lower-multiplicity=0, upper-multiplicity-infinite=true}, variation-restriction={severity=ERROR, variation=true, valid-binding-times=[BLUEPRINT-DERIVATION-TIME, SYSTEM-DESIGN-TIME, CODE-GENERATION-TIME, PRE-COMPILE-TIME]}, unresolved-reference-restriction=severity=ERROR
            aggregation tailoring callPoint: in-scope=false, multiplicity-restriction={severity=ERROR, lower-multiplicity=0, upper-multiplicity-infinite=true}, variation-restriction={severity=ERROR, variation=true, valid-binding-times=[BLUEPRINT-DERIVATION-TIME, SYSTEM-DESIGN-TIME, CODE-GENERATION-TIME, PRE-COMPILE-TIME]}
            reference tailoring calledEntry: in-scope=false, multiplicity-restriction={severity=WARNING, lower-multiplicity=0, upper-multiplicity=0}, variation-restriction={severity=ERROR, variation=true, valid-binding-times=[BLUEPRINT-DERIVATION-TIME, SYSTEM-DESIGN-TIME, CODE-GENERATION-TIME, PRE-COMPILE-TIME]}, unresolved-reference-restriction=severity=ERROR  # Spec element has lifecycle state 'obsolete'.
            aggregation tailoring dataReceivePoint: in-scope=false, multiplicity-restriction={severity=ERROR, lower-multiplicity=0, upper-multiplicity-infinite=true}, variation-restriction={severity=ERROR, variation=true, valid-binding-times=[BLUEPRINT-DERIVATION-TIME, SYSTEM-DESIGN-TIME, CODE-GENERATION-TIME, PRE-COMPILE-TIME]}
            aggregation tailoring dataSendPoint: in-scope=false, multiplicity-restriction={severity=ERROR, lower-multiplicity=0, upper-multiplicity-infinite=true}, variation-restriction={severity=ERROR, variation=true, valid-binding-times=[BLUEPRINT-DERIVATION-TIME, SYSTEM-DESIGN-TIME, CODE-GENERATION-TIME, PRE-COMPILE-TIME]}
            4 x reference tailoring, all with in-scope=false, unresolved-reference-restriction=severity=ERROR:
              implementedEntry: multiplicity-restriction={severity=ERROR, lower-multiplicity=0, upper-multiplicity=1}
              issuedTrigger: multiplicity-restriction={severity=ERROR, lower-multiplicity=0, upper-multiplicity-infinite=true}, variation-restriction={severity=ERROR, variation=true, valid-binding-times=[BLUEPRINT-DERIVATION-TIME, SYSTEM-DESIGN-TIME, CODE-GENERATION-TIME, PRE-COMPILE-TIME]}
              managedModeGroup: multiplicity-restriction={severity=ERROR, lower-multiplicity=0, upper-multiplicity-infinite=true}, variation-restriction={severity=ERROR, variation=true, valid-binding-times=[BLUEPRINT-DERIVATION-TIME, SYSTEM-DESIGN-TIME, CODE-GENERATION-TIME, PRE-COMPILE-TIME]}
              schedulerNamePrefix: multiplicity-restriction={severity=ERROR, lower-multiplicity=0, upper-multiplicity=1}
      5 x concrete class tailoring, all with in-scope=false, multiplicity-restriction={severity=INFO, lower-multiplicity=0, upper-multiplicity-infinite=true}, validation-root=false:
        BswModuleEntry
          class content conditional Invariant
            attribute-tailorings:
              aggregation tailoring argument: in-scope=false, multiplicity-restriction={severity=ERROR, lower-multiplicity=0, upper-multiplicity-infinite=true}, variation-restriction={severity=ERROR, variation=true, valid-binding-times=BLUEPRINT-DERIVATION-TIME}
              4 x primitive attribute tailoring, all with in-scope=false, multiplicity-restriction={severity=ERROR, lower-multiplicity=0, upper-multiplicity=1}, default-value-handling=NO-DEFAULT:
                callType
                executionContext
                isReentrant
                isSynchronous
              aggregation tailoring returnType: in-scope=false, multiplicity-restriction={severity=ERROR, lower-multiplicity=0, upper-multiplicity=1}
              primitive attribute tailoring role: in-scope=false, multiplicity-restriction={severity=ERROR, lower-multiplicity=0, upper-multiplicity=1}, default-value-handling=NO-DEFAULT
                sub-attribute-tailorings:
                  primitive attribute tailoring namePattern: in-scope=false, multiplicity-restriction={severity=ERROR, lower-multiplicity=0, upper-multiplicity=1}, default-value-handling=NO-DEFAULT
              primitive attribute tailoring serviceId: in-scope=false, multiplicity-restriction={severity=ERROR, lower-multiplicity=0, upper-multiplicity=1}, default-value-handling=NO-DEFAULT
              primitive attribute tailoring swServiceImplPolicy: in-scope=false, multiplicity-restriction={severity=ERROR, lower-multiplicity=0, upper-multiplicity=1}, default-value-handling=NO-DEFAULT
        BswModuleTiming
          class content conditional Invariant
            attribute-tailorings:
              reference tailoring behavior: in-scope=false, multiplicity-restriction={severity=ERROR, lower-multiplicity=0, upper-multiplicity=1}, unresolved-reference-restriction=severity=ERROR
        BswOperationInvokedEvent
          class content conditional Invariant
            attribute-tailorings:
              reference tailoring entry: in-scope=false, multiplicity-restriction={severity=ERROR, lower-multiplicity=0, upper-multiplicity=1}, unresolved-reference-restriction=severity=ERROR
        BswQueuedDataReceptionPolicy
          class content conditional Invariant
            primitive attribute tailoring queueLength: in-scope=false, multiplicity-restriction={severity=ERROR, lower-multiplicity=0, upper-multiplicity=1}, default-value-handling=NO-DEFAULT
        BswSchedulableEntity
          class content conditional Invariant
      abstract class tailoring BswScheduleEvent: multiplicity-restriction={severity=INFO, lower-multiplicity=0, upper-multiplicity-infinite=true}
        class content conditional Invariant
      7 x concrete class tailoring, all with in-scope=false, multiplicity-restriction={severity=INFO, lower-multiplicity=0, upper-multiplicity-infinite=true}, validation-root=false:
        BswSchedulerNamePrefix
          class content conditional Invariant
        BswServiceDependency
          class content conditional Invariant
            attribute-tailorings:
              aggregation tailoring assignedData: in-scope=false, multiplicity-restriction={severity=ERROR, lower-multiplicity=0, upper-multiplicity-infinite=true}, variation-restriction={severity=ERROR, variation=true, valid-binding-times=[BLUEPRINT-DERIVATION-TIME, SYSTEM-DESIGN-TIME, CODE-GENERATION-TIME, PRE-COMPILE-TIME]}
              aggregation tailoring assignedEntryRole: in-scope=false, multiplicity-restriction={severity=ERROR, lower-multiplicity=0, upper-multiplicity-infinite=true}, variation-restriction={severity=ERROR, variation=true, valid-binding-times=[BLUEPRINT-DERIVATION-TIME, SYSTEM-DESIGN-TIME, CODE-GENERATION-TIME, PRE-COMPILE-TIME]}
              aggregation tailoring serviceNeeds: in-scope=false, multiplicity-restriction={severity=ERROR, lower-multiplicity=0, upper-multiplicity=1}
        BswSynchronousServerCallPoint
          class content conditional Invariant
            attribute-tailorings:
              reference tailoring calledEntry: in-scope=false, multiplicity-restriction={severity=ERROR, lower-multiplicity=0, upper-multiplicity=1}, unresolved-reference-restriction=severity=ERROR
              reference tailoring calledFromWithinExclusiveArea: in-scope=false, multiplicity-restriction={severity=ERROR, lower-multiplicity=0, upper-multiplicity=1}, unresolved-reference-restriction=severity=ERROR
        BswTimingEvent
          class content conditional Invariant
            primitive attribute tailoring period: in-scope=false, multiplicity-restriction={severity=ERROR, lower-multiplicity=0, upper-multiplicity=1}, default-value-handling=NO-DEFAULT
        BswTriggerDirectImplementation
          class content conditional Invariant
            attribute-tailorings:
              reference tailoring masteredTrigger: in-scope=false, multiplicity-restriction={severity=ERROR, lower-multiplicity=0, upper-multiplicity=1}, unresolved-reference-restriction=severity=ERROR
              primitive attribute tailoring task: in-scope=false, multiplicity-restriction={severity=ERROR, lower-multiplicity=0, upper-multiplicity=1}, default-value-handling=NO-DEFAULT
                sub-attribute-tailorings:
                  primitive attribute tailoring namePattern: in-scope=false, multiplicity-restriction={severity=ERROR, lower-multiplicity=0, upper-multiplicity=1}, default-value-handling=NO-DEFAULT
        BswVariableAccess
          class content conditional Invariant
            attribute-tailorings:
              reference tailoring accessedVariable: in-scope=false, multiplicity-restriction={severity=ERROR, lower-multiplicity=0, upper-multiplicity=1}, unresolved-reference-restriction=severity=ERROR
              reference tailoring contextLimitation: in-scope=false, multiplicity-restriction={severity=ERROR, lower-multiplicity=0, upper-multiplicity-infinite=true}, unresolved-reference-restriction=severity=ERROR
        BuildAction
          class content conditional Invariant
            attribute-tailorings:
              aggregation tailoring createdData: in-scope=false, multiplicity-restriction={severity=ERROR, lower-multiplicity=0, upper-multiplicity-infinite=true}
              reference tailoring followUpAction: in-scope=false, multiplicity-restriction={severity=ERROR, lower-multiplicity=0, upper-multiplicity-infinite=true}, unresolved-reference-restriction=severity=ERROR
              aggregation tailoring inputData: in-scope=false, multiplicity-restriction={severity=ERROR, lower-multiplicity=0, upper-multiplicity-infinite=true}
              aggregation tailoring modifiedData: in-scope=false, multiplicity-restriction={severity=ERROR, lower-multiplicity=0, upper-multiplicity-infinite=true}
              reference tailoring predecessorAction: in-scope=false, multiplicity-restriction={severity=ERROR, lower-multiplicity=0, upper-multiplicity-infinite=true}, unresolved-reference-restriction=severity=ERROR
              reference tailoring requiredEnvironment: in-scope=false, multiplicity-restriction={severity=ERROR, lower-multiplicity=0, upper-multiplicity=1}, unresolved-reference-restriction=severity=ERROR
      abstract class tailoring BuildActionEntity: multiplicity-restriction={severity=INFO, lower-multiplicity=0, upper-multiplicity-infinite=true}
        class content conditional Invariant
          attribute-tailorings:
            aggregation tailoring deliveryArtifact: in-scope=false, multiplicity-restriction={severity=ERROR, lower-multiplicity=0, upper-multiplicity-infinite=true}
            aggregation tailoring invocation: in-scope=false, multiplicity-restriction={severity=ERROR, lower-multiplicity=0, upper-multiplicity=1}
      6 x concrete class tailoring, all with in-scope=false, multiplicity-restriction={severity=INFO, lower-multiplicity=0, upper-multiplicity-infinite=true}, validation-root=false:
        BuildActionEnvironment
          class content conditional Invariant
            attribute-tailorings:
              aggregation tailoring sdg: in-scope=false, multiplicity-restriction={severity=ERROR, lower-multiplicity=0, upper-multiplicity-infinite=true}
        BuildActionInvocator
          class content conditional Invariant
            attribute-tailorings:
              primitive attribute tailoring command: in-scope=false, multiplicity-restriction={severity=ERROR, lower-multiplicity=0, upper-multiplicity=1}, default-value-handling=NO-DEFAULT
                sub-attribute-tailorings:
                  primitive attribute tailoring xmlSpace: in-scope=false, multiplicity-restriction={severity=ERROR, lower-multiplicity=0, upper-multiplicity=1}, default-value-handling=NO-DEFAULT
              aggregation tailoring sdg: in-scope=false, multiplicity-restriction={severity=ERROR, lower-multiplicity=0, upper-multiplicity-infinite=true}
        BuildActionIoElement
          class content conditional Invariant
            attribute-tailorings:
              primitive attribute tailoring category: in-scope=false, multiplicity-restriction={severity=ERROR, lower-multiplicity=0, upper-multiplicity=1}, default-value-handling=NO-DEFAULT
              reference tailoring ecucDefinition: in-scope=false, multiplicity-restriction={severity=ERROR, lower-multiplicity=0, upper-multiplicity=1}, unresolved-reference-restriction=severity=ERROR
              aggregation tailoring engineeringObject: in-scope=false, multiplicity-restriction={severity=ERROR, lower-multiplicity=0, upper-multiplicity=1}
              aggregation tailoring foreignModelReference: in-scope=false, multiplicity-restriction={severity=ERROR, lower-multiplicity=0, upper-multiplicity=1}
              aggregation tailoring modelObjectReference: in-scope=false, multiplicity-restriction={severity=ERROR, lower-multiplicity=0, upper-multiplicity=1}
              primitive attribute tailoring role: in-scope=false, multiplicity-restriction={severity=ERROR, lower-multiplicity=0, upper-multiplicity=1}, default-value-handling=NO-DEFAULT
                sub-attribute-tailorings:
                  primitive attribute tailoring namePattern: in-scope=false, multiplicity-restriction={severity=ERROR, lower-multiplicity=0, upper-multiplicity=1}, default-value-handling=NO-DEFAULT
              aggregation tailoring sdg: in-scope=false, multiplicity-restriction={severity=ERROR, lower-multiplicity=0, upper-multiplicity-infinite=true}
        BuildActionManifest
          class content conditional Invariant
            attribute-tailorings:
              aggregation tailoring buildAction: in-scope=false, multiplicity-restriction={severity=ERROR, lower-multiplicity=0, upper-multiplicity-infinite=true}, variation-restriction={severity=ERROR, variation=true, valid-binding-times=BLUEPRINT-DERIVATION-TIME}
              aggregation tailoring buildActionEnvironment: in-scope=false, multiplicity-restriction={severity=ERROR, lower-multiplicity=0, upper-multiplicity-infinite=true}, variation-restriction={severity=ERROR, variation=true, valid-binding-times=BLUEPRINT-DERIVATION-TIME}
              reference tailoring dynamicAction: in-scope=false, multiplicity-restriction={severity=ERROR, lower-multiplicity=0, upper-multiplicity-infinite=true}, unresolved-reference-restriction=severity=ERROR
              reference tailoring startAction: in-scope=false, multiplicity-restriction={severity=ERROR, lower-multiplicity=0, upper-multiplicity-infinite=true}, unresolved-reference-restriction=severity=ERROR
              reference tailoring tearDownAction: in-scope=false, multiplicity-restriction={severity=ERROR, lower-multiplicity=0, upper-multiplicity-infinite=true}, unresolved-reference-restriction=severity=ERROR
        BuildEngineeringObject
          class content conditional Invariant
            6 x primitive attribute tailoring, all with in-scope=false, multiplicity-restriction={severity=ERROR, lower-multiplicity=0, upper-multiplicity=1}, default-value-handling=NO-DEFAULT:
              fileType
              fileTypePattern
              intendedFilename
              parentCategory
              parentShortLabel
              shortLabelPattern
        BurstPatternEventTriggering
          class content conditional Invariant
            attribute-tailorings:
              primitive attribute tailoring maxNumberOfOccurrences: in-scope=false, multiplicity-restriction={severity=ERROR, lower-multiplicity=0, upper-multiplicity=1}, default-value-handling=NO-DEFAULT
              primitive attribute tailoring minNumberOfOccurrences: in-scope=false, multiplicity-restriction={severity=ERROR, lower-multiplicity=0, upper-multiplicity=1}, default-value-handling=NO-DEFAULT
              4 x aggregation tailoring, all with in-scope=false, multiplicity-restriction={severity=ERROR, lower-multiplicity=0, upper-multiplicity=1}:
                minimumInterArrivalTime
                patternJitter
                patternLength
                patternPeriod
      abstract class tailoring BusspecificNmEcu: multiplicity-restriction={severity=WARNING, lower-multiplicity=0, upper-multiplicity=0}  # Spec element has lifecycle state 'obsolete'.
        class content conditional Invariant
      33 x concrete class tailoring, all with in-scope=false, validation-root=false:
        CalibrationParameterValue: multiplicity-restriction={severity=INFO, lower-multiplicity=0, upper-multiplicity-infinite=true}
          class content conditional Invariant
            attribute-tailorings:
              aggregation tailoring applInitValue: in-scope=false, multiplicity-restriction={severity=ERROR, lower-multiplicity=0, upper-multiplicity=1}
              aggregation tailoring implInitValue: in-scope=false, multiplicity-restriction={severity=ERROR, lower-multiplicity=0, upper-multiplicity=1}
              reference tailoring initializedParameter: in-scope=false, multiplicity-restriction={severity=ERROR, lower-multiplicity=0, upper-multiplicity=1}, unresolved-reference-restriction=severity=ERROR
        CalibrationParameterValueSet: multiplicity-restriction={severity=INFO, lower-multiplicity=0, upper-multiplicity-infinite=true}
          class content conditional Invariant
            attribute-tailorings:
              aggregation tailoring calibrationParameterValue: in-scope=false, multiplicity-restriction={severity=ERROR, lower-multiplicity=0, upper-multiplicity-infinite=true}, variation-restriction={severity=ERROR, variation=true, valid-binding-times=[BLUEPRINT-DERIVATION-TIME, SYSTEM-DESIGN-TIME, CODE-GENERATION-TIME, PRE-COMPILE-TIME]}
        CanCluster: multiplicity-restriction={severity=INFO, lower-multiplicity=0, upper-multiplicity-infinite=true}
          class content conditional Invariant
        CanCommunicationConnector: multiplicity-restriction={severity=INFO, lower-multiplicity=0, upper-multiplicity-infinite=true}
          class content conditional Invariant
            5 x primitive attribute tailoring, all with in-scope=false, multiplicity-restriction={severity=ERROR, lower-multiplicity=0, upper-multiplicity=1}, default-value-handling=NO-DEFAULT:
              pncWakeupCanId
              pncWakeupCanIdExtended
              pncWakeupCanIdMask
              pncWakeupDataMask
              pncWakeupDlc
        CanCommunicationController: multiplicity-restriction={severity=INFO, lower-multiplicity=0, upper-multiplicity-infinite=true}
          class content conditional Invariant
        CanControllerConfiguration: multiplicity-restriction={severity=INFO, lower-multiplicity=0, upper-multiplicity-infinite=true}
          class content conditional Invariant
            4 x primitive attribute tailoring, all with in-scope=false, multiplicity-restriction={severity=ERROR, lower-multiplicity=0, upper-multiplicity=1}, default-value-handling=NO-DEFAULT:
              propSeg
              syncJumpWidth
              timeSeg1
              timeSeg2
        CanControllerConfigurationRequirements: multiplicity-restriction={severity=INFO, lower-multiplicity=0, upper-multiplicity-infinite=true}
          class content conditional Invariant
            6 x primitive attribute tailoring, all with in-scope=false, multiplicity-restriction={severity=ERROR, lower-multiplicity=0, upper-multiplicity=1}, default-value-handling=NO-DEFAULT:
              maxNumberOfTimeQuantaPerBit
              maxSamplePoint
              maxSyncJumpWidth
              minNumberOfTimeQuantaPerBit
              minSamplePoint
              minSyncJumpWidth
        CanControllerFdConfiguration: multiplicity-restriction={severity=INFO, lower-multiplicity=0, upper-multiplicity-infinite=true}
          class content conditional Invariant
            6 x primitive attribute tailoring, all with in-scope=false, multiplicity-restriction={severity=ERROR, lower-multiplicity=0, upper-multiplicity=1}, default-value-handling=NO-DEFAULT:
              propSeg
              syncJumpWidth
              timeSeg1
              timeSeg2
              trcvDelayCompensationOffset
              txBitRateSwitch
        CanFrame: multiplicity-restriction={severity=INFO, lower-multiplicity=0, upper-multiplicity-infinite=true}
          class content conditional Invariant
        CanFrameTriggering: multiplicity-restriction={severity=INFO, lower-multiplicity=0, upper-multiplicity-infinite=true}
          class content conditional Invariant
            attribute-tailorings:
              aggregation tailoring absolutelyScheduledTiming: in-scope=false, multiplicity-restriction={severity=ERROR, lower-multiplicity=0, upper-multiplicity-infinite=true}
              primitive attribute tailoring canAddressingMode: in-scope=false, multiplicity-restriction={severity=ERROR, lower-multiplicity=0, upper-multiplicity=1}, default-value-handling=NO-DEFAULT
              primitive attribute tailoring canFdFrameSupport: in-scope=false, multiplicity-restriction={severity=ERROR, lower-multiplicity=0, upper-multiplicity=1}, default-value-handling=NO-DEFAULT
              primitive attribute tailoring identifier: in-scope=false, multiplicity-restriction={severity=ERROR, lower-multiplicity=0, upper-multiplicity=1}, default-value-handling=NO-DEFAULT
              aggregation tailoring rxIdentifierRange: in-scope=false, multiplicity-restriction={severity=ERROR, lower-multiplicity=0, upper-multiplicity=1}
              primitive attribute tailoring rxMask: in-scope=false, multiplicity-restriction={severity=ERROR, lower-multiplicity=0, upper-multiplicity=1}, default-value-handling=NO-DEFAULT
              primitive attribute tailoring txMask: in-scope=false, multiplicity-restriction={severity=ERROR, lower-multiplicity=0, upper-multiplicity=1}, default-value-handling=NO-DEFAULT
        CanNmCluster: multiplicity-restriction={severity=INFO, lower-multiplicity=0, upper-multiplicity-infinite=true}
          class content conditional Invariant
            17 x primitive attribute tailoring, all with in-scope=false, default-value-handling=NO-DEFAULT:
              nmBusloadReductionActive: multiplicity-restriction={severity=ERROR, lower-multiplicity=0, upper-multiplicity=1}
              nmCarWakeUpBitPosition: multiplicity-restriction={severity=ERROR, lower-multiplicity=0, upper-multiplicity=1}
              nmCarWakeUpFilterEnabled: multiplicity-restriction={severity=ERROR, lower-multiplicity=0, upper-multiplicity=1}
              nmCarWakeUpFilterNodeId: multiplicity-restriction={severity=ERROR, lower-multiplicity=0, upper-multiplicity=1}
              nmCarWakeUpRxEnabled: multiplicity-restriction={severity=ERROR, lower-multiplicity=0, upper-multiplicity=1}
              nmCbvPosition: multiplicity-restriction={severity=ERROR, lower-multiplicity=0, upper-multiplicity=1}
              nmChannelActive: multiplicity-restriction={severity=WARNING, lower-multiplicity=0, upper-multiplicity=0}  # Spec element has lifecycle state 'obsolete' since 4.1.2.
              nmImmediateNmCycleTime: multiplicity-restriction={severity=ERROR, lower-multiplicity=0, upper-multiplicity=1}
              nmImmediateNmTransmissions: multiplicity-restriction={severity=ERROR, lower-multiplicity=0, upper-multiplicity=1}
              nmMessageTimeoutTime: multiplicity-restriction={severity=ERROR, lower-multiplicity=0, upper-multiplicity=1}
              nmMsgCycleTime: multiplicity-restriction={severity=ERROR, lower-multiplicity=0, upper-multiplicity=1}
              nmNetworkTimeout: multiplicity-restriction={severity=ERROR, lower-multiplicity=0, upper-multiplicity=1}
              nmNidPosition: multiplicity-restriction={severity=ERROR, lower-multiplicity=0, upper-multiplicity=1}
              nmRemoteSleepIndicationTime: multiplicity-restriction={severity=ERROR, lower-multiplicity=0, upper-multiplicity=1}
              nmRepeatMessageTime: multiplicity-restriction={severity=ERROR, lower-multiplicity=0, upper-multiplicity=1}
              nmUserDataLength: multiplicity-restriction={severity=WARNING, lower-multiplicity=0, upper-multiplicity=0}  # Spec element has lifecycle state 'obsolete' since 4.1.3.
              nmWaitBusSleepTime: multiplicity-restriction={severity=ERROR, lower-multiplicity=0, upper-multiplicity=1}
        CanNmClusterCoupling: multiplicity-restriction={severity=INFO, lower-multiplicity=0, upper-multiplicity-infinite=true}
          class content conditional Invariant
            attribute-tailorings:
              reference tailoring coupledCluster: in-scope=false, multiplicity-restriction={severity=ERROR, lower-multiplicity=0, upper-multiplicity-infinite=true}, unresolved-reference-restriction=severity=ERROR
              primitive attribute tailoring nmBusloadReductionEnabled: in-scope=false, multiplicity-restriction={severity=ERROR, lower-multiplicity=0, upper-multiplicity=1}, default-value-handling=NO-DEFAULT
              primitive attribute tailoring nmImmediateRestartEnabled: in-scope=false, multiplicity-restriction={severity=ERROR, lower-multiplicity=0, upper-multiplicity=1}, default-value-handling=NO-DEFAULT
        CanNmEcu: multiplicity-restriction={severity=INFO, lower-multiplicity=0, upper-multiplicity-infinite=true}
          class content conditional Invariant
            primitive attribute tailoring nmRepeatMsgIndicationEnabled: in-scope=false, multiplicity-restriction={severity=WARNING, lower-multiplicity=0, upper-multiplicity=0}, default-value-handling=NO-DEFAULT  # Spec element has lifecycle state 'obsolete'.
        CanNmNode: multiplicity-restriction={severity=INFO, lower-multiplicity=0, upper-multiplicity-infinite=true}
          class content conditional Invariant
            attribute-tailorings:
              primitive attribute tailoring nmMsgCycleOffset: in-scope=false, multiplicity-restriction={severity=ERROR, lower-multiplicity=0, upper-multiplicity=1}, default-value-handling=NO-DEFAULT
              primitive attribute tailoring nmMsgReducedTime: in-scope=false, multiplicity-restriction={severity=ERROR, lower-multiplicity=0, upper-multiplicity=1}, default-value-handling=NO-DEFAULT
              aggregation tailoring nmRangeConfig: in-scope=false, multiplicity-restriction={severity=ERROR, lower-multiplicity=0, upper-multiplicity=1}
        CanNmRangeConfig: multiplicity-restriction={severity=WARNING, lower-multiplicity=0, upper-multiplicity=0}  # Spec element has lifecycle state 'obsolete'.
          class content conditional Invariant
            primitive attribute tailoring lowerCanId: in-scope=false, multiplicity-restriction={severity=ERROR, lower-multiplicity=0, upper-multiplicity=1}, default-value-handling=NO-DEFAULT
            primitive attribute tailoring upperCanId: in-scope=false, multiplicity-restriction={severity=ERROR, lower-multiplicity=0, upper-multiplicity=1}, default-value-handling=NO-DEFAULT
        CanPhysicalChannel: multiplicity-restriction={severity=INFO, lower-multiplicity=0, upper-multiplicity-infinite=true}
          class content conditional Invariant
        CanTpAddress: multiplicity-restriction={severity=INFO, lower-multiplicity=0, upper-multiplicity-infinite=true}
          class content conditional Invariant
            primitive attribute tailoring tpAddress: in-scope=false, multiplicity-restriction={severity=ERROR, lower-multiplicity=0, upper-multiplicity=1}, default-value-handling=NO-DEFAULT
            primitive attribute tailoring tpAddressExtensionValue: in-scope=false, multiplicity-restriction={severity=ERROR, lower-multiplicity=0, upper-multiplicity=1}, default-value-handling=NO-DEFAULT
        CanTpChannel: multiplicity-restriction={severity=INFO, lower-multiplicity=0, upper-multiplicity-infinite=true}
          class content conditional Invariant
            primitive attribute tailoring channelId: in-scope=false, multiplicity-restriction={severity=ERROR, lower-multiplicity=0, upper-multiplicity=1}, default-value-handling=NO-DEFAULT
            primitive attribute tailoring channelMode: in-scope=false, multiplicity-restriction={severity=ERROR, lower-multiplicity=0, upper-multiplicity=1}, default-value-handling=NO-DEFAULT
        CanTpConfig: multiplicity-restriction={severity=INFO, lower-multiplicity=0, upper-multiplicity-infinite=true}
          class content conditional Invariant
            attribute-tailorings:
              5 x aggregation tailoring, all with in-scope=false, multiplicity-restriction={severity=ERROR, lower-multiplicity=0, upper-multiplicity-infinite=true}, variation-restriction={severity=ERROR, variation=true, valid-binding-times=[BLUEPRINT-DERIVATION-TIME, SYSTEM-DESIGN-TIME, CODE-GENERATION-TIME, PRE-COMPILE-TIME, LINK-TIME, POST-BUILD]}:
                tpAddress
                tpChannel
                tpConnection
                tpEcu
                tpNode
        CanTpConnection: multiplicity-restriction={severity=INFO, lower-multiplicity=0, upper-multiplicity-infinite=true}
          class content conditional Invariant
            attribute-tailorings:
              primitive attribute tailoring addressingFormat: in-scope=false, multiplicity-restriction={severity=ERROR, lower-multiplicity=0, upper-multiplicity=1}, default-value-handling=NO-DEFAULT
              reference tailoring canTpChannel: in-scope=false, multiplicity-restriction={severity=ERROR, lower-multiplicity=0, upper-multiplicity=1}, unresolved-reference-restriction=severity=ERROR
              primitive attribute tailoring cancellation: in-scope=false, multiplicity-restriction={severity=ERROR, lower-multiplicity=0, upper-multiplicity=1}, default-value-handling=NO-DEFAULT
              reference tailoring dataPdu: in-scope=false, multiplicity-restriction={severity=ERROR, lower-multiplicity=0, upper-multiplicity=1}, unresolved-reference-restriction=severity=ERROR
              reference tailoring flowControlPdu: in-scope=false, multiplicity-restriction={severity=ERROR, lower-multiplicity=0, upper-multiplicity=1}, unresolved-reference-restriction=severity=ERROR
              primitive attribute tailoring maxBlockSize: in-scope=false, multiplicity-restriction={severity=ERROR, lower-multiplicity=0, upper-multiplicity=1}, default-value-handling=NO-DEFAULT
              reference tailoring multicast: in-scope=false, multiplicity-restriction={severity=ERROR, lower-multiplicity=0, upper-multiplicity=1}, unresolved-reference-restriction=severity=ERROR
              primitive attribute tailoring paddingActivation: in-scope=false, multiplicity-restriction={severity=ERROR, lower-multiplicity=0, upper-multiplicity=1}, default-value-handling=NO-DEFAULT
              reference tailoring receiver: in-scope=false, multiplicity-restriction={severity=ERROR, lower-multiplicity=0, upper-multiplicity-infinite=true}, unresolved-reference-restriction=severity=ERROR
              5 x primitive attribute tailoring, all with in-scope=false, multiplicity-restriction={severity=ERROR, lower-multiplicity=0, upper-multiplicity=1}, default-value-handling=NO-DEFAULT:
                taType
                timeoutBr
                timeoutBs
                timeoutCr
                timeoutCs
              reference tailoring tpSdu: in-scope=false, multiplicity-restriction={severity=ERROR, lower-multiplicity=0, upper-multiplicity=1}, unresolved-reference-restriction=severity=ERROR
              primitive attribute tailoring transmitCancellation: in-scope=false, multiplicity-restriction={severity=WARNING, lower-multiplicity=0, upper-multiplicity=0}, default-value-handling=NO-DEFAULT  # Spec element has lifecycle state 'obsolete' since 4.1.3. Replaced by CanTpConnection.cancellation.
              reference tailoring transmitter: in-scope=false, multiplicity-restriction={severity=ERROR, lower-multiplicity=0, upper-multiplicity=1}, unresolved-reference-restriction=severity=ERROR
        CanTpEcu: multiplicity-restriction={severity=INFO, lower-multiplicity=0, upper-multiplicity-infinite=true}
          class content conditional Invariant
            attribute-tailorings:
              primitive attribute tailoring cycleTimeMainFunction: in-scope=false, multiplicity-restriction={severity=ERROR, lower-multiplicity=0, upper-multiplicity=1}, default-value-handling=NO-DEFAULT
              reference tailoring ecuInstance: in-scope=false, multiplicity-restriction={severity=ERROR, lower-multiplicity=0, upper-multiplicity=1}, unresolved-reference-restriction=severity=ERROR
        CanTpNode: multiplicity-restriction={severity=INFO, lower-multiplicity=0, upper-multiplicity-infinite=true}
          class content conditional Invariant
            attribute-tailorings:
              reference tailoring connector: in-scope=false, multiplicity-restriction={severity=ERROR, lower-multiplicity=0, upper-multiplicity=1}, unresolved-reference-restriction=severity=ERROR
              4 x primitive attribute tailoring, all with in-scope=false, multiplicity-restriction={severity=ERROR, lower-multiplicity=0, upper-multiplicity=1}, default-value-handling=NO-DEFAULT:
                maxFcWait
                stMin
                timeoutAr
                timeoutAs
              reference tailoring tpAddress: in-scope=false, multiplicity-restriction={severity=ERROR, lower-multiplicity=0, upper-multiplicity=1}, unresolved-reference-restriction=severity=ERROR
        Caption: multiplicity-restriction={severity=INFO, lower-multiplicity=0, upper-multiplicity-infinite=true}
          class content conditional Invariant
        Chapter: multiplicity-restriction={severity=INFO, lower-multiplicity=0, upper-multiplicity-infinite=true}
          class content conditional Invariant
            attribute-tailorings:
              aggregation tailoring chapterModel: in-scope=false, multiplicity-restriction={severity=ERROR, lower-multiplicity=0, upper-multiplicity=1}
              primitive attribute tailoring helpEntry: in-scope=false, multiplicity-restriction={severity=ERROR, lower-multiplicity=0, upper-multiplicity=1}, default-value-handling=NO-DEFAULT
        ChapterContent: multiplicity-restriction={severity=INFO, lower-multiplicity=0, upper-multiplicity-infinite=true}
          class content conditional Invariant
            attribute-tailorings:
              aggregation tailoring prms: in-scope=false, multiplicity-restriction={severity=ERROR, lower-multiplicity=0, upper-multiplicity-infinite=true}  # Multiplicity is 0..* since attribute is contained in mixed / mixedString class.
              aggregation tailoring topicContent: in-scope=false, multiplicity-restriction={severity=ERROR, lower-multiplicity=0, upper-multiplicity-infinite=true}  # Multiplicity is 0..* since attribute is contained in mixed / mixedString class.
        ChapterModel: multiplicity-restriction={severity=INFO, lower-multiplicity=0, upper-multiplicity-infinite=true}
          class content conditional Invariant
            attribute-tailorings:
              aggregation tailoring chapter: in-scope=false, multiplicity-restriction={severity=ERROR, lower-multiplicity=0, upper-multiplicity=1}
              aggregation tailoring chapterContent: in-scope=false, multiplicity-restriction={severity=ERROR, lower-multiplicity=0, upper-multiplicity=1}
              aggregation tailoring topic1: in-scope=false, multiplicity-restriction={severity=ERROR, lower-multiplicity=0, upper-multiplicity=1}
        ChapterOrMsrQuery: multiplicity-restriction={severity=INFO, lower-multiplicity=0, upper-multiplicity-infinite=true}
          class content conditional Invariant
            attribute-tailorings:
              aggregation tailoring chapter: in-scope=false, multiplicity-restriction={severity=ERROR, lower-multiplicity=0, upper-multiplicity-infinite=true}, variation-restriction={severity=ERROR, variation=true, valid-binding-times=[BLUEPRINT-DERIVATION-TIME, SYSTEM-DESIGN-TIME, CODE-GENERATION-TIME, PRE-COMPILE-TIME, LINK-TIME, POST-BUILD]}  # Multiplicity is 0..* since attribute is contained in mixed / mixedString class.
              aggregation tailoring msrQueryChapter: in-scope=false, multiplicity-restriction={severity=ERROR, lower-multiplicity=0, upper-multiplicity-infinite=true}  # Multiplicity is 0..* since attribute is contained in mixed / mixedString class.
        ClientComSpec: multiplicity-restriction={severity=INFO, lower-multiplicity=0, upper-multiplicity-infinite=true}
          class content conditional Invariant
            attribute-tailorings:
              reference tailoring operation: in-scope=false, multiplicity-restriction={severity=ERROR, lower-multiplicity=0, upper-multiplicity=1}, unresolved-reference-restriction=severity=ERROR
        ClientIdMapping: multiplicity-restriction={severity=INFO, lower-multiplicity=0, upper-multiplicity-infinite=true}
          class content conditional Invariant
            attribute-tailorings:
              reference tailoring systemSignal: in-scope=false, multiplicity-restriction={severity=ERROR, lower-multiplicity=0, upper-multiplicity=1}, unresolved-reference-restriction=severity=ERROR
        ClientServerAnnotation: multiplicity-restriction={severity=INFO, lower-multiplicity=0, upper-multiplicity-infinite=true}
          class content conditional Invariant
            attribute-tailorings:
              reference tailoring operation: in-scope=false, multiplicity-restriction={severity=ERROR, lower-multiplicity=0, upper-multiplicity=1}, unresolved-reference-restriction=severity=ERROR
        ClientServerApplicationErrorMapping: multiplicity-restriction={severity=INFO, lower-multiplicity=0, upper-multiplicity-infinite=true}
          class content conditional Invariant
            attribute-tailorings:
              reference tailoring firstApplicationError: in-scope=false, multiplicity-restriction={severity=ERROR, lower-multiplicity=0, upper-multiplicity=1}, unresolved-reference-restriction=severity=ERROR
              reference tailoring secondApplicationError: in-scope=false, multiplicity-restriction={severity=ERROR, lower-multiplicity=0, upper-multiplicity=1}, unresolved-reference-restriction=severity=ERROR
        ClientServerArrayElementMapping: multiplicity-restriction={severity=INFO, lower-multiplicity=0, upper-multiplicity-infinite=true}
          class content conditional Invariant
            attribute-tailorings:
              aggregation tailoring complexTypeMapping: in-scope=false, multiplicity-restriction={severity=ERROR, lower-multiplicity=0, upper-multiplicity=1}
              aggregation tailoring indexedArrayElement: in-scope=false, multiplicity-restriction={severity=ERROR, lower-multiplicity=0, upper-multiplicity=1}
              reference tailoring systemSignal: in-scope=false, multiplicity-restriction={severity=ERROR, lower-multiplicity=0, upper-multiplicity=1}, unresolved-reference-restriction=severity=ERROR
        ClientServerArrayTypeMapping: multiplicity-restriction={severity=INFO, lower-multiplicity=0, upper-multiplicity-infinite=true}
          class content conditional Invariant
            attribute-tailorings:
              aggregation tailoring arrayElementMapping: in-scope=false, multiplicity-restriction={severity=ERROR, lower-multiplicity=0, upper-multiplicity-infinite=true}
      abstract class tailoring ClientServerCompositeTypeMapping: multiplicity-restriction={severity=INFO, lower-multiplicity=0, upper-multiplicity-infinite=true}
        class content conditional Invariant
          attribute-tailorings:
            reference tailoring argument: in-scope=false, multiplicity-restriction={severity=ERROR, lower-multiplicity=0, upper-multiplicity=1}, unresolved-reference-restriction=severity=ERROR
      10 x concrete class tailoring, all with in-scope=false, validation-root=false:
        ClientServerInterface: multiplicity-restriction={severity=INFO, lower-multiplicity=0, upper-multiplicity-infinite=true}
          class content conditional Invariant
            attribute-tailorings:
              aggregation tailoring operation: in-scope=false, multiplicity-restriction={severity=ERROR, lower-multiplicity=0, upper-multiplicity-infinite=true}, variation-restriction={severity=ERROR, variation=true, valid-binding-times=BLUEPRINT-DERIVATION-TIME}
              aggregation tailoring possibleError: in-scope=false, multiplicity-restriction={severity=ERROR, lower-multiplicity=0, upper-multiplicity-infinite=true}
        ClientServerInterfaceMapping: multiplicity-restriction={severity=INFO, lower-multiplicity=0, upper-multiplicity-infinite=true}
          class content conditional Invariant
            attribute-tailorings:
              aggregation tailoring errorMapping: in-scope=false, multiplicity-restriction={severity=ERROR, lower-multiplicity=0, upper-multiplicity-infinite=true}
              aggregation tailoring operationMapping: in-scope=false, multiplicity-restriction={severity=ERROR, lower-multiplicity=0, upper-multiplicity-infinite=true}
        ClientServerOperation: multiplicity-restriction={severity=INFO, lower-multiplicity=0, upper-multiplicity-infinite=true}
          class content conditional Invariant
            attribute-tailorings:
              aggregation tailoring argument: in-scope=false, multiplicity-restriction={severity=ERROR, lower-multiplicity=0, upper-multiplicity-infinite=true}, variation-restriction={severity=ERROR, variation=true, valid-binding-times=BLUEPRINT-DERIVATION-TIME}
              reference tailoring possibleError: in-scope=false, multiplicity-restriction={severity=ERROR, lower-multiplicity=0, upper-multiplicity-infinite=true}, unresolved-reference-restriction=severity=ERROR
        ClientServerOperationMapping: multiplicity-restriction={severity=INFO, lower-multiplicity=0, upper-multiplicity-infinite=true}
          class content conditional Invariant
            attribute-tailorings:
              aggregation tailoring argumentMapping: in-scope=false, multiplicity-restriction={severity=ERROR, lower-multiplicity=0, upper-multiplicity-infinite=true}
              reference tailoring firstOperation: in-scope=false, multiplicity-restriction={severity=ERROR, lower-multiplicity=0, upper-multiplicity=1}, unresolved-reference-restriction=severity=ERROR
              reference tailoring secondOperation: in-scope=false, multiplicity-restriction={severity=ERROR, lower-multiplicity=0, upper-multiplicity=1}, unresolved-reference-restriction=severity=ERROR
        ClientServerPrimitiveTypeMapping: multiplicity-restriction={severity=INFO, lower-multiplicity=0, upper-multiplicity-infinite=true}
          class content conditional Invariant
            attribute-tailorings:
              reference tailoring argument: in-scope=false, multiplicity-restriction={severity=ERROR, lower-multiplicity=0, upper-multiplicity=1}, unresolved-reference-restriction=severity=ERROR
              reference tailoring systemSignal: in-scope=false, multiplicity-restriction={severity=ERROR, lower-multiplicity=0, upper-multiplicity=1}, unresolved-reference-restriction=severity=ERROR
        ClientServerRecordElementMapping: multiplicity-restriction={severity=INFO, lower-multiplicity=0, upper-multiplicity-infinite=true}
          class content conditional Invariant
            attribute-tailorings:
              reference tailoring applicationRecordElement: in-scope=false, multiplicity-restriction={severity=ERROR, lower-multiplicity=0, upper-multiplicity=1}, unresolved-reference-restriction=severity=ERROR
              aggregation tailoring complexTypeMapping: in-scope=false, multiplicity-restriction={severity=ERROR, lower-multiplicity=0, upper-multiplicity=1}
              reference tailoring implementationRecordElement: in-scope=false, multiplicity-restriction={severity=ERROR, lower-multiplicity=0, upper-multiplicity=1}, unresolved-reference-restriction=severity=ERROR
              reference tailoring systemSignal: in-scope=false, multiplicity-restriction={severity=ERROR, lower-multiplicity=0, upper-multiplicity=1}, unresolved-reference-restriction=severity=ERROR
        ClientServerRecordTypeMapping: multiplicity-restriction={severity=INFO, lower-multiplicity=0, upper-multiplicity-infinite=true}
          class content conditional Invariant
            attribute-tailorings:
              aggregation tailoring recordElementMapping: in-scope=false, multiplicity-restriction={severity=ERROR, lower-multiplicity=0, upper-multiplicity-infinite=true}
        ClientServerToSignalGroupMapping: multiplicity-restriction={severity=WARNING, lower-multiplicity=0, upper-multiplicity=0}  # Spec element has lifecycle state 'obsolete'.
          class content conditional Invariant
            attribute-tailorings:
              6 x aggregation tailoring, all with in-scope=false:
                applicationError: multiplicity-restriction={severity=ERROR, lower-multiplicity=0, upper-multiplicity=1}
                clientID: multiplicity-restriction={severity=ERROR, lower-multiplicity=0, upper-multiplicity=1}
                compositeTypeMapping: multiplicity-restriction={severity=ERROR, lower-multiplicity=0, upper-multiplicity-infinite=true}
                emptySignal: multiplicity-restriction={severity=ERROR, lower-multiplicity=0, upper-multiplicity=1}
                mappedOperation: multiplicity-restriction={severity=ERROR, lower-multiplicity=0, upper-multiplicity=1}
                primitiveTypeMapping: multiplicity-restriction={severity=ERROR, lower-multiplicity=0, upper-multiplicity-infinite=true}
              reference tailoring requestGroup: in-scope=false, multiplicity-restriction={severity=ERROR, lower-multiplicity=0, upper-multiplicity=1}, unresolved-reference-restriction=severity=ERROR
              reference tailoring responseGroup: in-scope=false, multiplicity-restriction={severity=ERROR, lower-multiplicity=0, upper-multiplicity=1}, unresolved-reference-restriction=severity=ERROR
              aggregation tailoring sequenceCounter: in-scope=false, multiplicity-restriction={severity=ERROR, lower-multiplicity=0, upper-multiplicity=1}
        ClientServerToSignalMapping: multiplicity-restriction={severity=INFO, lower-multiplicity=0, upper-multiplicity=0}  # Spec element has lifecycle state 'draft'.
          class content conditional Invariant
            attribute-tailorings:
              reference tailoring callSignal: in-scope=false, multiplicity-restriction={severity=ERROR, lower-multiplicity=0, upper-multiplicity=1}, unresolved-reference-restriction=severity=ERROR
              aggregation tailoring clientServerOperation: in-scope=false, multiplicity-restriction={severity=ERROR, lower-multiplicity=0, upper-multiplicity=1}
              primitive attribute tailoring lengthClientId: in-scope=false, multiplicity-restriction={severity=ERROR, lower-multiplicity=0, upper-multiplicity=1}, default-value-handling=NO-DEFAULT
              primitive attribute tailoring lengthSequenceCounter: in-scope=false, multiplicity-restriction={severity=ERROR, lower-multiplicity=0, upper-multiplicity=1}, default-value-handling=NO-DEFAULT
              reference tailoring returnSignal: in-scope=false, multiplicity-restriction={severity=ERROR, lower-multiplicity=0, upper-multiplicity=1}, unresolved-reference-restriction=severity=ERROR
              reference tailoring serializer: in-scope=false, multiplicity-restriction={severity=ERROR, lower-multiplicity=0, upper-multiplicity=1}, unresolved-reference-restriction=severity=ERROR
        Code: multiplicity-restriction={severity=INFO, lower-multiplicity=0, upper-multiplicity-infinite=true}
          class content conditional Invariant
            attribute-tailorings:
              aggregation tailoring artifactDescriptor: in-scope=false, multiplicity-restriction={severity=ERROR, lower-multiplicity=0, upper-multiplicity-infinite=true}
      abstract class tailoring CollectableElement: multiplicity-restriction={severity=INFO, lower-multiplicity=0, upper-multiplicity-infinite=true}
        class content conditional Invariant
      concrete class tailoring Collection: in-scope=false, multiplicity-restriction={severity=INFO, lower-multiplicity=0, upper-multiplicity-infinite=true}, validation-root=false
        class content conditional Invariant
          attribute-tailorings:
            primitive attribute tailoring autoCollect: in-scope=false, multiplicity-restriction={severity=ERROR, lower-multiplicity=0, upper-multiplicity=1}, default-value-handling=NO-DEFAULT
            aggregation tailoring collectedInstance: in-scope=false, multiplicity-restriction={severity=ERROR, lower-multiplicity=0, upper-multiplicity-infinite=true}
            reference tailoring element: in-scope=false, multiplicity-restriction={severity=ERROR, lower-multiplicity=0, upper-multiplicity-infinite=true}, unresolved-reference-restriction=severity=ERROR
            primitive attribute tailoring elementRole: in-scope=false, multiplicity-restriction={severity=ERROR, lower-multiplicity=0, upper-multiplicity=1}, default-value-handling=NO-DEFAULT
              sub-attribute-tailorings:
                primitive attribute tailoring namePattern: in-scope=false, multiplicity-restriction={severity=ERROR, lower-multiplicity=0, upper-multiplicity=1}, default-value-handling=NO-DEFAULT
            reference tailoring sourceElement: in-scope=false, multiplicity-restriction={severity=ERROR, lower-multiplicity=0, upper-multiplicity-infinite=true}, unresolved-reference-restriction=severity=ERROR
            aggregation tailoring sourceInstance: in-scope=false, multiplicity-restriction={severity=ERROR, lower-multiplicity=0, upper-multiplicity-infinite=true}
      concrete class tailoring Colspec: in-scope=false, multiplicity-restriction={severity=INFO, lower-multiplicity=0, upper-multiplicity-infinite=true}, validation-root=false
        class content conditional Invariant
          6 x primitive attribute tailoring, all with in-scope=false, multiplicity-restriction={severity=ERROR, lower-multiplicity=0, upper-multiplicity=1}, default-value-handling=NO-DEFAULT:
            align
            colname
            colnum
            colsep
            colwidth
            rowsep
      concrete class tailoring ComMgrUserNeeds: in-scope=false, multiplicity-restriction={severity=INFO, lower-multiplicity=0, upper-multiplicity-infinite=true}, validation-root=false
        class content conditional Invariant
          primitive attribute tailoring maxCommMode: in-scope=false, multiplicity-restriction={severity=ERROR, lower-multiplicity=0, upper-multiplicity=1}, default-value-handling=NO-DEFAULT
      abstract class tailoring CommConnectorPort: multiplicity-restriction={severity=INFO, lower-multiplicity=0, upper-multiplicity-infinite=true}
        class content conditional Invariant
          primitive attribute tailoring communicationDirection: in-scope=false, multiplicity-restriction={severity=ERROR, lower-multiplicity=0, upper-multiplicity=1}, default-value-handling=NO-DEFAULT
      concrete class tailoring CommonSignalPath: in-scope=false, multiplicity-restriction={severity=INFO, lower-multiplicity=0, upper-multiplicity-infinite=true}, validation-root=false
        class content conditional Invariant
          attribute-tailorings:
            aggregation tailoring operation: in-scope=false, multiplicity-restriction={severity=ERROR, lower-multiplicity=0, upper-multiplicity-infinite=true}
            aggregation tailoring signal: in-scope=false, multiplicity-restriction={severity=ERROR, lower-multiplicity=0, upper-multiplicity-infinite=true}
      abstract class tailoring CommunicationCluster: multiplicity-restriction={severity=INFO, lower-multiplicity=0, upper-multiplicity-infinite=true}, variation-restriction={severity=ERROR, variation=true, valid-binding-times=[BLUEPRINT-DERIVATION-TIME, SYSTEM-DESIGN-TIME, CODE-GENERATION-TIME, PRE-COMPILE-TIME, LINK-TIME, POST-BUILD]}
        class content conditional Invariant
          attribute-tailorings:
            primitive attribute tailoring baudrate: in-scope=false, multiplicity-restriction={severity=ERROR, lower-multiplicity=0, upper-multiplicity=1}, default-value-handling=NO-DEFAULT
            aggregation tailoring physicalChannel: in-scope=false, multiplicity-restriction={severity=ERROR, lower-multiplicity=0, upper-multiplicity-infinite=true}, variation-restriction={severity=ERROR, variation=true, valid-binding-times=[BLUEPRINT-DERIVATION-TIME, SYSTEM-DESIGN-TIME]}
            primitive attribute tailoring protocolName: in-scope=false, multiplicity-restriction={severity=ERROR, lower-multiplicity=0, upper-multiplicity=1}, default-value-handling=NO-DEFAULT
            primitive attribute tailoring protocolVersion: in-scope=false, multiplicity-restriction={severity=ERROR, lower-multiplicity=0, upper-multiplicity=1}, default-value-handling=NO-DEFAULT
            primitive attribute tailoring speed: in-scope=false, multiplicity-restriction={severity=WARNING, lower-multiplicity=0, upper-multiplicity=0}, default-value-handling=NO-DEFAULT  # Spec element has lifecycle state 'obsolete'.
      abstract class tailoring CommunicationConnector: multiplicity-restriction={severity=INFO, lower-multiplicity=0, upper-multiplicity-infinite=true}
        class content conditional Invariant
          attribute-tailorings:
            reference tailoring commController: in-scope=false, multiplicity-restriction={severity=ERROR, lower-multiplicity=0, upper-multiplicity=1}, unresolved-reference-restriction=severity=ERROR
            aggregation tailoring ecuCommPortInstance: in-scope=false, multiplicity-restriction={severity=ERROR, lower-multiplicity=0, upper-multiplicity-infinite=true}, variation-restriction={severity=ERROR, variation=true, valid-binding-times=[BLUEPRINT-DERIVATION-TIME, SYSTEM-DESIGN-TIME, CODE-GENERATION-TIME, PRE-COMPILE-TIME, LINK-TIME, POST-BUILD]}
            primitive attribute tailoring pncGatewayType: in-scope=false, multiplicity-restriction={severity=ERROR, lower-multiplicity=0, upper-multiplicity=1}, default-value-handling=NO-DEFAULT
      abstract class tailoring CommunicationController: multiplicity-restriction={severity=INFO, lower-multiplicity=0, upper-multiplicity-infinite=true}, variation-restriction={severity=ERROR, variation=true, valid-binding-times=[BLUEPRINT-DERIVATION-TIME, SYSTEM-DESIGN-TIME, CODE-GENERATION-TIME, PRE-COMPILE-TIME, LINK-TIME, POST-BUILD]}
        class content conditional Invariant
      concrete class tailoring CommunicationControllerMapping: in-scope=false, multiplicity-restriction={severity=INFO, lower-multiplicity=0, upper-multiplicity-infinite=true}, validation-root=false
        class content conditional Invariant
          attribute-tailorings:
            reference tailoring communicationController: in-scope=false, multiplicity-restriction={severity=ERROR, lower-multiplicity=0, upper-multiplicity=1}, unresolved-reference-restriction=severity=ERROR
            reference tailoring hwCommunicationController: in-scope=false, multiplicity-restriction={severity=ERROR, lower-multiplicity=0, upper-multiplicity=1}, unresolved-reference-restriction=severity=ERROR
      abstract class tailoring CommunicationCycle: multiplicity-restriction={severity=INFO, lower-multiplicity=0, upper-multiplicity-infinite=true}
        class content conditional Invariant
      12 x concrete class tailoring, all with in-scope=false, multiplicity-restriction={severity=INFO, lower-multiplicity=0, upper-multiplicity-infinite=true}, validation-root=false:
        CompanyData
          class content conditional Invariant
        CompanyDocInfo
          class content conditional Invariant
        Compiler
          class content conditional Invariant
            4 x primitive attribute tailoring, all with in-scope=false, multiplicity-restriction={severity=ERROR, lower-multiplicity=0, upper-multiplicity=1}, default-value-handling=NO-DEFAULT:
              name
              options
              vendor
              version
        ComplexDeviceDriverSwComponentType
          class content conditional Invariant
            attribute-tailorings:
              reference tailoring hardwareElement: in-scope=false, multiplicity-restriction={severity=ERROR, lower-multiplicity=0, upper-multiplicity-infinite=true}, unresolved-reference-restriction=severity=ERROR
        ComponentClustering
          class content conditional Invariant
            attribute-tailorings:
              aggregation tailoring clusteredComponent: in-scope=false, multiplicity-restriction={severity=ERROR, lower-multiplicity=0, upper-multiplicity-infinite=true}
        ComponentInCompositionInstanceRef
          class content conditional Invariant
            attribute-tailorings:
              reference tailoring contextComponent: in-scope=false, multiplicity-restriction={severity=ERROR, lower-multiplicity=0, upper-multiplicity-infinite=true}, unresolved-reference-restriction=severity=ERROR
              reference tailoring targetComponent: in-scope=false, multiplicity-restriction={severity=ERROR, lower-multiplicity=0, upper-multiplicity=1}, unresolved-reference-restriction=severity=ERROR
        ComponentInSystemInstanceRef
          class content conditional Invariant
            attribute-tailorings:
              reference tailoring contextComponent: in-scope=false, multiplicity-restriction={severity=ERROR, lower-multiplicity=0, upper-multiplicity-infinite=true}, unresolved-reference-restriction=severity=ERROR
              reference tailoring contextComposition: in-scope=false, multiplicity-restriction={severity=ERROR, lower-multiplicity=0, upper-multiplicity=1}, unresolved-reference-restriction=severity=ERROR
              reference tailoring targetComponent: in-scope=false, multiplicity-restriction={severity=ERROR, lower-multiplicity=0, upper-multiplicity=1}, unresolved-reference-restriction=severity=ERROR
        ComponentSeparation
          class content conditional Invariant
            attribute-tailorings:
              aggregation tailoring separatedComponent: in-scope=false, multiplicity-restriction={severity=ERROR, lower-multiplicity=0, upper-multiplicity=2}
        CompositeNetworkRepresentation
          class content conditional Invariant
            attribute-tailorings:
              aggregation tailoring leafElement: in-scope=false, multiplicity-restriction={severity=ERROR, lower-multiplicity=0, upper-multiplicity=1}
              aggregation tailoring networkRepresentation: in-scope=false, multiplicity-restriction={severity=ERROR, lower-multiplicity=0, upper-multiplicity=1}
        CompositionSwComponentType
          class content conditional Invariant
            attribute-tailorings:
              aggregation tailoring component: in-scope=false, multiplicity-restriction={severity=ERROR, lower-multiplicity=0, upper-multiplicity-infinite=true}, variation-restriction={severity=ERROR, variation=true, valid-binding-times=[BLUEPRINT-DERIVATION-TIME, SYSTEM-DESIGN-TIME, CODE-GENERATION-TIME, PRE-COMPILE-TIME, LINK-TIME, POST-BUILD]}
              aggregation tailoring connector: in-scope=false, multiplicity-restriction={severity=ERROR, lower-multiplicity=0, upper-multiplicity-infinite=true}, variation-restriction={severity=ERROR, variation=true, valid-binding-times=[BLUEPRINT-DERIVATION-TIME, SYSTEM-DESIGN-TIME, CODE-GENERATION-TIME, PRE-COMPILE-TIME, LINK-TIME, POST-BUILD]}
              reference tailoring constantValueMapping: in-scope=false, multiplicity-restriction={severity=ERROR, lower-multiplicity=0, upper-multiplicity-infinite=true}, unresolved-reference-restriction=severity=ERROR
              reference tailoring dataTypeMapping: in-scope=false, multiplicity-restriction={severity=ERROR, lower-multiplicity=0, upper-multiplicity-infinite=true}, unresolved-reference-restriction=severity=ERROR
              aggregation tailoring instantiationRTEEventProps: in-scope=false, multiplicity-restriction={severity=ERROR, lower-multiplicity=0, upper-multiplicity-infinite=true}, variation-restriction={severity=ERROR, variation=true, valid-binding-times=[BLUEPRINT-DERIVATION-TIME, SYSTEM-DESIGN-TIME, CODE-GENERATION-TIME]}
        Compu
          class content conditional Invariant
            attribute-tailorings:
              aggregation tailoring compuContent: in-scope=false, multiplicity-restriction={severity=ERROR, lower-multiplicity=0, upper-multiplicity=1}
              aggregation tailoring compuDefaultValue: in-scope=false, multiplicity-restriction={severity=ERROR, lower-multiplicity=0, upper-multiplicity=1}
        CompuConst
          class content conditional Invariant
            attribute-tailorings:
              aggregation tailoring compuConstContentType: in-scope=false, multiplicity-restriction={severity=ERROR, lower-multiplicity=0, upper-multiplicity=1}
      abstract class tailoring CompuConstContent: multiplicity-restriction={severity=INFO, lower-multiplicity=0, upper-multiplicity-infinite=true}
        class content conditional Invariant
      concrete class tailoring CompuConstFormulaContent: in-scope=false, multiplicity-restriction={severity=INFO, lower-multiplicity=0, upper-multiplicity-infinite=true}, validation-root=false
        class content conditional Invariant
          primitive attribute tailoring vf: in-scope=false, multiplicity-restriction={severity=ERROR, lower-multiplicity=0, upper-multiplicity=1}, variation-restriction={severity=ERROR, variation=true, valid-binding-times=[BLUEPRINT-DERIVATION-TIME, SYSTEM-DESIGN-TIME, CODE-GENERATION-TIME]}, default-value-handling=NO-DEFAULT
      concrete class tailoring CompuConstNumericContent: in-scope=false, multiplicity-restriction={severity=INFO, lower-multiplicity=0, upper-multiplicity-infinite=true}, validation-root=false
        class content conditional Invariant
          primitive attribute tailoring v: in-scope=false, multiplicity-restriction={severity=ERROR, lower-multiplicity=0, upper-multiplicity=1}, default-value-handling=NO-DEFAULT
      concrete class tailoring CompuConstTextContent: in-scope=false, multiplicity-restriction={severity=INFO, lower-multiplicity=0, upper-multiplicity-infinite=true}, validation-root=false
        class content conditional Invariant
          primitive attribute tailoring vt: in-scope=false, multiplicity-restriction={severity=ERROR, lower-multiplicity=0, upper-multiplicity=1}, default-value-handling=NO-DEFAULT
            sub-attribute-tailorings:
              primitive attribute tailoring xmlSpace: in-scope=false, multiplicity-restriction={severity=ERROR, lower-multiplicity=0, upper-multiplicity=1}, default-value-handling=NO-DEFAULT
      abstract class tailoring CompuContent: multiplicity-restriction={severity=INFO, lower-multiplicity=0, upper-multiplicity-infinite=true}
        class content conditional Invariant
      6 x concrete class tailoring, all with in-scope=false, multiplicity-restriction={severity=INFO, lower-multiplicity=0, upper-multiplicity-infinite=true}, validation-root=false:
        CompuGenericMath
          class content conditional Invariant
            primitive attribute tailoring level: in-scope=false, multiplicity-restriction={severity=ERROR, lower-multiplicity=0, upper-multiplicity-infinite=true}, default-value-handling=NO-DEFAULT  # Multiplicity is 0..* since attribute is contained in mixed / mixedString class.
        CompuMethod
          class content conditional Invariant
            attribute-tailorings:
              aggregation tailoring compuInternalToPhys: in-scope=false, multiplicity-restriction={severity=ERROR, lower-multiplicity=0, upper-multiplicity=1}
              aggregation tailoring compuPhysToInternal: in-scope=false, multiplicity-restriction={severity=ERROR, lower-multiplicity=0, upper-multiplicity=1}
              primitive attribute tailoring displayFormat: in-scope=false, multiplicity-restriction={severity=ERROR, lower-multiplicity=0, upper-multiplicity=1}, default-value-handling=NO-DEFAULT
              reference tailoring unit: in-scope=false, multiplicity-restriction={severity=ERROR, lower-multiplicity=0, upper-multiplicity=1}, unresolved-reference-restriction=severity=ERROR
        CompuNominatorDenominator
          class content conditional Invariant
            primitive attribute tailoring v: in-scope=false, multiplicity-restriction={severity=ERROR, lower-multiplicity=0, upper-multiplicity-infinite=true}, variation-restriction={severity=ERROR, variation=true, valid-binding-times=[BLUEPRINT-DERIVATION-TIME, SYSTEM-DESIGN-TIME, CODE-GENERATION-TIME, PRE-COMPILE-TIME]}, default-value-handling=NO-DEFAULT
        CompuRationalCoeffs
          class content conditional Invariant
            attribute-tailorings:
              aggregation tailoring compuDenominator: in-scope=false, multiplicity-restriction={severity=ERROR, lower-multiplicity=0, upper-multiplicity=1}
              aggregation tailoring compuNumerator: in-scope=false, multiplicity-restriction={severity=ERROR, lower-multiplicity=0, upper-multiplicity=1}
        CompuScale
          class content conditional Invariant
            attribute-tailorings:
              aggregation tailoring compuInverseValue: in-scope=false, multiplicity-restriction={severity=ERROR, lower-multiplicity=0, upper-multiplicity=1}
              aggregation tailoring compuScaleContents: in-scope=false, multiplicity-restriction={severity=ERROR, lower-multiplicity=0, upper-multiplicity=1}
              aggregation tailoring desc: in-scope=false, multiplicity-restriction={severity=ERROR, lower-multiplicity=0, upper-multiplicity=1}
              5 x primitive attribute tailoring, all with in-scope=false, multiplicity-restriction={severity=ERROR, lower-multiplicity=0, upper-multiplicity=1}, default-value-handling=NO-DEFAULT:
                lowerLimit: variation-restriction={severity=ERROR, variation=true, valid-binding-times=[BLUEPRINT-DERIVATION-TIME, SYSTEM-DESIGN-TIME, CODE-GENERATION-TIME, PRE-COMPILE-TIME]}
                  sub-attribute-tailorings:
                    primitive attribute tailoring intervalType: in-scope=false, multiplicity-restriction={severity=ERROR, lower-multiplicity=0, upper-multiplicity=1}, default-value-handling=NO-DEFAULT
                mask
                shortLabel
                  sub-attribute-tailorings:
                    primitive attribute tailoring namePattern: in-scope=false, multiplicity-restriction={severity=ERROR, lower-multiplicity=0, upper-multiplicity=1}, default-value-handling=NO-DEFAULT
                symbol
                  sub-attribute-tailorings:
                    primitive attribute tailoring namePattern: in-scope=false, multiplicity-restriction={severity=ERROR, lower-multiplicity=0, upper-multiplicity=1}, default-value-handling=NO-DEFAULT
                upperLimit: variation-restriction={severity=ERROR, variation=true, valid-binding-times=[BLUEPRINT-DERIVATION-TIME, SYSTEM-DESIGN-TIME, CODE-GENERATION-TIME, PRE-COMPILE-TIME]}
                  sub-attribute-tailorings:
                    primitive attribute tailoring intervalType: in-scope=false, multiplicity-restriction={severity=ERROR, lower-multiplicity=0, upper-multiplicity=1}, default-value-handling=NO-DEFAULT
        CompuScaleConstantContents
          class content conditional Invariant
            attribute-tailorings:
              aggregation tailoring compuConst: in-scope=false, multiplicity-restriction={severity=ERROR, lower-multiplicity=0, upper-multiplicity=1}
      abstract class tailoring CompuScaleContents: multiplicity-restriction={severity=INFO, lower-multiplicity=0, upper-multiplicity-infinite=true}
        class content conditional Invariant
      16 x concrete class tailoring, all with in-scope=false, multiplicity-restriction={severity=INFO, lower-multiplicity=0, upper-multiplicity-infinite=true}, validation-root=false:
        CompuScaleRationalFormula
          class content conditional Invariant
            attribute-tailorings:
              aggregation tailoring compuRationalCoeffs: in-scope=false, multiplicity-restriction={severity=ERROR, lower-multiplicity=0, upper-multiplicity=1}
        CompuScales
          class content conditional Invariant
            attribute-tailorings:
              aggregation tailoring compuScale: in-scope=false, multiplicity-restriction={severity=ERROR, lower-multiplicity=0, upper-multiplicity-infinite=true}, variation-restriction={severity=ERROR, variation=true, valid-binding-times=BLUEPRINT-DERIVATION-TIME}
        ConcretePatternEventTriggering
          class content conditional Invariant
            attribute-tailorings:
              aggregation tailoring offset: in-scope=false, multiplicity-restriction={severity=ERROR, lower-multiplicity=0, upper-multiplicity-infinite=true}
              aggregation tailoring patternLength: in-scope=false, multiplicity-restriction={severity=ERROR, lower-multiplicity=0, upper-multiplicity=1}
        ConditionByFormula
          class content conditional Invariant
            primitive attribute tailoring bindingTime: in-scope=false, multiplicity-restriction={severity=ERROR, lower-multiplicity=0, upper-multiplicity=1}, default-value-handling=NO-DEFAULT
        ConditionalChangeNad
          class content conditional Invariant
            5 x primitive attribute tailoring, all with in-scope=false, multiplicity-restriction={severity=ERROR, lower-multiplicity=0, upper-multiplicity=1}, default-value-handling=NO-DEFAULT:
              byte
              id
              invert
              mask
              newNad
        ConfCond
          class content conditional Invariant
            attribute-tailorings:
              reference tailoring confItem: in-scope=false, multiplicity-restriction={severity=ERROR, lower-multiplicity=0, upper-multiplicity=1}, unresolved-reference-restriction=severity=ERROR
        ConfDefaultValue
          class content conditional Invariant
        ConfDefaultValueFormula
          class content conditional Invariant
        ConfDefaultValuePointer
          class content conditional Invariant
        ConfDefaultValueValue
          class content conditional Invariant
        ConfForwarding
          class content conditional Invariant
        ConfItem
          class content conditional Invariant
        ConfItemFormula
          class content conditional Invariant
        ConfItemNumber
          class content conditional Invariant
        ConfItemPointer
          class content conditional Invariant
        ConfItemText
          class content conditional Invariant
      abstract class tailoring ConfItemValue: multiplicity-restriction={severity=INFO, lower-multiplicity=0, upper-multiplicity-infinite=true}
        class content conditional Invariant
      37 x concrete class tailoring, all with in-scope=false, multiplicity-restriction={severity=INFO, lower-multiplicity=0, upper-multiplicity-infinite=true}, validation-root=false:
        ConfItems
          class content conditional Invariant
        ConfKeySpec
          class content conditional Invariant
        ConfProValue
          class content conditional Invariant
        ConfProValueFormula
          class content conditional Invariant
        ConfProValuePointer
          class content conditional Invariant
        ConfProValueValue
          class content conditional Invariant
        ConfRule
          class content conditional Invariant
        ConfRuleRef
          class content conditional Invariant
            attribute-tailorings:
              reference tailoring confRule: in-scope=false, multiplicity-restriction={severity=ERROR, lower-multiplicity=0, upper-multiplicity=1}, unresolved-reference-restriction=severity=ERROR
        ConfSource
          class content conditional Invariant
        ConfSources
          class content conditional Invariant
        ConfSourcesScope
          class content conditional Invariant
            attribute-tailorings:
              aggregation tailoring swInterfaceExportScope: in-scope=false, multiplicity-restriction={severity=ERROR, lower-multiplicity=0, upper-multiplicity=1}
        ConfSpec
          class content conditional Invariant
        ConfValueConstr
          class content conditional Invariant
        ConfValueProps
          class content conditional Invariant
        ConfidenceInterval
          class content conditional Invariant
            attribute-tailorings:
              aggregation tailoring lowerBound: in-scope=false, multiplicity-restriction={severity=ERROR, lower-multiplicity=0, upper-multiplicity=1}
              primitive attribute tailoring propability: in-scope=false, multiplicity-restriction={severity=ERROR, lower-multiplicity=0, upper-multiplicity=1}, default-value-handling=NO-DEFAULT
              aggregation tailoring upperBound: in-scope=false, multiplicity-restriction={severity=ERROR, lower-multiplicity=0, upper-multiplicity=1}
        ConsistencyNeeds
          class content conditional Invariant
            attribute-tailorings:
              4 x aggregation tailoring, all with in-scope=false, multiplicity-restriction={severity=ERROR, lower-multiplicity=0, upper-multiplicity-infinite=true}, variation-restriction={severity=ERROR, variation=true, valid-binding-times=[BLUEPRINT-DERIVATION-TIME, SYSTEM-DESIGN-TIME, CODE-GENERATION-TIME, PRE-COMPILE-TIME]}:
                dpgDoesNotRequireCoherency
                dpgRequiresCoherency
                regDoesNotRequireStability
                regRequiresStability
        ConsistencyNeedsBlueprintSet
          class content conditional Invariant
            attribute-tailorings:
              aggregation tailoring consistencyNeeds: in-scope=false, multiplicity-restriction={severity=ERROR, lower-multiplicity=0, upper-multiplicity-infinite=true}, variation-restriction={severity=ERROR, variation=true, valid-binding-times=[BLUEPRINT-DERIVATION-TIME, SYSTEM-DESIGN-TIME, CODE-GENERATION-TIME, PRE-COMPILE-TIME]}
        ConstantReference
          class content conditional Invariant
            attribute-tailorings:
              reference tailoring constant: in-scope=false, multiplicity-restriction={severity=ERROR, lower-multiplicity=0, upper-multiplicity=1}, unresolved-reference-restriction=severity=ERROR
        ConstantSpecification
          class content conditional Invariant
            attribute-tailorings:
              aggregation tailoring valueSpec: in-scope=false, multiplicity-restriction={severity=ERROR, lower-multiplicity=0, upper-multiplicity=1}
        ConstantSpecificationMapping
          class content conditional Invariant
            attribute-tailorings:
              reference tailoring applConstant: in-scope=false, multiplicity-restriction={severity=ERROR, lower-multiplicity=0, upper-multiplicity=1}, unresolved-reference-restriction=severity=ERROR
              reference tailoring implConstant: in-scope=false, multiplicity-restriction={severity=ERROR, lower-multiplicity=0, upper-multiplicity=1}, unresolved-reference-restriction=severity=ERROR
        ConstantSpecificationMappingSet
          class content conditional Invariant
            attribute-tailorings:
              aggregation tailoring mapping: in-scope=false, multiplicity-restriction={severity=ERROR, lower-multiplicity=0, upper-multiplicity-infinite=true}
        ConsumedEventGroup
          class content conditional Invariant
            attribute-tailorings:
              reference tailoring applicationEndpoint: in-scope=false, multiplicity-restriction={severity=ERROR, lower-multiplicity=0, upper-multiplicity=1}, unresolved-reference-restriction=severity=ERROR
              primitive attribute tailoring eventGroupIdentifier: in-scope=false, multiplicity-restriction={severity=ERROR, lower-multiplicity=0, upper-multiplicity=1}, default-value-handling=NO-DEFAULT
              primitive attribute tailoring instanceIdentifier: in-scope=false, multiplicity-restriction={severity=ERROR, lower-multiplicity=0, upper-multiplicity=1}, default-value-handling=NO-DEFAULT
              primitive attribute tailoring priority: in-scope=false, multiplicity-restriction={severity=ERROR, lower-multiplicity=0, upper-multiplicity=1}, default-value-handling=NO-DEFAULT
              reference tailoring routingGroup: in-scope=false, multiplicity-restriction={severity=ERROR, lower-multiplicity=0, upper-multiplicity-infinite=true}, unresolved-reference-restriction=severity=ERROR
              aggregation tailoring sdClientConfig: in-scope=false, multiplicity-restriction={severity=ERROR, lower-multiplicity=0, upper-multiplicity=1}
        ConsumedServiceInstance
          class content conditional Invariant
            attribute-tailorings:
              aggregation tailoring consumedEventGroup: in-scope=false, multiplicity-restriction={severity=ERROR, lower-multiplicity=0, upper-multiplicity-infinite=true}
              reference tailoring providedServiceInstance: in-scope=false, multiplicity-restriction={severity=ERROR, lower-multiplicity=0, upper-multiplicity=1}, unresolved-reference-restriction=severity=ERROR
              aggregation tailoring sdClientConfig: in-scope=false, multiplicity-restriction={severity=ERROR, lower-multiplicity=0, upper-multiplicity=1}
        ContractAspects
          class content conditional Invariant
        CountConstr
          class content conditional Invariant
            primitive attribute tailoring lowerLimit: in-scope=false, multiplicity-restriction={severity=ERROR, lower-multiplicity=0, upper-multiplicity=1}, variation-restriction={severity=ERROR, variation=true, valid-binding-times=[BLUEPRINT-DERIVATION-TIME, SYSTEM-DESIGN-TIME, CODE-GENERATION-TIME, PRE-COMPILE-TIME]}, default-value-handling=NO-DEFAULT
              sub-attribute-tailorings:
                primitive attribute tailoring intervalType: in-scope=false, multiplicity-restriction={severity=ERROR, lower-multiplicity=0, upper-multiplicity=1}, default-value-handling=NO-DEFAULT
            primitive attribute tailoring upperLimit: in-scope=false, multiplicity-restriction={severity=ERROR, lower-multiplicity=0, upper-multiplicity=1}, variation-restriction={severity=ERROR, variation=true, valid-binding-times=[BLUEPRINT-DERIVATION-TIME, SYSTEM-DESIGN-TIME, CODE-GENERATION-TIME, PRE-COMPILE-TIME]}, default-value-handling=NO-DEFAULT
              sub-attribute-tailorings:
                primitive attribute tailoring intervalType: in-scope=false, multiplicity-restriction={severity=ERROR, lower-multiplicity=0, upper-multiplicity=1}, default-value-handling=NO-DEFAULT
        CouplingElement
          class content conditional Invariant
            attribute-tailorings:
              reference tailoring communicationCluster: in-scope=false, multiplicity-restriction={severity=ERROR, lower-multiplicity=0, upper-multiplicity=1}, unresolved-reference-restriction=severity=ERROR
              aggregation tailoring couplingPort: in-scope=false, multiplicity-restriction={severity=ERROR, lower-multiplicity=0, upper-multiplicity-infinite=true}
              primitive attribute tailoring couplingType: in-scope=false, multiplicity-restriction={severity=ERROR, lower-multiplicity=0, upper-multiplicity=1}, default-value-handling=NO-DEFAULT
              reference tailoring ecuInstance: in-scope=false, multiplicity-restriction={severity=ERROR, lower-multiplicity=0, upper-multiplicity=1}, unresolved-reference-restriction=severity=ERROR
        CouplingPort
          class content conditional Invariant
            attribute-tailorings:
              reference tailoring defaultVlan: in-scope=false, multiplicity-restriction={severity=ERROR, lower-multiplicity=0, upper-multiplicity=1}, unresolved-reference-restriction=severity=ERROR
              reference tailoring macMulticastAddress: in-scope=false, multiplicity-restriction={severity=ERROR, lower-multiplicity=0, upper-multiplicity-infinite=true}, unresolved-reference-restriction=severity=ERROR
              aggregation tailoring vlanMembership: in-scope=false, multiplicity-restriction={severity=ERROR, lower-multiplicity=0, upper-multiplicity-infinite=true}
        CouplingPortConnection
          class content conditional Invariant
            attribute-tailorings:
              reference tailoring firstPort: in-scope=false, multiplicity-restriction={severity=ERROR, lower-multiplicity=0, upper-multiplicity=1}, unresolved-reference-restriction=severity=ERROR
              reference tailoring secondPort: in-scope=false, multiplicity-restriction={severity=ERROR, lower-multiplicity=0, upper-multiplicity=1}, unresolved-reference-restriction=severity=ERROR
        CryptoServiceNeeds
          class content conditional Invariant
            primitive attribute tailoring maximumKeyLength: in-scope=false, multiplicity-restriction={severity=ERROR, lower-multiplicity=0, upper-multiplicity=1}, default-value-handling=NO-DEFAULT
        CsEntry
          class content conditional Invariant
            attribute-tailorings:
              7 x primitive attribute tailoring, all with in-scope=false, multiplicity-restriction={severity=ERROR, lower-multiplicity=0, upper-multiplicity=1}, default-value-handling=NO-DEFAULT:
                csdi
                cspi
                cspr
                csto
                cstv
                csus
                cswp
              aggregation tailoring date: in-scope=false, multiplicity-restriction={severity=ERROR, lower-multiplicity=0, upper-multiplicity=1}
              aggregation tailoring sd: in-scope=false, multiplicity-restriction={severity=ERROR, lower-multiplicity=0, upper-multiplicity-infinite=true}
              aggregation tailoring state: in-scope=false, multiplicity-restriction={severity=ERROR, lower-multiplicity=0, upper-multiplicity=1}
        CycleCounter
          class content conditional Invariant
            primitive attribute tailoring CycleCounter: in-scope=false, multiplicity-restriction={severity=ERROR, lower-multiplicity=0, upper-multiplicity=1}, default-value-handling=NO-DEFAULT
        CycleRepetition
          class content conditional Invariant
            primitive attribute tailoring BaseCycle: in-scope=false, multiplicity-restriction={severity=ERROR, lower-multiplicity=0, upper-multiplicity=1}, default-value-handling=NO-DEFAULT
            primitive attribute tailoring CycleRepetition: in-scope=false, multiplicity-restriction={severity=ERROR, lower-multiplicity=0, upper-multiplicity=1}, default-value-handling=NO-DEFAULT
        CyclicTiming
          class content conditional Invariant
            attribute-tailorings:
              aggregation tailoring timeOffset: in-scope=false, multiplicity-restriction={severity=ERROR, lower-multiplicity=0, upper-multiplicity=1}
              aggregation tailoring timePeriod: in-scope=false, multiplicity-restriction={severity=ERROR, lower-multiplicity=0, upper-multiplicity=1}
        DataConstr
          class content conditional Invariant
            attribute-tailorings:
              aggregation tailoring dataConstrRule: in-scope=false, multiplicity-restriction={severity=ERROR, lower-multiplicity=0, upper-multiplicity-infinite=true}
        DataConstrRule
          class content conditional Invariant
            attribute-tailorings:
              primitive attribute tailoring constrLevel: in-scope=false, multiplicity-restriction={severity=ERROR, lower-multiplicity=0, upper-multiplicity=1}, default-value-handling=NO-DEFAULT
              aggregation tailoring internalConstrs: in-scope=false, multiplicity-restriction={severity=ERROR, lower-multiplicity=0, upper-multiplicity=1}
              aggregation tailoring physConstrs: in-scope=false, multiplicity-restriction={severity=ERROR, lower-multiplicity=0, upper-multiplicity=1}
        DataDumpEntry
          class content conditional Invariant
            primitive attribute tailoring byteValue: in-scope=false, multiplicity-restriction={severity=ERROR, lower-multiplicity=0, upper-multiplicity=5}, default-value-handling=NO-DEFAULT
        DataFilter
          class content conditional Invariant
            7 x primitive attribute tailoring, all with in-scope=false, multiplicity-restriction={severity=ERROR, lower-multiplicity=0, upper-multiplicity=1}, default-value-handling=NO-DEFAULT:
              dataFilterType
              mask
              max
              min
              offset
              period
              x
      abstract class tailoring DataInterface: multiplicity-restriction={severity=INFO, lower-multiplicity=0, upper-multiplicity-infinite=true}
        class content conditional Invariant
      abstract class tailoring DataMapping: multiplicity-restriction={severity=INFO, lower-multiplicity=0, upper-multiplicity-infinite=true}
        class content conditional Invariant
          attribute-tailorings:
            primitive attribute tailoring communicationDirection: in-scope=false, multiplicity-restriction={severity=ERROR, lower-multiplicity=0, upper-multiplicity=1}, default-value-handling=NO-DEFAULT
            reference tailoring eventGroup: in-scope=false, multiplicity-restriction={severity=ERROR, lower-multiplicity=0, upper-multiplicity-infinite=true}, unresolved-reference-restriction=severity=ERROR
            reference tailoring eventHandler: in-scope=false, multiplicity-restriction={severity=ERROR, lower-multiplicity=0, upper-multiplicity-infinite=true}, unresolved-reference-restriction=severity=ERROR
            aggregation tailoring introduction: in-scope=false, multiplicity-restriction={severity=ERROR, lower-multiplicity=0, upper-multiplicity=1}
            reference tailoring serviceInstance: in-scope=false, multiplicity-restriction={severity=ERROR, lower-multiplicity=0, upper-multiplicity-infinite=true}, unresolved-reference-restriction=severity=ERROR
      abstract class tailoring DataPrototype: multiplicity-restriction={severity=INFO, lower-multiplicity=0, upper-multiplicity-infinite=true}
        class content conditional Invariant
          attribute-tailorings:
            aggregation tailoring swDataDefProps: in-scope=false, multiplicity-restriction={severity=ERROR, lower-multiplicity=0, upper-multiplicity=1}
      18 x concrete class tailoring, all with in-scope=false, multiplicity-restriction={severity=INFO, lower-multiplicity=0, upper-multiplicity-infinite=true}, validation-root=false:
        DataPrototypeGroup
          class content conditional Invariant
            attribute-tailorings:
              aggregation tailoring dataPrototypeGroup: in-scope=false, multiplicity-restriction={severity=ERROR, lower-multiplicity=0, upper-multiplicity-infinite=true}, variation-restriction={severity=ERROR, variation=true, valid-binding-times=[BLUEPRINT-DERIVATION-TIME, SYSTEM-DESIGN-TIME, CODE-GENERATION-TIME, PRE-COMPILE-TIME]}
              aggregation tailoring implicitDataAccess: in-scope=false, multiplicity-restriction={severity=ERROR, lower-multiplicity=0, upper-multiplicity-infinite=true}, variation-restriction={severity=ERROR, variation=true, valid-binding-times=[BLUEPRINT-DERIVATION-TIME, SYSTEM-DESIGN-TIME, CODE-GENERATION-TIME, PRE-COMPILE-TIME]}
        DataPrototypeMapping
          class content conditional Invariant
            attribute-tailorings:
              reference tailoring firstDataPrototype: in-scope=false, multiplicity-restriction={severity=ERROR, lower-multiplicity=0, upper-multiplicity=1}, unresolved-reference-restriction=severity=ERROR
              reference tailoring secondDataPrototype: in-scope=false, multiplicity-restriction={severity=ERROR, lower-multiplicity=0, upper-multiplicity=1}, unresolved-reference-restriction=severity=ERROR
              aggregation tailoring subElementMapping: in-scope=false, multiplicity-restriction={severity=ERROR, lower-multiplicity=0, upper-multiplicity-infinite=true}
              aggregation tailoring textTableMapping: in-scope=false, multiplicity-restriction={severity=ERROR, lower-multiplicity=0, upper-multiplicity=2}
        DataReceiveErrorEvent
          class content conditional Invariant
            attribute-tailorings:
              aggregation tailoring data: in-scope=false, multiplicity-restriction={severity=ERROR, lower-multiplicity=0, upper-multiplicity=1}
        DataReceivedEvent
          class content conditional Invariant
            attribute-tailorings:
              aggregation tailoring data: in-scope=false, multiplicity-restriction={severity=ERROR, lower-multiplicity=0, upper-multiplicity=1}
        DataRequirements
          class content conditional Invariant
        DataSendCompletedEvent
          class content conditional Invariant
            attribute-tailorings:
              reference tailoring eventSource: in-scope=false, multiplicity-restriction={severity=ERROR, lower-multiplicity=0, upper-multiplicity=1}, unresolved-reference-restriction=severity=ERROR
        DataTypeMap
          class content conditional Invariant
            attribute-tailorings:
              reference tailoring applicationDataType: in-scope=false, multiplicity-restriction={severity=ERROR, lower-multiplicity=0, upper-multiplicity=1}, unresolved-reference-restriction=severity=ERROR
              reference tailoring implementationDataType: in-scope=false, multiplicity-restriction={severity=ERROR, lower-multiplicity=0, upper-multiplicity=1}, unresolved-reference-restriction=severity=ERROR
        DataTypeMappingSet
          class content conditional Invariant
            attribute-tailorings:
              aggregation tailoring dataTypeMap: in-scope=false, multiplicity-restriction={severity=ERROR, lower-multiplicity=0, upper-multiplicity-infinite=true}
              aggregation tailoring modeRequestTypeMap: in-scope=false, multiplicity-restriction={severity=ERROR, lower-multiplicity=0, upper-multiplicity-infinite=true}
        DataWriteCompletedEvent
          class content conditional Invariant
            attribute-tailorings:
              reference tailoring eventSource: in-scope=false, multiplicity-restriction={severity=ERROR, lower-multiplicity=0, upper-multiplicity=1}, unresolved-reference-restriction=severity=ERROR
        DciEnum
          class content conditional Invariant
        DciEnumEntry
          class content conditional Invariant
        DcmIPdu
          class content conditional Invariant
            primitive attribute tailoring diagPduType: in-scope=false, multiplicity-restriction={severity=ERROR, lower-multiplicity=0, upper-multiplicity=1}, default-value-handling=NO-DEFAULT
        DefItem
          class content conditional Invariant
            attribute-tailorings:
              aggregation tailoring def: in-scope=false, multiplicity-restriction={severity=ERROR, lower-multiplicity=0, upper-multiplicity=1}
              primitive attribute tailoring helpEntry: in-scope=false, multiplicity-restriction={severity=ERROR, lower-multiplicity=0, upper-multiplicity=1}, default-value-handling=NO-DEFAULT
        DefList
          class content conditional Invariant
            attribute-tailorings:
              aggregation tailoring defItem: in-scope=false, multiplicity-restriction={severity=ERROR, lower-multiplicity=0, upper-multiplicity-infinite=true}, variation-restriction={severity=ERROR, variation=true, valid-binding-times=[BLUEPRINT-DERIVATION-TIME, SYSTEM-DESIGN-TIME, CODE-GENERATION-TIME, PRE-COMPILE-TIME, LINK-TIME, POST-BUILD]}
        DefaultValueElement
          class content conditional Invariant
            primitive attribute tailoring elementByteValue: in-scope=false, multiplicity-restriction={severity=ERROR, lower-multiplicity=0, upper-multiplicity=1}, default-value-handling=NO-DEFAULT
            primitive attribute tailoring elementPosition: in-scope=false, multiplicity-restriction={severity=ERROR, lower-multiplicity=0, upper-multiplicity=1}, default-value-handling=NO-DEFAULT
        DelegatedPortAnnotation
          class content conditional Invariant
            primitive attribute tailoring signalFan: in-scope=false, multiplicity-restriction={severity=ERROR, lower-multiplicity=0, upper-multiplicity=1}, default-value-handling=NO-DEFAULT
        DelegationSwConnector
          class content conditional Invariant
            attribute-tailorings:
              aggregation tailoring innerPort: in-scope=false, multiplicity-restriction={severity=ERROR, lower-multiplicity=0, upper-multiplicity=1}
              reference tailoring outerPort: in-scope=false, multiplicity-restriction={severity=ERROR, lower-multiplicity=0, upper-multiplicity=1}, unresolved-reference-restriction=severity=ERROR
        DependencyOnArtifact
          class content conditional Invariant
            attribute-tailorings:
              aggregation tailoring artifactDescriptor: in-scope=false, multiplicity-restriction={severity=ERROR, lower-multiplicity=0, upper-multiplicity=1}
              primitive attribute tailoring usage: in-scope=false, multiplicity-restriction={severity=ERROR, lower-multiplicity=0, upper-multiplicity-infinite=true}, default-value-handling=NO-DEFAULT
      abstract class tailoring Describable: multiplicity-restriction={severity=INFO, lower-multiplicity=0, upper-multiplicity-infinite=true}
        class content conditional Invariant
          attribute-tailorings:
            aggregation tailoring adminData: in-scope=false, multiplicity-restriction={severity=ERROR, lower-multiplicity=0, upper-multiplicity=1}
            primitive attribute tailoring category: in-scope=false, multiplicity-restriction={severity=ERROR, lower-multiplicity=0, upper-multiplicity=1}, default-value-handling=NO-DEFAULT
            aggregation tailoring desc: in-scope=false, multiplicity-restriction={severity=ERROR, lower-multiplicity=0, upper-multiplicity=1}
            aggregation tailoring introduction: in-scope=false, multiplicity-restriction={severity=ERROR, lower-multiplicity=0, upper-multiplicity=1}
      concrete class tailoring DesignRequirements: in-scope=false, multiplicity-restriction={severity=INFO, lower-multiplicity=0, upper-multiplicity-infinite=true}, validation-root=false
        class content conditional Invariant
      concrete class tailoring DhcpServerConfiguration: in-scope=false, multiplicity-restriction={severity=INFO, lower-multiplicity=0, upper-multiplicity-infinite=true}, validation-root=false
        class content conditional Invariant
          attribute-tailorings:
            aggregation tailoring ipv4DhcpServerConfiguration: in-scope=false, multiplicity-restriction={severity=ERROR, lower-multiplicity=0, upper-multiplicity=1}
            aggregation tailoring ipv6DhcpServerConfiguration: in-scope=false, multiplicity-restriction={severity=ERROR, lower-multiplicity=0, upper-multiplicity=1}
      abstract class tailoring DiagEventDebounceAlgorithm: multiplicity-restriction={severity=INFO, lower-multiplicity=0, upper-multiplicity-infinite=true}
        class content conditional Invariant
      concrete class tailoring DiagEventDebounceCounterBased: in-scope=false, multiplicity-restriction={severity=INFO, lower-multiplicity=0, upper-multiplicity-infinite=true}, validation-root=false
        class content conditional Invariant
          8 x primitive attribute tailoring, all with in-scope=false, multiplicity-restriction={severity=ERROR, lower-multiplicity=0, upper-multiplicity=1}, default-value-handling=NO-DEFAULT:
            counterDecrementStepSize
            counterFailedThreshold
            counterIncrementStepSize
            counterJumpDown
            counterJumpDownValue
            counterJumpUp
            counterJumpUpValue
            counterPassedThreshold
      concrete class tailoring DiagEventDebounceMonitorInternal: in-scope=false, multiplicity-restriction={severity=INFO, lower-multiplicity=0, upper-multiplicity-infinite=true}, validation-root=false
        class content conditional Invariant
      concrete class tailoring DiagEventDebounceTimeBased: in-scope=false, multiplicity-restriction={severity=INFO, lower-multiplicity=0, upper-multiplicity-infinite=true}, validation-root=false
        class content conditional Invariant
          primitive attribute tailoring timeFailedThreshold: in-scope=false, multiplicity-restriction={severity=ERROR, lower-multiplicity=0, upper-multiplicity=1}, default-value-handling=NO-DEFAULT
          primitive attribute tailoring timePassedThreshold: in-scope=false, multiplicity-restriction={severity=ERROR, lower-multiplicity=0, upper-multiplicity=1}, default-value-handling=NO-DEFAULT
      abstract class tailoring DiagnosticCapabilityElement: multiplicity-restriction={severity=INFO, lower-multiplicity=0, upper-multiplicity-infinite=true}
        class content conditional Invariant
          primitive attribute tailoring audience: in-scope=false, multiplicity-restriction={severity=ERROR, lower-multiplicity=0, upper-multiplicity-infinite=true}, default-value-handling=NO-DEFAULT
          primitive attribute tailoring diagRequirement: in-scope=false, multiplicity-restriction={severity=ERROR, lower-multiplicity=0, upper-multiplicity=1}, default-value-handling=NO-DEFAULT
          primitive attribute tailoring securityAccessLevel: in-scope=false, multiplicity-restriction={severity=ERROR, lower-multiplicity=0, upper-multiplicity=1}, default-value-handling=NO-DEFAULT
      20 x concrete class tailoring, all with in-scope=false, validation-root=false:
        DiagnosticCommunicationManagerNeeds: multiplicity-restriction={severity=INFO, lower-multiplicity=0, upper-multiplicity-infinite=true}
          class content conditional Invariant
        DiagnosticEnableConditionNeeds: multiplicity-restriction={severity=INFO, lower-multiplicity=0, upper-multiplicity-infinite=true}
          class content conditional Invariant
            primitive attribute tailoring initialStatus: in-scope=false, multiplicity-restriction={severity=ERROR, lower-multiplicity=0, upper-multiplicity=1}, default-value-handling=NO-DEFAULT
        DiagnosticEventInfoNeeds: multiplicity-restriction={severity=INFO, lower-multiplicity=0, upper-multiplicity-infinite=true}
          class content conditional Invariant
            4 x primitive attribute tailoring, all with in-scope=false, default-value-handling=NO-DEFAULT:
              dtcKind: multiplicity-restriction={severity=ERROR, lower-multiplicity=0, upper-multiplicity=1}
              dtcNumber: multiplicity-restriction={severity=WARNING, lower-multiplicity=0, upper-multiplicity=0}  # Spec element has lifecycle state 'obsolete'.
              obdDtcNumber: multiplicity-restriction={severity=ERROR, lower-multiplicity=0, upper-multiplicity=1}
              udsDtcNumber: multiplicity-restriction={severity=ERROR, lower-multiplicity=0, upper-multiplicity=1}
        DiagnosticEventManagerNeeds: multiplicity-restriction={severity=INFO, lower-multiplicity=0, upper-multiplicity-infinite=true}
          class content conditional Invariant
        DiagnosticEventNeeds: multiplicity-restriction={severity=INFO, lower-multiplicity=0, upper-multiplicity-infinite=true}
          class content conditional Invariant
            attribute-tailorings:
              primitive attribute tailoring considerPtoStatus: in-scope=false, multiplicity-restriction={severity=ERROR, lower-multiplicity=0, upper-multiplicity=1}, default-value-handling=NO-DEFAULT
              aggregation tailoring diagEventDebounceAlgorithm: in-scope=false, multiplicity-restriction={severity=ERROR, lower-multiplicity=0, upper-multiplicity=1}
              primitive attribute tailoring dtcKind: in-scope=false, multiplicity-restriction={severity=ERROR, lower-multiplicity=0, upper-multiplicity=1}, default-value-handling=NO-DEFAULT
              primitive attribute tailoring dtcNumber: in-scope=false, multiplicity-restriction={severity=WARNING, lower-multiplicity=0, upper-multiplicity=0}, default-value-handling=NO-DEFAULT  # Spec element has lifecycle state 'obsolete'.
              reference tailoring inhibitingFid: in-scope=false, multiplicity-restriction={severity=ERROR, lower-multiplicity=0, upper-multiplicity=1}, unresolved-reference-restriction=severity=ERROR
              reference tailoring inhibitingSecondaryFid: in-scope=false, multiplicity-restriction={severity=ERROR, lower-multiplicity=0, upper-multiplicity-infinite=true}, unresolved-reference-restriction=severity=ERROR
              primitive attribute tailoring obdDtcNumber: in-scope=false, multiplicity-restriction={severity=ERROR, lower-multiplicity=0, upper-multiplicity=1}, default-value-handling=NO-DEFAULT
              primitive attribute tailoring udsDtcNumber: in-scope=false, multiplicity-restriction={severity=ERROR, lower-multiplicity=0, upper-multiplicity=1}, default-value-handling=NO-DEFAULT
        DiagnosticIoControlNeeds: multiplicity-restriction={severity=INFO, lower-multiplicity=0, upper-multiplicity-infinite=true}
          class content conditional Invariant
            primitive attribute tailoring didNumber: in-scope=false, multiplicity-restriction={severity=ERROR, lower-multiplicity=0, upper-multiplicity=1}, default-value-handling=NO-DEFAULT
            primitive attribute tailoring freezeCurrentStateSupported: in-scope=false, multiplicity-restriction={severity=ERROR, lower-multiplicity=0, upper-multiplicity=1}, default-value-handling=NO-DEFAULT
            primitive attribute tailoring shortTermAdjustmentSupported: in-scope=false, multiplicity-restriction={severity=ERROR, lower-multiplicity=0, upper-multiplicity=1}, default-value-handling=NO-DEFAULT
        DiagnosticOperationCycleNeeds: multiplicity-restriction={severity=INFO, lower-multiplicity=0, upper-multiplicity-infinite=true}
          class content conditional Invariant
            primitive attribute tailoring operationCycle: in-scope=false, multiplicity-restriction={severity=ERROR, lower-multiplicity=0, upper-multiplicity=1}, default-value-handling=NO-DEFAULT
            primitive attribute tailoring operationCycleAutomaticEnd: in-scope=false, multiplicity-restriction={severity=ERROR, lower-multiplicity=0, upper-multiplicity=1}, default-value-handling=NO-DEFAULT
            primitive attribute tailoring operationCycleAutostart: in-scope=false, multiplicity-restriction={severity=ERROR, lower-multiplicity=0, upper-multiplicity=1}, default-value-handling=NO-DEFAULT
        DiagnosticRoutineNeeds: multiplicity-restriction={severity=INFO, lower-multiplicity=0, upper-multiplicity-infinite=true}
          class content conditional Invariant
            primitive attribute tailoring diagRoutineType: in-scope=false, multiplicity-restriction={severity=ERROR, lower-multiplicity=0, upper-multiplicity=1}, default-value-handling=NO-DEFAULT
            primitive attribute tailoring ridNumber: in-scope=false, multiplicity-restriction={severity=ERROR, lower-multiplicity=0, upper-multiplicity=1}, default-value-handling=NO-DEFAULT
        DiagnosticStorageConditionNeeds: multiplicity-restriction={severity=INFO, lower-multiplicity=0, upper-multiplicity-infinite=true}
          class content conditional Invariant
            primitive attribute tailoring initialStatus: in-scope=false, multiplicity-restriction={severity=ERROR, lower-multiplicity=0, upper-multiplicity=1}, default-value-handling=NO-DEFAULT
        DiagnosticValueNeeds: multiplicity-restriction={severity=INFO, lower-multiplicity=0, upper-multiplicity-infinite=true}
          class content conditional Invariant
            primitive attribute tailoring dataLength: in-scope=false, multiplicity-restriction={severity=ERROR, lower-multiplicity=0, upper-multiplicity=1}, default-value-handling=NO-DEFAULT
            primitive attribute tailoring diagnosticValueAccess: in-scope=false, multiplicity-restriction={severity=ERROR, lower-multiplicity=0, upper-multiplicity=1}, default-value-handling=NO-DEFAULT
            primitive attribute tailoring didNumber: in-scope=false, multiplicity-restriction={severity=ERROR, lower-multiplicity=0, upper-multiplicity=1}, default-value-handling=NO-DEFAULT
        DiagnosticsCommunicationSecurityNeeds: multiplicity-restriction={severity=INFO, lower-multiplicity=0, upper-multiplicity-infinite=true}
          class content conditional Invariant
        DiscoveryTechnology: multiplicity-restriction={severity=WARNING, lower-multiplicity=0, upper-multiplicity=0}  # Spec element has lifecycle state 'obsolete' since 4.1.2.
          class content conditional Invariant
            primitive attribute tailoring name: in-scope=false, multiplicity-restriction={severity=ERROR, lower-multiplicity=0, upper-multiplicity=1}, default-value-handling=NO-DEFAULT
            primitive attribute tailoring version: in-scope=false, multiplicity-restriction={severity=ERROR, lower-multiplicity=0, upper-multiplicity=1}, default-value-handling=NO-DEFAULT
        DltUserNeeds: multiplicity-restriction={severity=INFO, lower-multiplicity=0, upper-multiplicity-infinite=true}
          class content conditional Invariant
        DoIpActivationLineNeeds: multiplicity-restriction={severity=INFO, lower-multiplicity=0, upper-multiplicity-infinite=true}
          class content conditional Invariant
        DoIpEntity: multiplicity-restriction={severity=INFO, lower-multiplicity=0, upper-multiplicity-infinite=true}
          class content conditional Invariant
            primitive attribute tailoring doIpEntityRole: in-scope=false, multiplicity-restriction={severity=ERROR, lower-multiplicity=0, upper-multiplicity=1}, default-value-handling=NO-DEFAULT
        DoIpGidNeeds: multiplicity-restriction={severity=INFO, lower-multiplicity=0, upper-multiplicity-infinite=true}
          class content conditional Invariant
        DoIpGidSynchronizationNeeds: multiplicity-restriction={severity=INFO, lower-multiplicity=0, upper-multiplicity-infinite=true}
          class content conditional Invariant
        DoIpPowerModeStatusNeeds: multiplicity-restriction={severity=INFO, lower-multiplicity=0, upper-multiplicity-infinite=true}
          class content conditional Invariant
        DoIpRoutingActivationAuthenticationNeeds: multiplicity-restriction={severity=INFO, lower-multiplicity=0, upper-multiplicity-infinite=true}
          class content conditional Invariant
            primitive attribute tailoring dataLengthRequest: in-scope=false, multiplicity-restriction={severity=ERROR, lower-multiplicity=0, upper-multiplicity=1}, default-value-handling=NO-DEFAULT
            primitive attribute tailoring dataLengthResponse: in-scope=false, multiplicity-restriction={severity=ERROR, lower-multiplicity=0, upper-multiplicity=1}, default-value-handling=NO-DEFAULT
            primitive attribute tailoring routingActivationType: in-scope=false, multiplicity-restriction={severity=ERROR, lower-multiplicity=0, upper-multiplicity=1}, default-value-handling=NO-DEFAULT
        DoIpRoutingActivationConfirmationNeeds: multiplicity-restriction={severity=INFO, lower-multiplicity=0, upper-multiplicity-infinite=true}
          class content conditional Invariant
            primitive attribute tailoring dataLengthRequest: in-scope=false, multiplicity-restriction={severity=ERROR, lower-multiplicity=0, upper-multiplicity=1}, default-value-handling=NO-DEFAULT
            primitive attribute tailoring dataLengthResponse: in-scope=false, multiplicity-restriction={severity=ERROR, lower-multiplicity=0, upper-multiplicity=1}, default-value-handling=NO-DEFAULT
            primitive attribute tailoring routingActivationType: in-scope=false, multiplicity-restriction={severity=ERROR, lower-multiplicity=0, upper-multiplicity=1}, default-value-handling=NO-DEFAULT
      abstract class tailoring DoIpServiceNeeds: multiplicity-restriction={severity=INFO, lower-multiplicity=0, upper-multiplicity-infinite=true}
        class content conditional Invariant
      concrete class tailoring DocRevision: in-scope=false, multiplicity-restriction={severity=INFO, lower-multiplicity=0, upper-multiplicity-infinite=true}, validation-root=false
        class content conditional Invariant
          attribute-tailorings:
            primitive attribute tailoring date: in-scope=false, multiplicity-restriction={severity=ERROR, lower-multiplicity=0, upper-multiplicity=1}, default-value-handling=NO-DEFAULT
            primitive attribute tailoring issuedBy: in-scope=false, multiplicity-restriction={severity=ERROR, lower-multiplicity=0, upper-multiplicity=1}, default-value-handling=NO-DEFAULT
            aggregation tailoring modification: in-scope=false, multiplicity-restriction={severity=ERROR, lower-multiplicity=0, upper-multiplicity-infinite=true}
            4 x primitive attribute tailoring, all with in-scope=false, multiplicity-restriction={severity=ERROR, lower-multiplicity=0, upper-multiplicity=1}, default-value-handling=NO-DEFAULT:
              revisionLabel
              revisionLabelP1
              revisionLabelP2
              state
      abstract class tailoring DocumentViewSelectable: multiplicity-restriction={severity=INFO, lower-multiplicity=0, upper-multiplicity-infinite=true}
        class content conditional Invariant
          primitive attribute tailoring si: in-scope=false, multiplicity-restriction={severity=ERROR, lower-multiplicity=0, upper-multiplicity=1}, default-value-handling=NO-DEFAULT
          primitive attribute tailoring view: in-scope=false, multiplicity-restriction={severity=ERROR, lower-multiplicity=0, upper-multiplicity=1}, default-value-handling=NO-DEFAULT
      8 x concrete class tailoring, all with in-scope=false, multiplicity-restriction={severity=INFO, lower-multiplicity=0, upper-multiplicity-infinite=true}, validation-root=false:
        Documentation
          class content conditional Invariant
            attribute-tailorings:
              aggregation tailoring context: in-scope=false, multiplicity-restriction={severity=ERROR, lower-multiplicity=0, upper-multiplicity-infinite=true}
              aggregation tailoring documentationContent: in-scope=false, multiplicity-restriction={severity=ERROR, lower-multiplicity=0, upper-multiplicity=1}
        DocumentationBlock
          class content conditional Invariant
            attribute-tailorings:
              10 x aggregation tailoring, all with in-scope=false, multiplicity-restriction={severity=ERROR, lower-multiplicity=0, upper-multiplicity-infinite=true}, variation-restriction={severity=ERROR, variation=true, valid-binding-times=[BLUEPRINT-DERIVATION-TIME, SYSTEM-DESIGN-TIME, CODE-GENERATION-TIME, PRE-COMPILE-TIME, LINK-TIME, POST-BUILD]}:
                defList  # Multiplicity is 0..* since attribute is contained in mixed / mixedString class.
                figure  # Multiplicity is 0..* since attribute is contained in mixed / mixedString class.
                formula  # Multiplicity is 0..* since attribute is contained in mixed / mixedString class.
                labeledList  # Multiplicity is 0..* since attribute is contained in mixed / mixedString class.
                list  # Multiplicity is 0..* since attribute is contained in mixed / mixedString class.
                note  # Multiplicity is 0..* since attribute is contained in mixed / mixedString class.
                p  # Multiplicity is 0..* since attribute is contained in mixed / mixedString class.
                structuredReq  # Multiplicity is 0..* since attribute is contained in mixed / mixedString class.
                trace  # Multiplicity is 0..* since attribute is contained in mixed / mixedString class.
                verbatim  # Multiplicity is 0..* since attribute is contained in mixed / mixedString class.
        DocumentationContext
          class content conditional Invariant
            attribute-tailorings:
              aggregation tailoring feature: in-scope=false, multiplicity-restriction={severity=ERROR, lower-multiplicity=0, upper-multiplicity=1}
              reference tailoring identifiable: in-scope=false, multiplicity-restriction={severity=ERROR, lower-multiplicity=0, upper-multiplicity=1}, unresolved-reference-restriction=severity=ERROR
        DtcStatusChangeNotificationNeeds
          class content conditional Invariant
            primitive attribute tailoring dtcFormatType: in-scope=false, multiplicity-restriction={severity=ERROR, lower-multiplicity=0, upper-multiplicity=1}, default-value-handling=NO-DEFAULT
        DynamicPart
          class content conditional Invariant
            attribute-tailorings:
              aggregation tailoring dynamicPartAlternative: in-scope=false, multiplicity-restriction={severity=ERROR, lower-multiplicity=0, upper-multiplicity-infinite=true}
        DynamicPartAlternative
          class content conditional Invariant
            attribute-tailorings:
              reference tailoring iPdu: in-scope=false, multiplicity-restriction={severity=ERROR, lower-multiplicity=0, upper-multiplicity=1}, unresolved-reference-restriction=severity=ERROR
              primitive attribute tailoring initialDynamicPart: in-scope=false, multiplicity-restriction={severity=ERROR, lower-multiplicity=0, upper-multiplicity=1}, default-value-handling=NO-DEFAULT
              primitive attribute tailoring selectorFieldCode: in-scope=false, multiplicity-restriction={severity=ERROR, lower-multiplicity=0, upper-multiplicity=1}, default-value-handling=NO-DEFAULT
        ECUMapping
          class content conditional Invariant
            attribute-tailorings:
              aggregation tailoring commControllerMapping: in-scope=false, multiplicity-restriction={severity=ERROR, lower-multiplicity=0, upper-multiplicity-infinite=true}
              reference tailoring ecu: in-scope=false, multiplicity-restriction={severity=ERROR, lower-multiplicity=0, upper-multiplicity=1}, unresolved-reference-restriction=severity=ERROR
              reference tailoring ecuInstance: in-scope=false, multiplicity-restriction={severity=ERROR, lower-multiplicity=0, upper-multiplicity=1}, unresolved-reference-restriction=severity=ERROR
              aggregation tailoring hwPortMapping: in-scope=false, multiplicity-restriction={severity=ERROR, lower-multiplicity=0, upper-multiplicity-infinite=true}
        EOCExecutableEntityRef
          class content conditional Invariant
            attribute-tailorings:
              aggregation tailoring component: in-scope=false, multiplicity-restriction={severity=ERROR, lower-multiplicity=0, upper-multiplicity=1}
              reference tailoring executable: in-scope=false, multiplicity-restriction={severity=ERROR, lower-multiplicity=0, upper-multiplicity=1}, unresolved-reference-restriction=severity=ERROR
              reference tailoring successor: in-scope=false, multiplicity-restriction={severity=ERROR, lower-multiplicity=0, upper-multiplicity-infinite=true}, unresolved-reference-restriction=severity=ERROR
      abstract class tailoring EOCExecutableEntityRefAbstract: multiplicity-restriction={severity=INFO, lower-multiplicity=0, upper-multiplicity-infinite=true}
        class content conditional Invariant
          attribute-tailorings:
            reference tailoring directSuccessor: in-scope=false, multiplicity-restriction={severity=ERROR, lower-multiplicity=0, upper-multiplicity-infinite=true}, unresolved-reference-restriction=severity=ERROR
