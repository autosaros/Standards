[part 2 of 4: package /AUTOSAR/DataExchangePoints]
AUTOSAR XML (schema 00046)
package /AUTOSAR/DataExchangePoints  (continued)
  data exchange point Default: kind=AGREED, referenced-baseline=standard-revisions=CP 4.1.3  (continued)
    data-format-tailoring:  (continued)
      7 x concrete class tailoring, all with in-scope=false, multiplicity-restriction={severity=INFO, lower-multiplicity=0, upper-multiplicity-infinite=true}, validation-root=false:
        EOCExecutableEntityRefGroup
          class content conditional Invariant
            attribute-tailorings:
              primitive attribute tailoring maxCycles: in-scope=false, multiplicity-restriction={severity=ERROR, lower-multiplicity=0, upper-multiplicity=1}, default-value-handling=NO-DEFAULT
              primitive attribute tailoring maxSlots: in-scope=false, multiplicity-restriction={severity=ERROR, lower-multiplicity=0, upper-multiplicity=1}, default-value-handling=NO-DEFAULT
              reference tailoring nestedElement: in-scope=false, multiplicity-restriction={severity=ERROR, lower-multiplicity=0, upper-multiplicity-infinite=true}, unresolved-reference-restriction=severity=ERROR
              reference tailoring successor: in-scope=false, multiplicity-restriction={severity=ERROR, lower-multiplicity=0, upper-multiplicity-infinite=true}, unresolved-reference-restriction=severity=ERROR
              reference tailoring triggeringEvent: in-scope=false, multiplicity-restriction={severity=ERROR, lower-multiplicity=0, upper-multiplicity=1}, unresolved-reference-restriction=severity=ERROR
        EcuAbstractionSwComponentType
          class content conditional Invariant
            attribute-tailorings:
              reference tailoring hardwareElement: in-scope=false, multiplicity-restriction={severity=ERROR, lower-multiplicity=0, upper-multiplicity-infinite=true}, unresolved-reference-restriction=severity=ERROR
        EcuInstance
          class content conditional Invariant
            attribute-tailorings:
              reference tailoring associatedComIPduGroup: in-scope=false, multiplicity-restriction={severity=ERROR, lower-multiplicity=0, upper-multiplicity-infinite=true}, unresolved-reference-restriction=severity=ERROR
              reference tailoring associatedPdurIPduGroup: in-scope=false, multiplicity-restriction={severity=ERROR, lower-multiplicity=0, upper-multiplicity-infinite=true}, unresolved-reference-restriction=severity=ERROR
              reference tailoring canTpAddress: in-scope=false, multiplicity-restriction={severity=ERROR, lower-multiplicity=0, upper-multiplicity-infinite=true}, unresolved-reference-restriction=severity=ERROR
              4 x primitive attribute tailoring, all with in-scope=false, multiplicity-restriction={severity=ERROR, lower-multiplicity=0, upper-multiplicity=1}, default-value-handling=NO-DEFAULT:
                comConfigurationGwTimeBase
                comConfigurationRxTimeBase
                comConfigurationTxTimeBase
                comEnableMDTForCyclicTransmission
              aggregation tailoring commController: in-scope=false, multiplicity-restriction={severity=ERROR, lower-multiplicity=0, upper-multiplicity-infinite=true}
              aggregation tailoring connector: in-scope=false, multiplicity-restriction={severity=ERROR, lower-multiplicity=0, upper-multiplicity-infinite=true}
              primitive attribute tailoring diagnosticAddress: in-scope=false, multiplicity-restriction={severity=ERROR, lower-multiplicity=0, upper-multiplicity=1}, default-value-handling=NO-DEFAULT
              aggregation tailoring partition: in-scope=false, multiplicity-restriction={severity=ERROR, lower-multiplicity=0, upper-multiplicity-infinite=true}
              primitive attribute tailoring sleepModeSupported: in-scope=false, multiplicity-restriction={severity=ERROR, lower-multiplicity=0, upper-multiplicity=1}, default-value-handling=NO-DEFAULT
              reference tailoring tpAddress: in-scope=false, multiplicity-restriction={severity=ERROR, lower-multiplicity=0, upper-multiplicity-infinite=true}, unresolved-reference-restriction=severity=ERROR
              primitive attribute tailoring wakeUpOverBusSupported: in-scope=false, multiplicity-restriction={severity=ERROR, lower-multiplicity=0, upper-multiplicity=1}, default-value-handling=NO-DEFAULT
        EcuPartition
          class content conditional Invariant
            primitive attribute tailoring execInUserMode: in-scope=false, multiplicity-restriction={severity=ERROR, lower-multiplicity=0, upper-multiplicity=1}, default-value-handling=NO-DEFAULT
        EcuResourceEstimation
          class content conditional Invariant
            attribute-tailorings:
              aggregation tailoring bswResourceEstimation: in-scope=false, multiplicity-restriction={severity=ERROR, lower-multiplicity=0, upper-multiplicity=1}
              reference tailoring ecuInstance: in-scope=false, multiplicity-restriction={severity=ERROR, lower-multiplicity=0, upper-multiplicity=1}, unresolved-reference-restriction=severity=ERROR
              aggregation tailoring introduction: in-scope=false, multiplicity-restriction={severity=ERROR, lower-multiplicity=0, upper-multiplicity=1}
              aggregation tailoring rteResourceEstimation: in-scope=false, multiplicity-restriction={severity=ERROR, lower-multiplicity=0, upper-multiplicity=1}
              reference tailoring swCompToEcuMapping: in-scope=false, multiplicity-restriction={severity=ERROR, lower-multiplicity=0, upper-multiplicity-infinite=true}, unresolved-reference-restriction=severity=ERROR
        EcuStateMgrUserNeeds
          class content conditional Invariant
        EcuTiming
          class content conditional Invariant
            attribute-tailorings:
              reference tailoring ecuConfiguration: in-scope=false, multiplicity-restriction={severity=ERROR, lower-multiplicity=0, upper-multiplicity=1}, unresolved-reference-restriction=severity=ERROR
      abstract class tailoring EcucAbstractReferenceDef: multiplicity-restriction={severity=INFO, lower-multiplicity=0, upper-multiplicity-infinite=true}
        class content conditional Invariant
      abstract class tailoring EcucAbstractReferenceValue: multiplicity-restriction={severity=INFO, lower-multiplicity=0, upper-multiplicity-infinite=true}
        class content conditional Invariant
          attribute-tailorings:
            aggregation tailoring annotation: in-scope=false, multiplicity-restriction={severity=ERROR, lower-multiplicity=0, upper-multiplicity-infinite=true}
            reference tailoring definition: in-scope=false, multiplicity-restriction={severity=ERROR, lower-multiplicity=0, upper-multiplicity=1}, unresolved-reference-restriction=severity=ERROR
      abstract class tailoring EcucAbstractStringParamDef: multiplicity-restriction={severity=INFO, lower-multiplicity=0, upper-multiplicity-infinite=true}, variation-restriction={severity=ERROR, variation=true, valid-binding-times=[BLUEPRINT-DERIVATION-TIME, SYSTEM-DESIGN-TIME, CODE-GENERATION-TIME]}
        class content conditional Invariant
          4 x primitive attribute tailoring, all with in-scope=false, multiplicity-restriction={severity=ERROR, lower-multiplicity=0, upper-multiplicity=1}, default-value-handling=NO-DEFAULT:
            defaultValue
              sub-attribute-tailorings:
                primitive attribute tailoring xmlSpace: in-scope=false, multiplicity-restriction={severity=ERROR, lower-multiplicity=0, upper-multiplicity=1}, default-value-handling=NO-DEFAULT
            maxLength
            minLength
            regularExpression
      5 x concrete class tailoring, all with in-scope=false, multiplicity-restriction={severity=INFO, lower-multiplicity=0, upper-multiplicity-infinite=true}, validation-root=false:
        EcucAddInfoParamDef
          class content conditional Invariant
        EcucAddInfoParamValue
          class content conditional Invariant
            attribute-tailorings:
              aggregation tailoring value: in-scope=false, multiplicity-restriction={severity=ERROR, lower-multiplicity=0, upper-multiplicity=1}
        EcucBooleanParamDef
          class content conditional Invariant
            primitive attribute tailoring defaultValue: in-scope=false, multiplicity-restriction={severity=ERROR, lower-multiplicity=0, upper-multiplicity=1}, variation-restriction={severity=ERROR, variation=true, valid-binding-times=[BLUEPRINT-DERIVATION-TIME, SYSTEM-DESIGN-TIME, CODE-GENERATION-TIME]}, default-value-handling=NO-DEFAULT
        EcucChoiceContainerDef
          class content conditional Invariant
            attribute-tailorings:
              aggregation tailoring choice: in-scope=false, multiplicity-restriction={severity=ERROR, lower-multiplicity=0, upper-multiplicity-infinite=true}
        EcucChoiceReferenceDef
          class content conditional Invariant
            attribute-tailorings:
              reference tailoring destination: in-scope=false, multiplicity-restriction={severity=ERROR, lower-multiplicity=0, upper-multiplicity-infinite=true}, unresolved-reference-restriction=severity=ERROR
      abstract class tailoring EcucCommonAttributes: multiplicity-restriction={severity=INFO, lower-multiplicity=0, upper-multiplicity-infinite=true}
        class content conditional Invariant
          attribute-tailorings:
            aggregation tailoring configurationClassAffection: in-scope=false, multiplicity-restriction={severity=ERROR, lower-multiplicity=0, upper-multiplicity=1}
            aggregation tailoring implementationConfigClass: in-scope=false, multiplicity-restriction={severity=ERROR, lower-multiplicity=0, upper-multiplicity-infinite=true}
            primitive attribute tailoring origin: in-scope=false, multiplicity-restriction={severity=ERROR, lower-multiplicity=0, upper-multiplicity=1}, default-value-handling=NO-DEFAULT
            primitive attribute tailoring requiresIndex: in-scope=false, multiplicity-restriction={severity=ERROR, lower-multiplicity=0, upper-multiplicity=1}, default-value-handling=NO-DEFAULT
      concrete class tailoring EcucConditionFormula: in-scope=false, multiplicity-restriction={severity=INFO, lower-multiplicity=0, upper-multiplicity-infinite=true}, validation-root=false
        class content conditional Invariant
          attribute-tailorings:
            reference tailoring ecucQuery: in-scope=false, multiplicity-restriction={severity=ERROR, lower-multiplicity=0, upper-multiplicity=1}, unresolved-reference-restriction=severity=ERROR
            reference tailoring ecucQueryString: in-scope=false, multiplicity-restriction={severity=ERROR, lower-multiplicity=0, upper-multiplicity=1}, unresolved-reference-restriction=severity=ERROR
      concrete class tailoring EcucConditionSpecification: in-scope=false, multiplicity-restriction={severity=INFO, lower-multiplicity=0, upper-multiplicity-infinite=true}, validation-root=false
        class content conditional Invariant
          attribute-tailorings:
            aggregation tailoring conditionFormula: in-scope=false, multiplicity-restriction={severity=ERROR, lower-multiplicity=0, upper-multiplicity=1}
            aggregation tailoring ecucQuery: in-scope=false, multiplicity-restriction={severity=ERROR, lower-multiplicity=0, upper-multiplicity-infinite=true}
            aggregation tailoring informalFormula: in-scope=false, multiplicity-restriction={severity=ERROR, lower-multiplicity=0, upper-multiplicity=1}
      concrete class tailoring EcucConfigurationClassAffection: in-scope=false, multiplicity-restriction={severity=INFO, lower-multiplicity=0, upper-multiplicity-infinite=true}, validation-root=false
        class content conditional Invariant
          attribute-tailorings:
            reference tailoring affected: in-scope=false, multiplicity-restriction={severity=ERROR, lower-multiplicity=0, upper-multiplicity-infinite=true}, unresolved-reference-restriction=severity=ERROR
            primitive attribute tailoring affectionKind: in-scope=false, multiplicity-restriction={severity=WARNING, lower-multiplicity=0, upper-multiplicity=0}, default-value-handling=NO-DEFAULT  # Spec element has lifecycle state 'obsolete'.
      abstract class tailoring EcucContainerDef: multiplicity-restriction={severity=INFO, lower-multiplicity=0, upper-multiplicity-infinite=true}
        class content conditional Invariant
          primitive attribute tailoring postBuildChangeable: in-scope=false, multiplicity-restriction={severity=ERROR, lower-multiplicity=0, upper-multiplicity=1}, default-value-handling=NO-DEFAULT
          primitive attribute tailoring requiresIndex: in-scope=false, multiplicity-restriction={severity=ERROR, lower-multiplicity=0, upper-multiplicity=1}, default-value-handling=NO-DEFAULT
      concrete class tailoring EcucContainerValue: in-scope=false, multiplicity-restriction={severity=INFO, lower-multiplicity=0, upper-multiplicity-infinite=true}, validation-root=false
        class content conditional Invariant
          attribute-tailorings:
            reference tailoring definition: in-scope=false, multiplicity-restriction={severity=ERROR, lower-multiplicity=0, upper-multiplicity=1}, unresolved-reference-restriction=severity=ERROR
            aggregation tailoring parameterValue: in-scope=false, multiplicity-restriction={severity=ERROR, lower-multiplicity=0, upper-multiplicity-infinite=true}, variation-restriction={severity=ERROR, variation=true, valid-binding-times=[BLUEPRINT-DERIVATION-TIME, SYSTEM-DESIGN-TIME, CODE-GENERATION-TIME, PRE-COMPILE-TIME, LINK-TIME, POST-BUILD]}
            aggregation tailoring referenceValue: in-scope=false, multiplicity-restriction={severity=ERROR, lower-multiplicity=0, upper-multiplicity-infinite=true}, variation-restriction={severity=ERROR, variation=true, valid-binding-times=[BLUEPRINT-DERIVATION-TIME, SYSTEM-DESIGN-TIME, CODE-GENERATION-TIME, PRE-COMPILE-TIME, LINK-TIME, POST-BUILD]}
            aggregation tailoring subContainer: in-scope=false, multiplicity-restriction={severity=ERROR, lower-multiplicity=0, upper-multiplicity-infinite=true}, variation-restriction={severity=ERROR, variation=true, valid-binding-times=[BLUEPRINT-DERIVATION-TIME, SYSTEM-DESIGN-TIME, CODE-GENERATION-TIME, PRE-COMPILE-TIME, LINK-TIME, POST-BUILD]}
      concrete class tailoring EcucDefinitionCollection: in-scope=false, multiplicity-restriction={severity=INFO, lower-multiplicity=0, upper-multiplicity-infinite=true}, validation-root=false
        class content conditional Invariant
          attribute-tailorings:
            reference tailoring module: in-scope=false, multiplicity-restriction={severity=ERROR, lower-multiplicity=0, upper-multiplicity-infinite=true}, unresolved-reference-restriction=severity=ERROR
      abstract class tailoring EcucDefinitionElement: multiplicity-restriction={severity=INFO, lower-multiplicity=0, upper-multiplicity-infinite=true}
        class content conditional Invariant
          attribute-tailorings:
            aggregation tailoring ecucCond: in-scope=false, multiplicity-restriction={severity=ERROR, lower-multiplicity=0, upper-multiplicity=1}
            aggregation tailoring ecucValidationCond: in-scope=false, multiplicity-restriction={severity=ERROR, lower-multiplicity=0, upper-multiplicity-infinite=true}
            4 x primitive attribute tailoring, all with in-scope=false, multiplicity-restriction={severity=ERROR, lower-multiplicity=0, upper-multiplicity=1}, default-value-handling=NO-DEFAULT:
              lowerMultiplicity: variation-restriction={severity=ERROR, variation=true, valid-binding-times=[BLUEPRINT-DERIVATION-TIME, SYSTEM-DESIGN-TIME, CODE-GENERATION-TIME]}
              scope
              upperMultiplicity: variation-restriction={severity=ERROR, variation=true, valid-binding-times=[BLUEPRINT-DERIVATION-TIME, SYSTEM-DESIGN-TIME, CODE-GENERATION-TIME]}
              upperMultiplicityInfinite: variation-restriction={severity=ERROR, variation=true, valid-binding-times=[BLUEPRINT-DERIVATION-TIME, SYSTEM-DESIGN-TIME, CODE-GENERATION-TIME]}
      7 x concrete class tailoring, all with in-scope=false, multiplicity-restriction={severity=INFO, lower-multiplicity=0, upper-multiplicity-infinite=true}, validation-root=false:
        EcucDerivationSpecification
          class content conditional Invariant
            attribute-tailorings:
              aggregation tailoring calculationFormula: in-scope=false, multiplicity-restriction={severity=ERROR, lower-multiplicity=0, upper-multiplicity=1}
              aggregation tailoring ecucQuery: in-scope=false, multiplicity-restriction={severity=ERROR, lower-multiplicity=0, upper-multiplicity-infinite=true}
              aggregation tailoring informalFormula: in-scope=false, multiplicity-restriction={severity=ERROR, lower-multiplicity=0, upper-multiplicity=1}
        EcucEnumerationLiteralDef
          class content conditional Invariant
            attribute-tailorings:
              aggregation tailoring ecucCond: in-scope=false, multiplicity-restriction={severity=ERROR, lower-multiplicity=0, upper-multiplicity=1}
              primitive attribute tailoring origin: in-scope=false, multiplicity-restriction={severity=ERROR, lower-multiplicity=0, upper-multiplicity=1}, default-value-handling=NO-DEFAULT
        EcucEnumerationParamDef
          class content conditional Invariant
            attribute-tailorings:
              primitive attribute tailoring defaultValue: in-scope=false, multiplicity-restriction={severity=ERROR, lower-multiplicity=0, upper-multiplicity=1}, default-value-handling=NO-DEFAULT
                sub-attribute-tailorings:
                  primitive attribute tailoring namePattern: in-scope=false, multiplicity-restriction={severity=ERROR, lower-multiplicity=0, upper-multiplicity=1}, default-value-handling=NO-DEFAULT
              aggregation tailoring literal: in-scope=false, multiplicity-restriction={severity=ERROR, lower-multiplicity=0, upper-multiplicity-infinite=true}
        EcucFloatParamDef
          class content conditional Invariant
            primitive attribute tailoring defaultValue: in-scope=false, multiplicity-restriction={severity=ERROR, lower-multiplicity=0, upper-multiplicity=1}, variation-restriction={severity=ERROR, variation=true, valid-binding-times=[BLUEPRINT-DERIVATION-TIME, SYSTEM-DESIGN-TIME, CODE-GENERATION-TIME]}, default-value-handling=NO-DEFAULT
            primitive attribute tailoring max: in-scope=false, multiplicity-restriction={severity=ERROR, lower-multiplicity=0, upper-multiplicity=1}, variation-restriction={severity=ERROR, variation=true, valid-binding-times=[BLUEPRINT-DERIVATION-TIME, SYSTEM-DESIGN-TIME, CODE-GENERATION-TIME]}, default-value-handling=NO-DEFAULT
              sub-attribute-tailorings:
                primitive attribute tailoring intervalType: in-scope=false, multiplicity-restriction={severity=ERROR, lower-multiplicity=0, upper-multiplicity=1}, default-value-handling=NO-DEFAULT
            primitive attribute tailoring min: in-scope=false, multiplicity-restriction={severity=ERROR, lower-multiplicity=0, upper-multiplicity=1}, variation-restriction={severity=ERROR, variation=true, valid-binding-times=[BLUEPRINT-DERIVATION-TIME, SYSTEM-DESIGN-TIME, CODE-GENERATION-TIME]}, default-value-handling=NO-DEFAULT
              sub-attribute-tailorings:
                primitive attribute tailoring intervalType: in-scope=false, multiplicity-restriction={severity=ERROR, lower-multiplicity=0, upper-multiplicity=1}, default-value-handling=NO-DEFAULT
        EcucForeignReferenceDef
          class content conditional Invariant
            primitive attribute tailoring destinationType: in-scope=false, multiplicity-restriction={severity=ERROR, lower-multiplicity=0, upper-multiplicity=1}, default-value-handling=NO-DEFAULT
        EcucFunctionNameDef
          class content conditional Invariant
        EcucImplementationConfigurationClass
          class content conditional Invariant
            primitive attribute tailoring configClass: in-scope=false, multiplicity-restriction={severity=ERROR, lower-multiplicity=0, upper-multiplicity=1}, default-value-handling=NO-DEFAULT
            primitive attribute tailoring configVariant: in-scope=false, multiplicity-restriction={severity=ERROR, lower-multiplicity=0, upper-multiplicity=1}, default-value-handling=NO-DEFAULT
      abstract class tailoring EcucIndexableValue: multiplicity-restriction={severity=INFO, lower-multiplicity=0, upper-multiplicity-infinite=true}
        class content conditional Invariant
          primitive attribute tailoring index: in-scope=false, multiplicity-restriction={severity=ERROR, lower-multiplicity=0, upper-multiplicity=1}, default-value-handling=NO-DEFAULT
      9 x concrete class tailoring, all with in-scope=false, multiplicity-restriction={severity=INFO, lower-multiplicity=0, upper-multiplicity-infinite=true}, validation-root=false:
        EcucInstanceReferenceDef
          class content conditional Invariant
            primitive attribute tailoring destinationContext: in-scope=false, multiplicity-restriction={severity=ERROR, lower-multiplicity=0, upper-multiplicity=1}, default-value-handling=NO-DEFAULT
            primitive attribute tailoring destinationType: in-scope=false, multiplicity-restriction={severity=ERROR, lower-multiplicity=0, upper-multiplicity=1}, default-value-handling=NO-DEFAULT
        EcucInstanceReferenceValue
          class content conditional Invariant
            attribute-tailorings:
              aggregation tailoring value: in-scope=false, multiplicity-restriction={severity=ERROR, lower-multiplicity=0, upper-multiplicity=1}
        EcucIntegerParamDef
          class content conditional Invariant
            primitive attribute tailoring defaultValue: in-scope=false, multiplicity-restriction={severity=ERROR, lower-multiplicity=0, upper-multiplicity=1}, variation-restriction={severity=ERROR, variation=true, valid-binding-times=[BLUEPRINT-DERIVATION-TIME, SYSTEM-DESIGN-TIME, CODE-GENERATION-TIME]}, default-value-handling=NO-DEFAULT
            primitive attribute tailoring max: in-scope=false, multiplicity-restriction={severity=ERROR, lower-multiplicity=0, upper-multiplicity=1}, variation-restriction={severity=ERROR, variation=true, valid-binding-times=[BLUEPRINT-DERIVATION-TIME, SYSTEM-DESIGN-TIME, CODE-GENERATION-TIME]}, default-value-handling=NO-DEFAULT
            primitive attribute tailoring min: in-scope=false, multiplicity-restriction={severity=ERROR, lower-multiplicity=0, upper-multiplicity=1}, variation-restriction={severity=ERROR, variation=true, valid-binding-times=[BLUEPRINT-DERIVATION-TIME, SYSTEM-DESIGN-TIME, CODE-GENERATION-TIME]}, default-value-handling=NO-DEFAULT
        EcucLinkerSymbolDef
          class content conditional Invariant
        EcucModuleConfigurationValues
          class content conditional Invariant
            attribute-tailorings:
              aggregation tailoring container: in-scope=false, multiplicity-restriction={severity=ERROR, lower-multiplicity=0, upper-multiplicity-infinite=true}, variation-restriction={severity=ERROR, variation=true, valid-binding-times=[BLUEPRINT-DERIVATION-TIME, SYSTEM-DESIGN-TIME, CODE-GENERATION-TIME, PRE-COMPILE-TIME, LINK-TIME, POST-BUILD]}
              reference tailoring definition: in-scope=false, multiplicity-restriction={severity=ERROR, lower-multiplicity=0, upper-multiplicity=1}, unresolved-reference-restriction=severity=ERROR
              primitive attribute tailoring ecucDefEdition: in-scope=false, multiplicity-restriction={severity=ERROR, lower-multiplicity=0, upper-multiplicity=1}, default-value-handling=NO-DEFAULT
              primitive attribute tailoring implementationConfigVariant: in-scope=false, multiplicity-restriction={severity=ERROR, lower-multiplicity=0, upper-multiplicity=1}, default-value-handling=NO-DEFAULT
              reference tailoring moduleDescription: in-scope=false, multiplicity-restriction={severity=ERROR, lower-multiplicity=0, upper-multiplicity=1}, unresolved-reference-restriction=severity=ERROR
        EcucModuleDef
          class content conditional Invariant
            attribute-tailorings:
              primitive attribute tailoring apiServicePrefix: in-scope=false, multiplicity-restriction={severity=ERROR, lower-multiplicity=0, upper-multiplicity=1}, default-value-handling=NO-DEFAULT
                sub-attribute-tailorings:
                  primitive attribute tailoring namePattern: in-scope=false, multiplicity-restriction={severity=ERROR, lower-multiplicity=0, upper-multiplicity=1}, default-value-handling=NO-DEFAULT
              aggregation tailoring container: in-scope=false, multiplicity-restriction={severity=ERROR, lower-multiplicity=0, upper-multiplicity-infinite=true}
              reference tailoring refinedModuleDef: in-scope=false, multiplicity-restriction={severity=ERROR, lower-multiplicity=0, upper-multiplicity=1}, unresolved-reference-restriction=severity=ERROR
              primitive attribute tailoring supportedConfigVariant: in-scope=false, multiplicity-restriction={severity=ERROR, lower-multiplicity=0, upper-multiplicity-infinite=true}, default-value-handling=NO-DEFAULT
        EcucMultilineStringParamDef
          class content conditional Invariant
        EcucNumericalParamValue
          class content conditional Invariant
            primitive attribute tailoring value: in-scope=false, multiplicity-restriction={severity=ERROR, lower-multiplicity=0, upper-multiplicity=1}, variation-restriction={severity=ERROR, variation=true, valid-binding-times=[BLUEPRINT-DERIVATION-TIME, SYSTEM-DESIGN-TIME, CODE-GENERATION-TIME, PRE-COMPILE-TIME]}, default-value-handling=NO-DEFAULT
        EcucParamConfContainerDef
          class content conditional Invariant
            attribute-tailorings:
              primitive attribute tailoring multipleConfigurationContainer: in-scope=false, multiplicity-restriction={severity=ERROR, lower-multiplicity=0, upper-multiplicity=1}, default-value-handling=NO-DEFAULT
              aggregation tailoring parameter: in-scope=false, multiplicity-restriction={severity=ERROR, lower-multiplicity=0, upper-multiplicity-infinite=true}
              aggregation tailoring reference: in-scope=false, multiplicity-restriction={severity=ERROR, lower-multiplicity=0, upper-multiplicity-infinite=true}
              aggregation tailoring subContainer: in-scope=false, multiplicity-restriction={severity=ERROR, lower-multiplicity=0, upper-multiplicity-infinite=true}
      abstract class tailoring EcucParameterDef: multiplicity-restriction={severity=INFO, lower-multiplicity=0, upper-multiplicity-infinite=true}
        class content conditional Invariant
          attribute-tailorings:
            aggregation tailoring derivation: in-scope=false, multiplicity-restriction={severity=ERROR, lower-multiplicity=0, upper-multiplicity=1}
            primitive attribute tailoring symbolicNameValue: in-scope=false, multiplicity-restriction={severity=ERROR, lower-multiplicity=0, upper-multiplicity=1}, default-value-handling=NO-DEFAULT
            primitive attribute tailoring withAuto: in-scope=false, multiplicity-restriction={severity=ERROR, lower-multiplicity=0, upper-multiplicity=1}, default-value-handling=NO-DEFAULT
      concrete class tailoring EcucParameterDerivationFormula: in-scope=false, multiplicity-restriction={severity=INFO, lower-multiplicity=0, upper-multiplicity-infinite=true}, validation-root=false
        class content conditional Invariant
          attribute-tailorings:
            reference tailoring ecucQuery: in-scope=false, multiplicity-restriction={severity=ERROR, lower-multiplicity=0, upper-multiplicity-infinite=true}, unresolved-reference-restriction=severity=ERROR  # Multiplicity is 0..* since attribute is contained in mixed / mixedString class.
            reference tailoring ecucQueryString: in-scope=false, multiplicity-restriction={severity=ERROR, lower-multiplicity=0, upper-multiplicity-infinite=true}, unresolved-reference-restriction=severity=ERROR  # Multiplicity is 0..* since attribute is contained in mixed / mixedString class.
      abstract class tailoring EcucParameterValue: multiplicity-restriction={severity=INFO, lower-multiplicity=0, upper-multiplicity-infinite=true}
        class content conditional Invariant
          attribute-tailorings:
            aggregation tailoring annotation: in-scope=false, multiplicity-restriction={severity=ERROR, lower-multiplicity=0, upper-multiplicity-infinite=true}
            reference tailoring definition: in-scope=false, multiplicity-restriction={severity=ERROR, lower-multiplicity=0, upper-multiplicity=1}, unresolved-reference-restriction=severity=ERROR
            primitive attribute tailoring isAutoValue: in-scope=false, multiplicity-restriction={severity=ERROR, lower-multiplicity=0, upper-multiplicity=1}, default-value-handling=NO-DEFAULT
      16 x concrete class tailoring, all with in-scope=false, multiplicity-restriction={severity=INFO, lower-multiplicity=0, upper-multiplicity-infinite=true}, validation-root=false:
        EcucQuery
          class content conditional Invariant
            attribute-tailorings:
              aggregation tailoring ecucQueryExpression: in-scope=false, multiplicity-restriction={severity=ERROR, lower-multiplicity=0, upper-multiplicity=1}
        EcucQueryExpression
          class content conditional Invariant
            attribute-tailorings:
              reference tailoring configElementDefGlobal: in-scope=false, multiplicity-restriction={severity=ERROR, lower-multiplicity=0, upper-multiplicity-infinite=true}, unresolved-reference-restriction=severity=ERROR  # Multiplicity is 0..* since attribute is contained in mixed / mixedString class.
              reference tailoring configElementDefLocal: in-scope=false, multiplicity-restriction={severity=ERROR, lower-multiplicity=0, upper-multiplicity-infinite=true}, unresolved-reference-restriction=severity=ERROR  # Multiplicity is 0..* since attribute is contained in mixed / mixedString class.
        EcucReferenceDef
          class content conditional Invariant
            attribute-tailorings:
              reference tailoring destination: in-scope=false, multiplicity-restriction={severity=ERROR, lower-multiplicity=0, upper-multiplicity=1}, unresolved-reference-restriction=severity=ERROR
        EcucReferenceValue
          class content conditional Invariant
            attribute-tailorings:
              reference tailoring value: in-scope=false, multiplicity-restriction={severity=ERROR, lower-multiplicity=0, upper-multiplicity=1}, unresolved-reference-restriction=severity=ERROR
        EcucStringParamDef
          class content conditional Invariant
        EcucSymbolicNameReferenceDef
          class content conditional Invariant
            attribute-tailorings:
              reference tailoring destination: in-scope=false, multiplicity-restriction={severity=ERROR, lower-multiplicity=0, upper-multiplicity=1}, unresolved-reference-restriction=severity=ERROR
        EcucTextualParamValue
          class content conditional Invariant
            primitive attribute tailoring value: in-scope=false, multiplicity-restriction={severity=ERROR, lower-multiplicity=0, upper-multiplicity=1}, default-value-handling=NO-DEFAULT
              sub-attribute-tailorings:
                primitive attribute tailoring xmlSpace: in-scope=false, multiplicity-restriction={severity=ERROR, lower-multiplicity=0, upper-multiplicity=1}, default-value-handling=NO-DEFAULT
        EcucValidationCondition
          class content conditional Invariant
            attribute-tailorings:
              aggregation tailoring ecucQuery: in-scope=false, multiplicity-restriction={severity=ERROR, lower-multiplicity=0, upper-multiplicity-infinite=true}
              aggregation tailoring validationFormula: in-scope=false, multiplicity-restriction={severity=ERROR, lower-multiplicity=0, upper-multiplicity=1}
        EcucValueCollection
          class content conditional Invariant
            attribute-tailorings:
              reference tailoring ecuExtract: in-scope=false, multiplicity-restriction={severity=ERROR, lower-multiplicity=0, upper-multiplicity=1}, unresolved-reference-restriction=severity=ERROR
              reference tailoring ecucValue: in-scope=false, multiplicity-restriction={severity=ERROR, lower-multiplicity=0, upper-multiplicity-infinite=true}, variation-restriction={severity=ERROR, variation=true, valid-binding-times=[BLUEPRINT-DERIVATION-TIME, SYSTEM-DESIGN-TIME, CODE-GENERATION-TIME, PRE-COMPILE-TIME]}, unresolved-reference-restriction=severity=ERROR
        EmphasisText
          class content conditional Invariant
            5 x primitive attribute tailoring, all with in-scope=false, multiplicity-restriction={severity=ERROR, lower-multiplicity=0, upper-multiplicity-infinite=true}, default-value-handling=NO-DEFAULT:
              color  # Multiplicity is 0..* since attribute is contained in mixed / mixedString class.
              font  # Multiplicity is 0..* since attribute is contained in mixed / mixedString class.
              sub  # Multiplicity is 0..* since attribute is contained in mixed / mixedString class.
              sup  # Multiplicity is 0..* since attribute is contained in mixed / mixedString class.
              type  # Multiplicity is 0..* since attribute is contained in mixed / mixedString class.
        EmptySignalMapping
          class content conditional Invariant
            attribute-tailorings:
              reference tailoring systemSignal: in-scope=false, multiplicity-restriction={severity=ERROR, lower-multiplicity=0, upper-multiplicity=1}, unresolved-reference-restriction=severity=ERROR
        EndToEndDescription
          class content conditional Invariant
            10 x primitive attribute tailoring, all with in-scope=false, default-value-handling=NO-DEFAULT:
              category: multiplicity-restriction={severity=ERROR, lower-multiplicity=0, upper-multiplicity=1}
              counterOffset: multiplicity-restriction={severity=ERROR, lower-multiplicity=0, upper-multiplicity=1}
              crcOffset: multiplicity-restriction={severity=ERROR, lower-multiplicity=0, upper-multiplicity=1}
              dataId: multiplicity-restriction={severity=ERROR, lower-multiplicity=0, upper-multiplicity-infinite=true}
              dataIdMode: multiplicity-restriction={severity=ERROR, lower-multiplicity=0, upper-multiplicity=1}
              dataIdNibbleOffset: multiplicity-restriction={severity=ERROR, lower-multiplicity=0, upper-multiplicity=1}
              dataLength: multiplicity-restriction={severity=ERROR, lower-multiplicity=0, upper-multiplicity=1}
              maxDeltaCounterInit: multiplicity-restriction={severity=ERROR, lower-multiplicity=0, upper-multiplicity=1}
              maxNoNewOrRepeatedData: multiplicity-restriction={severity=ERROR, lower-multiplicity=0, upper-multiplicity=1}
              syncCounterInit: multiplicity-restriction={severity=ERROR, lower-multiplicity=0, upper-multiplicity=1}
        EndToEndProtection
          class content conditional Invariant
            attribute-tailorings:
              aggregation tailoring endToEndProfile: in-scope=false, multiplicity-restriction={severity=ERROR, lower-multiplicity=0, upper-multiplicity=1}
              aggregation tailoring endToEndProtectionISignalIPdu: in-scope=false, multiplicity-restriction={severity=ERROR, lower-multiplicity=0, upper-multiplicity-infinite=true}, variation-restriction={severity=ERROR, variation=true, valid-binding-times=[BLUEPRINT-DERIVATION-TIME, SYSTEM-DESIGN-TIME, CODE-GENERATION-TIME, PRE-COMPILE-TIME]}
              aggregation tailoring endToEndProtectionVariablePrototype: in-scope=false, multiplicity-restriction={severity=ERROR, lower-multiplicity=0, upper-multiplicity-infinite=true}, variation-restriction={severity=ERROR, variation=true, valid-binding-times=[BLUEPRINT-DERIVATION-TIME, SYSTEM-DESIGN-TIME, CODE-GENERATION-TIME, PRE-COMPILE-TIME]}
        EndToEndProtectionISignalIPdu
          class content conditional Invariant
            attribute-tailorings:
              primitive attribute tailoring dataOffset: in-scope=false, multiplicity-restriction={severity=ERROR, lower-multiplicity=0, upper-multiplicity=1}, default-value-handling=NO-DEFAULT
              reference tailoring iSignalGroup: in-scope=false, multiplicity-restriction={severity=ERROR, lower-multiplicity=0, upper-multiplicity=1}, unresolved-reference-restriction=severity=ERROR
              reference tailoring iSignalIPdu: in-scope=false, multiplicity-restriction={severity=ERROR, lower-multiplicity=0, upper-multiplicity=1}, unresolved-reference-restriction=severity=ERROR
        EndToEndProtectionSet
          class content conditional Invariant
            attribute-tailorings:
              aggregation tailoring endToEndProtection: in-scope=false, multiplicity-restriction={severity=ERROR, lower-multiplicity=0, upper-multiplicity-infinite=true}, variation-restriction={severity=ERROR, variation=true, valid-binding-times=[BLUEPRINT-DERIVATION-TIME, SYSTEM-DESIGN-TIME, CODE-GENERATION-TIME, PRE-COMPILE-TIME]}
        EndToEndProtectionVariablePrototype
          class content conditional Invariant
            attribute-tailorings:
              aggregation tailoring receiver: in-scope=false, multiplicity-restriction={severity=ERROR, lower-multiplicity=0, upper-multiplicity-infinite=true}
              aggregation tailoring sender: in-scope=false, multiplicity-restriction={severity=ERROR, lower-multiplicity=0, upper-multiplicity=1}
              primitive attribute tailoring shortLabel: in-scope=false, multiplicity-restriction={severity=ERROR, lower-multiplicity=0, upper-multiplicity=1}, default-value-handling=NO-DEFAULT
                sub-attribute-tailorings:
                  primitive attribute tailoring namePattern: in-scope=false, multiplicity-restriction={severity=ERROR, lower-multiplicity=0, upper-multiplicity=1}, default-value-handling=NO-DEFAULT
      abstract class tailoring EngineeringObject: multiplicity-restriction={severity=INFO, lower-multiplicity=0, upper-multiplicity-infinite=true}
        class content conditional Invariant
          4 x primitive attribute tailoring, all with in-scope=false, default-value-handling=NO-DEFAULT:
            category: multiplicity-restriction={severity=ERROR, lower-multiplicity=0, upper-multiplicity=1}
            domain: multiplicity-restriction={severity=ERROR, lower-multiplicity=0, upper-multiplicity=1}
            revisionLabel: multiplicity-restriction={severity=ERROR, lower-multiplicity=0, upper-multiplicity-infinite=true}
            shortLabel: multiplicity-restriction={severity=ERROR, lower-multiplicity=0, upper-multiplicity=1}
      10 x concrete class tailoring, all with in-scope=false, multiplicity-restriction={severity=INFO, lower-multiplicity=0, upper-multiplicity-infinite=true}, validation-root=false:
        Entry
          class content conditional Invariant
            attribute-tailorings:
              primitive attribute tailoring align: in-scope=false, multiplicity-restriction={severity=ERROR, lower-multiplicity=0, upper-multiplicity=1}, default-value-handling=NO-DEFAULT
              primitive attribute tailoring colname: in-scope=false, multiplicity-restriction={severity=ERROR, lower-multiplicity=0, upper-multiplicity=1}, default-value-handling=NO-DEFAULT
              primitive attribute tailoring colsep: in-scope=false, multiplicity-restriction={severity=ERROR, lower-multiplicity=0, upper-multiplicity=1}, default-value-handling=NO-DEFAULT
              aggregation tailoring entryContents: in-scope=false, multiplicity-restriction={severity=ERROR, lower-multiplicity=0, upper-multiplicity=1}
              7 x primitive attribute tailoring, all with in-scope=false, multiplicity-restriction={severity=ERROR, lower-multiplicity=0, upper-multiplicity=1}, default-value-handling=NO-DEFAULT:
                morerows
                nameend
                namest
                rotate
                rowsep
                spanname
                valign
        EthernetCluster
          class content conditional Invariant
            attribute-tailorings:
              aggregation tailoring couplingPortConnection: in-scope=false, multiplicity-restriction={severity=ERROR, lower-multiplicity=0, upper-multiplicity-infinite=true}
              aggregation tailoring macMulticastGroup: in-scope=false, multiplicity-restriction={severity=ERROR, lower-multiplicity=0, upper-multiplicity-infinite=true}
        EthernetCommunicationConnector
          class content conditional Invariant
            attribute-tailorings:
              reference tailoring networkEndpoint: in-scope=false, multiplicity-restriction={severity=ERROR, lower-multiplicity=0, upper-multiplicity-infinite=true}, unresolved-reference-restriction=severity=ERROR
        EthernetCommunicationController
          class content conditional Invariant
            attribute-tailorings:
              aggregation tailoring couplingPort: in-scope=false, multiplicity-restriction={severity=ERROR, lower-multiplicity=0, upper-multiplicity-infinite=true}
              4 x primitive attribute tailoring, all with in-scope=false, multiplicity-restriction={severity=ERROR, lower-multiplicity=0, upper-multiplicity=1}, default-value-handling=NO-DEFAULT:
                macUnicastAddress
                maximumReceiveBufferLength
                maximumTransmissionUnit
                maximumTransmitBufferLength
        EthernetFrame
          class content conditional Invariant
        EthernetFrameTriggering
          class content conditional Invariant
        EthernetPhysicalChannel
          class content conditional Invariant
            attribute-tailorings:
              aggregation tailoring networkEndpoint: in-scope=false, multiplicity-restriction={severity=ERROR, lower-multiplicity=0, upper-multiplicity-infinite=true}
              aggregation tailoring soAdConfig: in-scope=false, multiplicity-restriction={severity=ERROR, lower-multiplicity=0, upper-multiplicity=1}
              aggregation tailoring vlan: in-scope=false, multiplicity-restriction={severity=ERROR, lower-multiplicity=0, upper-multiplicity=1}
        EvaluatedVariantSet
          class content conditional Invariant
            attribute-tailorings:
              primitive attribute tailoring approvalStatus: in-scope=false, multiplicity-restriction={severity=ERROR, lower-multiplicity=0, upper-multiplicity=1}, default-value-handling=NO-DEFAULT
              reference tailoring evaluatedElement: in-scope=false, multiplicity-restriction={severity=ERROR, lower-multiplicity=0, upper-multiplicity-infinite=true}, unresolved-reference-restriction=severity=ERROR
              reference tailoring evaluatedVariant: in-scope=false, multiplicity-restriction={severity=ERROR, lower-multiplicity=0, upper-multiplicity-infinite=true}, unresolved-reference-restriction=severity=ERROR
        EventControlledTiming
          class content conditional Invariant
            attribute-tailorings:
              primitive attribute tailoring numberOfRepetitions: in-scope=false, multiplicity-restriction={severity=ERROR, lower-multiplicity=0, upper-multiplicity=1}, default-value-handling=NO-DEFAULT
              aggregation tailoring repetitionPeriod: in-scope=false, multiplicity-restriction={severity=ERROR, lower-multiplicity=0, upper-multiplicity=1}
        EventHandler
          class content conditional Invariant
            attribute-tailorings:
              reference tailoring applicationEndpoint: in-scope=false, multiplicity-restriction={severity=ERROR, lower-multiplicity=0, upper-multiplicity=1}, unresolved-reference-restriction=severity=ERROR
              reference tailoring consumedEventGroup: in-scope=false, multiplicity-restriction={severity=ERROR, lower-multiplicity=0, upper-multiplicity-infinite=true}, unresolved-reference-restriction=severity=ERROR
              primitive attribute tailoring multicastThreshold: in-scope=false, multiplicity-restriction={severity=ERROR, lower-multiplicity=0, upper-multiplicity=1}, default-value-handling=NO-DEFAULT
              reference tailoring routingGroup: in-scope=false, multiplicity-restriction={severity=ERROR, lower-multiplicity=0, upper-multiplicity-infinite=true}, unresolved-reference-restriction=severity=ERROR
              aggregation tailoring sdServerConfig: in-scope=false, multiplicity-restriction={severity=ERROR, lower-multiplicity=0, upper-multiplicity=1}
      abstract class tailoring EventTriggeringConstraint: multiplicity-restriction={severity=INFO, lower-multiplicity=0, upper-multiplicity-infinite=true}
        class content conditional Invariant
          attribute-tailorings:
            reference tailoring event: in-scope=false, multiplicity-restriction={severity=ERROR, lower-multiplicity=0, upper-multiplicity=1}, unresolved-reference-restriction=severity=ERROR
      concrete class tailoring ExclusiveArea: in-scope=false, multiplicity-restriction={severity=INFO, lower-multiplicity=0, upper-multiplicity-infinite=true}, validation-root=false
        class content conditional Invariant
      concrete class tailoring ExclusiveAreaNestingOrder: in-scope=false, multiplicity-restriction={severity=INFO, lower-multiplicity=0, upper-multiplicity-infinite=true}, validation-root=false
        class content conditional Invariant
          attribute-tailorings:
            reference tailoring exclusiveArea: in-scope=false, multiplicity-restriction={severity=ERROR, lower-multiplicity=0, upper-multiplicity-infinite=true}, unresolved-reference-restriction=severity=ERROR
      abstract class tailoring ExecutableEntity: multiplicity-restriction={severity=INFO, lower-multiplicity=0, upper-multiplicity-infinite=true}
        class content conditional Invariant
          attribute-tailorings:
            aggregation tailoring activationReason: in-scope=false, multiplicity-restriction={severity=ERROR, lower-multiplicity=0, upper-multiplicity-infinite=true}
            reference tailoring canEnterExclusiveArea: in-scope=false, multiplicity-restriction={severity=ERROR, lower-multiplicity=0, upper-multiplicity-infinite=true}, unresolved-reference-restriction=severity=ERROR
            reference tailoring exclusiveAreaNestingOrder: in-scope=false, multiplicity-restriction={severity=ERROR, lower-multiplicity=0, upper-multiplicity-infinite=true}, unresolved-reference-restriction=severity=ERROR
            primitive attribute tailoring minimumStartInterval: in-scope=false, multiplicity-restriction={severity=ERROR, lower-multiplicity=0, upper-multiplicity=1}, default-value-handling=NO-DEFAULT
            primitive attribute tailoring reentrancyLevel: in-scope=false, multiplicity-restriction={severity=ERROR, lower-multiplicity=0, upper-multiplicity=1}, default-value-handling=NO-DEFAULT
            reference tailoring runsInsideExclusiveArea: in-scope=false, multiplicity-restriction={severity=ERROR, lower-multiplicity=0, upper-multiplicity-infinite=true}, unresolved-reference-restriction=severity=ERROR
            reference tailoring swAddrMethod: in-scope=false, multiplicity-restriction={severity=ERROR, lower-multiplicity=0, upper-multiplicity=1}, unresolved-reference-restriction=severity=ERROR
      concrete class tailoring ExecutableEntityActivationReason: in-scope=false, multiplicity-restriction={severity=INFO, lower-multiplicity=0, upper-multiplicity-infinite=true}, validation-root=false
        class content conditional Invariant
          primitive attribute tailoring bitPosition: in-scope=false, multiplicity-restriction={severity=ERROR, lower-multiplicity=0, upper-multiplicity=1}, default-value-handling=NO-DEFAULT
      concrete class tailoring ExecutionOrderConstraint: in-scope=false, multiplicity-restriction={severity=INFO, lower-multiplicity=0, upper-multiplicity-infinite=true}, validation-root=false
        class content conditional Invariant
          attribute-tailorings:
            aggregation tailoring orderedElement: in-scope=false, multiplicity-restriction={severity=ERROR, lower-multiplicity=0, upper-multiplicity-infinite=true}
      abstract class tailoring ExecutionTime: multiplicity-restriction={severity=INFO, lower-multiplicity=0, upper-multiplicity-infinite=true}
        class content conditional Invariant
          attribute-tailorings:
            reference tailoring exclusiveArea: in-scope=false, multiplicity-restriction={severity=ERROR, lower-multiplicity=0, upper-multiplicity=1}, unresolved-reference-restriction=severity=ERROR
            reference tailoring executableEntity: in-scope=false, multiplicity-restriction={severity=ERROR, lower-multiplicity=0, upper-multiplicity=1}, unresolved-reference-restriction=severity=ERROR
            aggregation tailoring hardwareConfiguration: in-scope=false, multiplicity-restriction={severity=ERROR, lower-multiplicity=0, upper-multiplicity=1}
            reference tailoring hwElement: in-scope=false, multiplicity-restriction={severity=ERROR, lower-multiplicity=0, upper-multiplicity=1}, unresolved-reference-restriction=severity=ERROR
            reference tailoring includedLibrary: in-scope=false, multiplicity-restriction={severity=ERROR, lower-multiplicity=0, upper-multiplicity-infinite=true}, unresolved-reference-restriction=severity=ERROR
            aggregation tailoring memorySectionLocation: in-scope=false, multiplicity-restriction={severity=ERROR, lower-multiplicity=0, upper-multiplicity-infinite=true}
            aggregation tailoring softwareContext: in-scope=false, multiplicity-restriction={severity=ERROR, lower-multiplicity=0, upper-multiplicity=1}
      19 x concrete class tailoring, all with in-scope=false, multiplicity-restriction={severity=INFO, lower-multiplicity=0, upper-multiplicity-infinite=true}, validation-root=false:
        ExecutionTimeConstraint
          class content conditional Invariant
            attribute-tailorings:
              aggregation tailoring component: in-scope=false, multiplicity-restriction={severity=ERROR, lower-multiplicity=0, upper-multiplicity=1}
              reference tailoring executable: in-scope=false, multiplicity-restriction={severity=ERROR, lower-multiplicity=0, upper-multiplicity=1}, unresolved-reference-restriction=severity=ERROR
              primitive attribute tailoring executionTimeType: in-scope=false, multiplicity-restriction={severity=ERROR, lower-multiplicity=0, upper-multiplicity=1}, default-value-handling=NO-DEFAULT
              aggregation tailoring maximum: in-scope=false, multiplicity-restriction={severity=ERROR, lower-multiplicity=0, upper-multiplicity=1}
              aggregation tailoring minimum: in-scope=false, multiplicity-restriction={severity=ERROR, lower-multiplicity=0, upper-multiplicity=1}
        ExternalTriggerOccurredEvent
          class content conditional Invariant
            attribute-tailorings:
              aggregation tailoring trigger: in-scope=false, multiplicity-restriction={severity=ERROR, lower-multiplicity=0, upper-multiplicity=1}
        ExternalTriggeringPoint
          class content conditional Invariant
            attribute-tailorings:
              aggregation tailoring ident: in-scope=false, multiplicity-restriction={severity=ERROR, lower-multiplicity=0, upper-multiplicity=1}
              aggregation tailoring trigger: in-scope=false, multiplicity-restriction={severity=ERROR, lower-multiplicity=0, upper-multiplicity=1}
        ExternalTriggeringPointIdent
          class content conditional Invariant
        FMAttributeDef
          class content conditional Invariant
            primitive attribute tailoring defaultValue: in-scope=false, multiplicity-restriction={severity=ERROR, lower-multiplicity=0, upper-multiplicity=1}, default-value-handling=NO-DEFAULT
            primitive attribute tailoring max: in-scope=false, multiplicity-restriction={severity=ERROR, lower-multiplicity=0, upper-multiplicity=1}, default-value-handling=NO-DEFAULT
              sub-attribute-tailorings:
                primitive attribute tailoring intervalType: in-scope=false, multiplicity-restriction={severity=ERROR, lower-multiplicity=0, upper-multiplicity=1}, default-value-handling=NO-DEFAULT
            primitive attribute tailoring min: in-scope=false, multiplicity-restriction={severity=ERROR, lower-multiplicity=0, upper-multiplicity=1}, default-value-handling=NO-DEFAULT
              sub-attribute-tailorings:
                primitive attribute tailoring intervalType: in-scope=false, multiplicity-restriction={severity=ERROR, lower-multiplicity=0, upper-multiplicity=1}, default-value-handling=NO-DEFAULT
        FMAttributeValue
          class content conditional Invariant
            attribute-tailorings:
              reference tailoring definition: in-scope=false, multiplicity-restriction={severity=ERROR, lower-multiplicity=0, upper-multiplicity=1}, unresolved-reference-restriction=severity=ERROR
              primitive attribute tailoring value: in-scope=false, multiplicity-restriction={severity=ERROR, lower-multiplicity=0, upper-multiplicity=1}, default-value-handling=NO-DEFAULT
        FMConditionByFeaturesAndAttributes
          class content conditional Invariant
        FMConditionByFeaturesAndSwSystemconsts
          class content conditional Invariant
        FMFeature
          class content conditional Invariant
            attribute-tailorings:
              aggregation tailoring attributeDef: in-scope=false, multiplicity-restriction={severity=ERROR, lower-multiplicity=0, upper-multiplicity-infinite=true}
              aggregation tailoring decomposition: in-scope=false, multiplicity-restriction={severity=ERROR, lower-multiplicity=0, upper-multiplicity-infinite=true}
              primitive attribute tailoring maximumIntendedBindingTime: in-scope=false, multiplicity-restriction={severity=ERROR, lower-multiplicity=0, upper-multiplicity=1}, default-value-handling=NO-DEFAULT
              primitive attribute tailoring minimumIntendedBindingTime: in-scope=false, multiplicity-restriction={severity=ERROR, lower-multiplicity=0, upper-multiplicity=1}, default-value-handling=NO-DEFAULT
              aggregation tailoring relation: in-scope=false, multiplicity-restriction={severity=ERROR, lower-multiplicity=0, upper-multiplicity-infinite=true}
              aggregation tailoring restriction: in-scope=false, multiplicity-restriction={severity=ERROR, lower-multiplicity=0, upper-multiplicity-infinite=true}
        FMFeatureDecomposition
          class content conditional Invariant
            attribute-tailorings:
              primitive attribute tailoring category: in-scope=false, multiplicity-restriction={severity=ERROR, lower-multiplicity=0, upper-multiplicity=1}, default-value-handling=NO-DEFAULT
              reference tailoring feature: in-scope=false, multiplicity-restriction={severity=ERROR, lower-multiplicity=0, upper-multiplicity-infinite=true}, unresolved-reference-restriction=severity=ERROR
              primitive attribute tailoring max: in-scope=false, multiplicity-restriction={severity=ERROR, lower-multiplicity=0, upper-multiplicity=1}, default-value-handling=NO-DEFAULT
              primitive attribute tailoring min: in-scope=false, multiplicity-restriction={severity=ERROR, lower-multiplicity=0, upper-multiplicity=1}, default-value-handling=NO-DEFAULT
        FMFeatureMap
          class content conditional Invariant
            attribute-tailorings:
              aggregation tailoring mapping: in-scope=false, multiplicity-restriction={severity=ERROR, lower-multiplicity=0, upper-multiplicity-infinite=true}
        FMFeatureMapAssertion
          class content conditional Invariant
            attribute-tailorings:
              aggregation tailoring fmSyscond: in-scope=false, multiplicity-restriction={severity=ERROR, lower-multiplicity=0, upper-multiplicity=1}
        FMFeatureMapCondition
          class content conditional Invariant
            attribute-tailorings:
              aggregation tailoring fmCond: in-scope=false, multiplicity-restriction={severity=ERROR, lower-multiplicity=0, upper-multiplicity=1}
        FMFeatureMapElement
          class content conditional Invariant
            attribute-tailorings:
              aggregation tailoring assertion: in-scope=false, multiplicity-restriction={severity=ERROR, lower-multiplicity=0, upper-multiplicity-infinite=true}
              aggregation tailoring condition: in-scope=false, multiplicity-restriction={severity=ERROR, lower-multiplicity=0, upper-multiplicity-infinite=true}
              reference tailoring postBuildVariantCriterionValueSet: in-scope=false, multiplicity-restriction={severity=ERROR, lower-multiplicity=0, upper-multiplicity-infinite=true}, unresolved-reference-restriction=severity=ERROR
              reference tailoring swSystemconstantValueSet: in-scope=false, multiplicity-restriction={severity=ERROR, lower-multiplicity=0, upper-multiplicity-infinite=true}, unresolved-reference-restriction=severity=ERROR
        FMFeatureModel
          class content conditional Invariant
            attribute-tailorings:
              reference tailoring feature: in-scope=false, multiplicity-restriction={severity=ERROR, lower-multiplicity=0, upper-multiplicity-infinite=true}, unresolved-reference-restriction=severity=ERROR
              reference tailoring root: in-scope=false, multiplicity-restriction={severity=ERROR, lower-multiplicity=0, upper-multiplicity=1}, unresolved-reference-restriction=severity=ERROR
        FMFeatureRelation
          class content conditional Invariant
            attribute-tailorings:
              reference tailoring feature: in-scope=false, multiplicity-restriction={severity=ERROR, lower-multiplicity=0, upper-multiplicity-infinite=true}, unresolved-reference-restriction=severity=ERROR
        FMFeatureRestriction
          class content conditional Invariant
            attribute-tailorings:
              aggregation tailoring restriction: in-scope=false, multiplicity-restriction={severity=ERROR, lower-multiplicity=0, upper-multiplicity=1}
        FMFeatureSelection
          class content conditional Invariant
            attribute-tailorings:
              aggregation tailoring attributeValue: in-scope=false, multiplicity-restriction={severity=ERROR, lower-multiplicity=0, upper-multiplicity-infinite=true}
              reference tailoring feature: in-scope=false, multiplicity-restriction={severity=ERROR, lower-multiplicity=0, upper-multiplicity=1}, unresolved-reference-restriction=severity=ERROR
              primitive attribute tailoring maximumSelectedBindingTime: in-scope=false, multiplicity-restriction={severity=ERROR, lower-multiplicity=0, upper-multiplicity=1}, default-value-handling=NO-DEFAULT
              primitive attribute tailoring minimumSelectedBindingTime: in-scope=false, multiplicity-restriction={severity=ERROR, lower-multiplicity=0, upper-multiplicity=1}, default-value-handling=NO-DEFAULT
              primitive attribute tailoring state: in-scope=false, multiplicity-restriction={severity=ERROR, lower-multiplicity=0, upper-multiplicity=1}, default-value-handling=NO-DEFAULT
        FMFeatureSelectionSet
          class content conditional Invariant
            attribute-tailorings:
              reference tailoring featureModel: in-scope=false, multiplicity-restriction={severity=ERROR, lower-multiplicity=0, upper-multiplicity-infinite=true}, unresolved-reference-restriction=severity=ERROR
              reference tailoring include: in-scope=false, multiplicity-restriction={severity=ERROR, lower-multiplicity=0, upper-multiplicity-infinite=true}, unresolved-reference-restriction=severity=ERROR
              aggregation tailoring selection: in-scope=false, multiplicity-restriction={severity=ERROR, lower-multiplicity=0, upper-multiplicity-infinite=true}
      abstract class tailoring FMFormulaByFeaturesAndAttributes: multiplicity-restriction={severity=INFO, lower-multiplicity=0, upper-multiplicity-infinite=true}
        class content conditional Invariant
          attribute-tailorings:
            reference tailoring attribute: in-scope=false, multiplicity-restriction={severity=ERROR, lower-multiplicity=0, upper-multiplicity=1}, unresolved-reference-restriction=severity=ERROR
            reference tailoring feature: in-scope=false, multiplicity-restriction={severity=ERROR, lower-multiplicity=0, upper-multiplicity=1}, unresolved-reference-restriction=severity=ERROR
      abstract class tailoring FMFormulaByFeaturesAndSwSystemconsts: multiplicity-restriction={severity=INFO, lower-multiplicity=0, upper-multiplicity-infinite=true}
        class content conditional Invariant
          attribute-tailorings:
            reference tailoring feature: in-scope=false, multiplicity-restriction={severity=ERROR, lower-multiplicity=0, upper-multiplicity=1}, unresolved-reference-restriction=severity=ERROR
      concrete class tailoring FailureManagement: in-scope=false, multiplicity-restriction={severity=INFO, lower-multiplicity=0, upper-multiplicity-infinite=true}, validation-root=false
        class content conditional Invariant
      abstract class tailoring FibexElement: multiplicity-restriction={severity=INFO, lower-multiplicity=0, upper-multiplicity-infinite=true}
        class content conditional Invariant
      29 x concrete class tailoring, all with in-scope=false, multiplicity-restriction={severity=INFO, lower-multiplicity=0, upper-multiplicity-infinite=true}, validation-root=false:
        FlatInstanceDescriptor
          class content conditional Invariant
            attribute-tailorings:
              aggregation tailoring ecuExtractReference: in-scope=false, multiplicity-restriction={severity=ERROR, lower-multiplicity=0, upper-multiplicity=1}
              primitive attribute tailoring role: in-scope=false, multiplicity-restriction={severity=ERROR, lower-multiplicity=0, upper-multiplicity=1}, default-value-handling=NO-DEFAULT
                sub-attribute-tailorings:
                  primitive attribute tailoring namePattern: in-scope=false, multiplicity-restriction={severity=ERROR, lower-multiplicity=0, upper-multiplicity=1}, default-value-handling=NO-DEFAULT
              aggregation tailoring swDataDefProps: in-scope=false, multiplicity-restriction={severity=ERROR, lower-multiplicity=0, upper-multiplicity=1}
              aggregation tailoring upstreamReference: in-scope=false, multiplicity-restriction={severity=ERROR, lower-multiplicity=0, upper-multiplicity=1}
        FlatMap
          class content conditional Invariant
            attribute-tailorings:
              aggregation tailoring instance: in-scope=false, multiplicity-restriction={severity=ERROR, lower-multiplicity=0, upper-multiplicity-infinite=true}, variation-restriction={severity=ERROR, variation=true, valid-binding-times=[BLUEPRINT-DERIVATION-TIME, SYSTEM-DESIGN-TIME, CODE-GENERATION-TIME, PRE-COMPILE-TIME, LINK-TIME, POST-BUILD]}
        FlexrayAbsolutelyScheduledTiming
          class content conditional Invariant
            attribute-tailorings:
              aggregation tailoring communicationCycle: in-scope=false, multiplicity-restriction={severity=ERROR, lower-multiplicity=0, upper-multiplicity=1}
              primitive attribute tailoring slotID: in-scope=false, multiplicity-restriction={severity=ERROR, lower-multiplicity=0, upper-multiplicity=1}, default-value-handling=NO-DEFAULT
        FlexrayArTpChannel
          class content conditional Invariant
            attribute-tailorings:
              primitive attribute tailoring ackType: in-scope=false, multiplicity-restriction={severity=ERROR, lower-multiplicity=0, upper-multiplicity=1}, default-value-handling=NO-DEFAULT
              primitive attribute tailoring cancellation: in-scope=false, multiplicity-restriction={severity=ERROR, lower-multiplicity=0, upper-multiplicity=1}, default-value-handling=NO-DEFAULT
              primitive attribute tailoring extendedAddressing: in-scope=false, multiplicity-restriction={severity=ERROR, lower-multiplicity=0, upper-multiplicity=1}, default-value-handling=NO-DEFAULT
              reference tailoring flowControlPdu: in-scope=false, multiplicity-restriction={severity=ERROR, lower-multiplicity=0, upper-multiplicity=1}, unresolved-reference-restriction=severity=ERROR
              11 x primitive attribute tailoring, all with in-scope=false, default-value-handling=NO-DEFAULT:
                maxAr: multiplicity-restriction={severity=ERROR, lower-multiplicity=0, upper-multiplicity=1}
                maxAs: multiplicity-restriction={severity=ERROR, lower-multiplicity=0, upper-multiplicity=1}
                maxBs: multiplicity-restriction={severity=ERROR, lower-multiplicity=0, upper-multiplicity=1}
                maxBufferRequest: multiplicity-restriction={severity=WARNING, lower-multiplicity=0, upper-multiplicity=0}  # Spec element has lifecycle state 'obsolete'.
                maxFcWait: multiplicity-restriction={severity=ERROR, lower-multiplicity=0, upper-multiplicity=1}
                maxFrIf: multiplicity-restriction={severity=WARNING, lower-multiplicity=0, upper-multiplicity=0}  # Spec element has lifecycle state 'obsolete' since 4.1.2.
                maxRetries: multiplicity-restriction={severity=ERROR, lower-multiplicity=0, upper-multiplicity=1}
                maximumMessageLength: multiplicity-restriction={severity=ERROR, lower-multiplicity=0, upper-multiplicity=1}
                minimumMulticastSeperationTime: multiplicity-restriction={severity=ERROR, lower-multiplicity=0, upper-multiplicity=1}
                minimumSeparationTime: multiplicity-restriction={severity=ERROR, lower-multiplicity=0, upper-multiplicity=1}
                multicastSegmentation: multiplicity-restriction={severity=ERROR, lower-multiplicity=0, upper-multiplicity=1}
              reference tailoring nPdu: in-scope=false, multiplicity-restriction={severity=ERROR, lower-multiplicity=0, upper-multiplicity-infinite=true}, unresolved-reference-restriction=severity=ERROR
              aggregation tailoring pduPool: in-scope=false, multiplicity-restriction={severity=ERROR, lower-multiplicity=0, upper-multiplicity-infinite=true}
              8 x primitive attribute tailoring, all with in-scope=false, default-value-handling=NO-DEFAULT:
                timeBr: multiplicity-restriction={severity=ERROR, lower-multiplicity=0, upper-multiplicity=1}
                timeBuffer: multiplicity-restriction={severity=WARNING, lower-multiplicity=0, upper-multiplicity=0}  # Spec element has lifecycle state 'obsolete'.
                timeCs: multiplicity-restriction={severity=ERROR, lower-multiplicity=0, upper-multiplicity=1}
                timeFrIf: multiplicity-restriction={severity=WARNING, lower-multiplicity=0, upper-multiplicity=0}  # Spec element has lifecycle state 'obsolete' since 4.1.2.
                timeoutAr: multiplicity-restriction={severity=ERROR, lower-multiplicity=0, upper-multiplicity=1}
                timeoutAs: multiplicity-restriction={severity=ERROR, lower-multiplicity=0, upper-multiplicity=1}
                timeoutBs: multiplicity-restriction={severity=ERROR, lower-multiplicity=0, upper-multiplicity=1}
                timeoutCr: multiplicity-restriction={severity=ERROR, lower-multiplicity=0, upper-multiplicity=1}
              aggregation tailoring tpConnection: in-scope=false, multiplicity-restriction={severity=ERROR, lower-multiplicity=0, upper-multiplicity-infinite=true}
              primitive attribute tailoring transmitCancellation: in-scope=false, multiplicity-restriction={severity=WARNING, lower-multiplicity=0, upper-multiplicity=0}, default-value-handling=NO-DEFAULT  # Spec element has lifecycle state 'obsolete' since 4.1.3. Replaced by FrArTpChannel.cancellation.
        FlexrayArTpConfig
          class content conditional Invariant
            attribute-tailorings:
              aggregation tailoring tpAddress: in-scope=false, multiplicity-restriction={severity=ERROR, lower-multiplicity=0, upper-multiplicity-infinite=true}, variation-restriction={severity=ERROR, variation=true, valid-binding-times=[BLUEPRINT-DERIVATION-TIME, SYSTEM-DESIGN-TIME, CODE-GENERATION-TIME, PRE-COMPILE-TIME, LINK-TIME, POST-BUILD]}
              aggregation tailoring tpChannel: in-scope=false, multiplicity-restriction={severity=ERROR, lower-multiplicity=0, upper-multiplicity-infinite=true}, variation-restriction={severity=ERROR, variation=true, valid-binding-times=[BLUEPRINT-DERIVATION-TIME, SYSTEM-DESIGN-TIME, CODE-GENERATION-TIME, PRE-COMPILE-TIME, LINK-TIME, POST-BUILD]}
              aggregation tailoring tpNode: in-scope=false, multiplicity-restriction={severity=ERROR, lower-multiplicity=0, upper-multiplicity-infinite=true}, variation-restriction={severity=ERROR, variation=true, valid-binding-times=[BLUEPRINT-DERIVATION-TIME, SYSTEM-DESIGN-TIME, CODE-GENERATION-TIME, PRE-COMPILE-TIME, LINK-TIME, POST-BUILD]}
        FlexrayArTpConnection
          class content conditional Invariant
            attribute-tailorings:
              primitive attribute tailoring connectionPrioPdus: in-scope=false, multiplicity-restriction={severity=ERROR, lower-multiplicity=0, upper-multiplicity=1}, default-value-handling=NO-DEFAULT
              7 x reference tailoring, all with in-scope=false, unresolved-reference-restriction=severity=ERROR:
                directTpSdu: multiplicity-restriction={severity=ERROR, lower-multiplicity=0, upper-multiplicity=1}
                flowControlPdu: multiplicity-restriction={severity=ERROR, lower-multiplicity=0, upper-multiplicity=1}
                multicast: multiplicity-restriction={severity=ERROR, lower-multiplicity=0, upper-multiplicity=1}
                reversedTpSdu: multiplicity-restriction={severity=ERROR, lower-multiplicity=0, upper-multiplicity=1}
                source: multiplicity-restriction={severity=ERROR, lower-multiplicity=0, upper-multiplicity=1}
                target: multiplicity-restriction={severity=ERROR, lower-multiplicity=0, upper-multiplicity-infinite=true}
                transmitPdu: multiplicity-restriction={severity=ERROR, lower-multiplicity=0, upper-multiplicity-infinite=true}
        FlexrayArTpNode
          class content conditional Invariant
            attribute-tailorings:
              reference tailoring connector: in-scope=false, multiplicity-restriction={severity=ERROR, lower-multiplicity=0, upper-multiplicity-infinite=true}, unresolved-reference-restriction=severity=ERROR
              reference tailoring tpAddress: in-scope=false, multiplicity-restriction={severity=ERROR, lower-multiplicity=0, upper-multiplicity=1}, unresolved-reference-restriction=severity=ERROR
        FlexrayCluster
          class content conditional Invariant
            35 x primitive attribute tailoring, all with in-scope=false, multiplicity-restriction={severity=ERROR, lower-multiplicity=0, upper-multiplicity=1}, default-value-handling=NO-DEFAULT:
              actionPointOffset
              bit
              casRxLowMax
              coldStartAttempts
              cycle
              cycleCountMax
              detectNitError
              dynamicSlotIdlePhase
              ignoreAfterTx
              listenNoise
              macroPerCycle
              macrotickDuration
              maxWithoutClockCorrectionFatal
              maxWithoutClockCorrectionPassive
              minislotActionPointOffset
              minislotDuration
              networkIdleTime
              networkManagementVectorLength
              numberOfMinislots
              numberOfStaticSlots
              offsetCorrectionStart
              payloadLengthStatic
              safetyMargin
              sampleClockPeriod
              staticSlotDuration
              symbolWindow
              symbolWindowActionPointOffset
              syncFrameIdCountMax
              tranceiverStandbyDelay
              transmissionStartSequenceDuration
              wakeupRxIdle
              wakeupRxLow
              wakeupRxWindow
              wakeupTxActive
              wakeupTxIdle
        FlexrayCommunicationConnector
          class content conditional Invariant
            primitive attribute tailoring nmReadySleepTime: in-scope=false, multiplicity-restriction={severity=ERROR, lower-multiplicity=0, upper-multiplicity=1}, default-value-handling=NO-DEFAULT
            primitive attribute tailoring pncFilterDataMask: in-scope=false, multiplicity-restriction={severity=ERROR, lower-multiplicity=0, upper-multiplicity=1}, default-value-handling=NO-DEFAULT
            primitive attribute tailoring wakeUpChannel: in-scope=false, multiplicity-restriction={severity=ERROR, lower-multiplicity=0, upper-multiplicity=1}, default-value-handling=NO-DEFAULT
        FlexrayCommunicationController
          class content conditional Invariant
            attribute-tailorings:
              11 x primitive attribute tailoring, all with in-scope=false, multiplicity-restriction={severity=ERROR, lower-multiplicity=0, upper-multiplicity=1}, default-value-handling=NO-DEFAULT:
                acceptedStartupRange
                allowHaltDueToClock
                allowPassiveToActive
                clusterDriftDamping
                decodingCorrection
                delayCompensationA
                delayCompensationB
                externOffsetCorrection
                externRateCorrection
                externalSync
                fallBackInternal
              aggregation tailoring flexrayFifo: in-scope=false, multiplicity-restriction={severity=ERROR, lower-multiplicity=0, upper-multiplicity-infinite=true}
              20 x primitive attribute tailoring, all with in-scope=false, multiplicity-restriction={severity=ERROR, lower-multiplicity=0, upper-multiplicity=1}, default-value-handling=NO-DEFAULT:
                keySlotID
                keySlotOnlyEnabled
                keySlotUsedForStartUp
                keySlotUsedForSync
                latestTX
                listenTimeout
                macroInitialOffsetA
                macroInitialOffsetB
                maximumDynamicPayloadLength
                microInitialOffsetA
                microInitialOffsetB
                microPerCycle
                microtickDuration
                nmVectorEarlyUpdate
                offsetCorrectionOut
                rateCorrectionOut
                samplesPerMicrotick
                secondKeySlotId
                twoKeySlotMode
                wakeUpPattern
        FlexrayFifoConfiguration
          class content conditional Invariant
            attribute-tailorings:
              primitive attribute tailoring admitWithoutMessageId: in-scope=false, multiplicity-restriction={severity=ERROR, lower-multiplicity=0, upper-multiplicity=1}, default-value-handling=NO-DEFAULT
              primitive attribute tailoring baseCycle: in-scope=false, multiplicity-restriction={severity=ERROR, lower-multiplicity=0, upper-multiplicity=1}, default-value-handling=NO-DEFAULT
              reference tailoring channel: in-scope=false, multiplicity-restriction={severity=ERROR, lower-multiplicity=0, upper-multiplicity=1}, unresolved-reference-restriction=severity=ERROR
              primitive attribute tailoring cycleRepetition: in-scope=false, multiplicity-restriction={severity=ERROR, lower-multiplicity=0, upper-multiplicity=1}, default-value-handling=NO-DEFAULT
              primitive attribute tailoring fifoDepth: in-scope=false, multiplicity-restriction={severity=ERROR, lower-multiplicity=0, upper-multiplicity=1}, default-value-handling=NO-DEFAULT
              aggregation tailoring fifoRange: in-scope=false, multiplicity-restriction={severity=ERROR, lower-multiplicity=0, upper-multiplicity-infinite=true}
              primitive attribute tailoring msgIdMask: in-scope=false, multiplicity-restriction={severity=ERROR, lower-multiplicity=0, upper-multiplicity=1}, default-value-handling=NO-DEFAULT
              primitive attribute tailoring msgIdMatch: in-scope=false, multiplicity-restriction={severity=ERROR, lower-multiplicity=0, upper-multiplicity=1}, default-value-handling=NO-DEFAULT
        FlexrayFifoRange
          class content conditional Invariant
            primitive attribute tailoring rangeMax: in-scope=false, multiplicity-restriction={severity=ERROR, lower-multiplicity=0, upper-multiplicity=1}, default-value-handling=NO-DEFAULT
            primitive attribute tailoring rangeMin: in-scope=false, multiplicity-restriction={severity=ERROR, lower-multiplicity=0, upper-multiplicity=1}, default-value-handling=NO-DEFAULT
        FlexrayFrame
          class content conditional Invariant
        FlexrayFrameTriggering
          class content conditional Invariant
            attribute-tailorings:
              aggregation tailoring absolutelyScheduledTiming: in-scope=false, multiplicity-restriction={severity=ERROR, lower-multiplicity=0, upper-multiplicity-infinite=true}
              primitive attribute tailoring allowDynamicLSduLength: in-scope=false, multiplicity-restriction={severity=ERROR, lower-multiplicity=0, upper-multiplicity=1}, default-value-handling=NO-DEFAULT
              primitive attribute tailoring messageId: in-scope=false, multiplicity-restriction={severity=ERROR, lower-multiplicity=0, upper-multiplicity=1}, default-value-handling=NO-DEFAULT
              primitive attribute tailoring payloadPreambleIndicator: in-scope=false, multiplicity-restriction={severity=ERROR, lower-multiplicity=0, upper-multiplicity=1}, default-value-handling=NO-DEFAULT
        FlexrayNmCluster
          class content conditional Invariant
            16 x primitive attribute tailoring, all with in-scope=false, default-value-handling=NO-DEFAULT:
              nmCarWakeUpBitPosition: multiplicity-restriction={severity=ERROR, lower-multiplicity=0, upper-multiplicity=1}
              nmCarWakeUpFilterEnabled: multiplicity-restriction={severity=ERROR, lower-multiplicity=0, upper-multiplicity=1}
              nmCarWakeUpFilterNodeId: multiplicity-restriction={severity=ERROR, lower-multiplicity=0, upper-multiplicity=1}
              nmCarWakeUpRxEnabled: multiplicity-restriction={severity=ERROR, lower-multiplicity=0, upper-multiplicity=1}
              nmControlBitVectorActive: multiplicity-restriction={severity=ERROR, lower-multiplicity=0, upper-multiplicity=1}
              nmDataCycle: multiplicity-restriction={severity=ERROR, lower-multiplicity=0, upper-multiplicity=1}
              nmDataEnabled: multiplicity-restriction={severity=ERROR, lower-multiplicity=0, upper-multiplicity=1}
              nmDetectionLock: multiplicity-restriction={severity=ERROR, lower-multiplicity=0, upper-multiplicity=1}
              nmMainFunctionPeriod: multiplicity-restriction={severity=ERROR, lower-multiplicity=0, upper-multiplicity=1}
              nmMessageTimeoutTime: multiplicity-restriction={severity=ERROR, lower-multiplicity=0, upper-multiplicity=1}
              nmReadySleepCount: multiplicity-restriction={severity=WARNING, lower-multiplicity=0, upper-multiplicity=0}  # Spec element has lifecycle state 'obsolete'.
              nmRemoteSleepIndicationTime: multiplicity-restriction={severity=ERROR, lower-multiplicity=0, upper-multiplicity=1}
              nmRepeatMessageBitActive: multiplicity-restriction={severity=ERROR, lower-multiplicity=0, upper-multiplicity=1}
              nmRepeatMessageTime: multiplicity-restriction={severity=ERROR, lower-multiplicity=0, upper-multiplicity=1}
              nmRepetitionCycle: multiplicity-restriction={severity=ERROR, lower-multiplicity=0, upper-multiplicity=1}
              nmVotingCycle: multiplicity-restriction={severity=ERROR, lower-multiplicity=0, upper-multiplicity=1}
        FlexrayNmClusterCoupling
          class content conditional Invariant
            attribute-tailorings:
              reference tailoring coupledCluster: in-scope=false, multiplicity-restriction={severity=ERROR, lower-multiplicity=0, upper-multiplicity-infinite=true}, unresolved-reference-restriction=severity=ERROR
              primitive attribute tailoring nmControlBitVectorEnabled: in-scope=false, multiplicity-restriction={severity=ERROR, lower-multiplicity=0, upper-multiplicity=1}, default-value-handling=NO-DEFAULT
              primitive attribute tailoring nmDataDisabled: in-scope=false, multiplicity-restriction={severity=ERROR, lower-multiplicity=0, upper-multiplicity=1}, default-value-handling=NO-DEFAULT
              primitive attribute tailoring nmScheduleVariant: in-scope=false, multiplicity-restriction={severity=ERROR, lower-multiplicity=0, upper-multiplicity=1}, default-value-handling=NO-DEFAULT
        FlexrayNmEcu
          class content conditional Invariant
            primitive attribute tailoring nmHwVoteEnabled: in-scope=false, multiplicity-restriction={severity=ERROR, lower-multiplicity=0, upper-multiplicity=1}, default-value-handling=NO-DEFAULT
            primitive attribute tailoring nmMainFunctionAcrossFrCycle: in-scope=false, multiplicity-restriction={severity=ERROR, lower-multiplicity=0, upper-multiplicity=1}, default-value-handling=NO-DEFAULT
            primitive attribute tailoring nmRepeatMessageBitEnable: in-scope=false, multiplicity-restriction={severity=ERROR, lower-multiplicity=0, upper-multiplicity=1}, default-value-handling=NO-DEFAULT
        FlexrayNmNode
          class content conditional Invariant
            primitive attribute tailoring nmInstanceId: in-scope=false, multiplicity-restriction={severity=ERROR, lower-multiplicity=0, upper-multiplicity=1}, default-value-handling=NO-DEFAULT
        FlexrayPhysicalChannel
          class content conditional Invariant
            primitive attribute tailoring channelName: in-scope=false, multiplicity-restriction={severity=ERROR, lower-multiplicity=0, upper-multiplicity=1}, default-value-handling=NO-DEFAULT
        FlexrayTpConfig
          class content conditional Invariant
            attribute-tailorings:
              6 x aggregation tailoring, all with in-scope=false, multiplicity-restriction={severity=ERROR, lower-multiplicity=0, upper-multiplicity-infinite=true}, variation-restriction={severity=ERROR, variation=true, valid-binding-times=[BLUEPRINT-DERIVATION-TIME, SYSTEM-DESIGN-TIME, CODE-GENERATION-TIME, PRE-COMPILE-TIME, LINK-TIME, POST-BUILD]}:
                pduPool
                tpAddress
                tpConnection
                tpConnectionControl
                tpEcu
                tpNode
        FlexrayTpConnection
          class content conditional Invariant
            attribute-tailorings:
              primitive attribute tailoring bandwidthLimitation: in-scope=false, multiplicity-restriction={severity=ERROR, lower-multiplicity=0, upper-multiplicity=1}, default-value-handling=NO-DEFAULT
              8 x reference tailoring, all with in-scope=false, unresolved-reference-restriction=severity=ERROR:
                directTpSdu: multiplicity-restriction={severity=ERROR, lower-multiplicity=0, upper-multiplicity=1}
                multicast: multiplicity-restriction={severity=ERROR, lower-multiplicity=0, upper-multiplicity=1}
                receiver: multiplicity-restriction={severity=ERROR, lower-multiplicity=0, upper-multiplicity-infinite=true}
                reversedTpSdu: multiplicity-restriction={severity=ERROR, lower-multiplicity=0, upper-multiplicity=1}
                rxPduPool: multiplicity-restriction={severity=ERROR, lower-multiplicity=0, upper-multiplicity=1}
                tpConnectionControl: multiplicity-restriction={severity=ERROR, lower-multiplicity=0, upper-multiplicity=1}
                transmitter: multiplicity-restriction={severity=ERROR, lower-multiplicity=0, upper-multiplicity=1}
                txPduPool: multiplicity-restriction={severity=ERROR, lower-multiplicity=0, upper-multiplicity=1}
        FlexrayTpConnectionControl
          class content conditional Invariant
            16 x primitive attribute tailoring, all with in-scope=false, multiplicity-restriction={severity=ERROR, lower-multiplicity=0, upper-multiplicity=1}, default-value-handling=NO-DEFAULT:
              ackType
              maxAr
              maxAs
              maxBufferSize
              maxFcWait
              maxFrIf
              maxNumberOfNpduPerCycle
              maxRetries
              separationCycleExponent
              timeBr
              timeBuffer
              timeFrIf
              timeoutAr
              timeoutAs
              timeoutBs
              timeoutCr
        FlexrayTpEcu
          class content conditional Invariant
            attribute-tailorings:
              primitive attribute tailoring cancellation: in-scope=false, multiplicity-restriction={severity=ERROR, lower-multiplicity=0, upper-multiplicity=1}, default-value-handling=NO-DEFAULT
              primitive attribute tailoring cycleTimeMainFunction: in-scope=false, multiplicity-restriction={severity=ERROR, lower-multiplicity=0, upper-multiplicity=1}, default-value-handling=NO-DEFAULT
              reference tailoring ecuInstance: in-scope=false, multiplicity-restriction={severity=ERROR, lower-multiplicity=0, upper-multiplicity=1}, unresolved-reference-restriction=severity=ERROR
              primitive attribute tailoring fullDuplexEnabled: in-scope=false, multiplicity-restriction={severity=ERROR, lower-multiplicity=0, upper-multiplicity=1}, default-value-handling=NO-DEFAULT
              primitive attribute tailoring transmitCancellation: in-scope=false, multiplicity-restriction={severity=WARNING, lower-multiplicity=0, upper-multiplicity=0}, default-value-handling=NO-DEFAULT  # Spec element has lifecycle state 'obsolete' since 4.1.3. Replaced by FlexrayTpEcu.cancellation.
        FlexrayTpNode
          class content conditional Invariant
            attribute-tailorings:
              reference tailoring connector: in-scope=false, multiplicity-restriction={severity=ERROR, lower-multiplicity=0, upper-multiplicity-infinite=true}, unresolved-reference-restriction=severity=ERROR
              reference tailoring tpAddress: in-scope=false, multiplicity-restriction={severity=ERROR, lower-multiplicity=0, upper-multiplicity=1}, unresolved-reference-restriction=severity=ERROR
        FlexrayTpPduPool
          class content conditional Invariant
            attribute-tailorings:
              reference tailoring nPdu: in-scope=false, multiplicity-restriction={severity=ERROR, lower-multiplicity=0, upper-multiplicity-infinite=true}, unresolved-reference-restriction=severity=ERROR
        FloatValueVariationPoint
          class content conditional Invariant
        FootnoteText
          class content conditional Invariant
            attribute-tailorings:
              aggregation tailoring e: in-scope=false, multiplicity-restriction={severity=ERROR, lower-multiplicity=0, upper-multiplicity-infinite=true}  # Multiplicity is 0..* since attribute is contained in mixed / mixedString class.
              primitive attribute tailoring sub: in-scope=false, multiplicity-restriction={severity=ERROR, lower-multiplicity=0, upper-multiplicity-infinite=true}, default-value-handling=NO-DEFAULT  # Multiplicity is 0..* since attribute is contained in mixed / mixedString class.
              primitive attribute tailoring sup: in-scope=false, multiplicity-restriction={severity=ERROR, lower-multiplicity=0, upper-multiplicity-infinite=true}, default-value-handling=NO-DEFAULT  # Multiplicity is 0..* since attribute is contained in mixed / mixedString class.
              aggregation tailoring tt: in-scope=false, multiplicity-restriction={severity=ERROR, lower-multiplicity=0, upper-multiplicity-infinite=true}  # Multiplicity is 0..* since attribute is contained in mixed / mixedString class.
        ForbiddenSignalPath
          class content conditional Invariant
            attribute-tailorings:
              aggregation tailoring operation: in-scope=false, multiplicity-restriction={severity=ERROR, lower-multiplicity=0, upper-multiplicity-infinite=true}
              reference tailoring physicalChannel: in-scope=false, multiplicity-restriction={severity=ERROR, lower-multiplicity=0, upper-multiplicity-infinite=true}, unresolved-reference-restriction=severity=ERROR
              aggregation tailoring signal: in-scope=false, multiplicity-restriction={severity=ERROR, lower-multiplicity=0, upper-multiplicity-infinite=true}
        ForeignModelReference
          class content conditional Invariant
            primitive attribute tailoring base: in-scope=false, multiplicity-restriction={severity=ERROR, lower-multiplicity=0, upper-multiplicity=1}, default-value-handling=NO-DEFAULT
            primitive attribute tailoring dest: in-scope=false, multiplicity-restriction={severity=ERROR, lower-multiplicity=0, upper-multiplicity=1}, default-value-handling=NO-DEFAULT
            primitive attribute tailoring ref: in-scope=false, multiplicity-restriction={severity=ERROR, lower-multiplicity=0, upper-multiplicity=1}, default-value-handling=NO-DEFAULT
              sub-attribute-tailorings:
                primitive attribute tailoring base: in-scope=false, multiplicity-restriction={severity=ERROR, lower-multiplicity=0, upper-multiplicity=1}, default-value-handling=NO-DEFAULT
                primitive attribute tailoring index: in-scope=false, multiplicity-restriction={severity=ERROR, lower-multiplicity=0, upper-multiplicity=1}, default-value-handling=NO-DEFAULT
      abstract class tailoring FormulaExpression: multiplicity-restriction={severity=INFO, lower-multiplicity=0, upper-multiplicity-infinite=true}
        class content conditional Invariant
      abstract class tailoring Frame: multiplicity-restriction={severity=INFO, lower-multiplicity=0, upper-multiplicity-infinite=true}
        class content conditional Invariant
          attribute-tailorings:
            primitive attribute tailoring frameLength: in-scope=false, multiplicity-restriction={severity=ERROR, lower-multiplicity=0, upper-multiplicity=1}, default-value-handling=NO-DEFAULT
            aggregation tailoring pduToFrameMapping: in-scope=false, multiplicity-restriction={severity=ERROR, lower-multiplicity=0, upper-multiplicity-infinite=true}, variation-restriction={severity=ERROR, variation=true, valid-binding-times=[BLUEPRINT-DERIVATION-TIME, SYSTEM-DESIGN-TIME, CODE-GENERATION-TIME, PRE-COMPILE-TIME, LINK-TIME, POST-BUILD]}
      concrete class tailoring FrameMapping: in-scope=false, multiplicity-restriction={severity=INFO, lower-multiplicity=0, upper-multiplicity-infinite=true}, validation-root=false
        class content conditional Invariant
          attribute-tailorings:
            aggregation tailoring introduction: in-scope=false, multiplicity-restriction={severity=ERROR, lower-multiplicity=0, upper-multiplicity=1}
            reference tailoring sourceFrame: in-scope=false, multiplicity-restriction={severity=ERROR, lower-multiplicity=0, upper-multiplicity=1}, unresolved-reference-restriction=severity=ERROR
            reference tailoring targetFrame: in-scope=false, multiplicity-restriction={severity=ERROR, lower-multiplicity=0, upper-multiplicity=1}, unresolved-reference-restriction=severity=ERROR
      concrete class tailoring FramePid: in-scope=false, multiplicity-restriction={severity=INFO, lower-multiplicity=0, upper-multiplicity-infinite=true}, validation-root=false
        class content conditional Invariant
          primitive attribute tailoring index: in-scope=false, multiplicity-restriction={severity=ERROR, lower-multiplicity=0, upper-multiplicity=1}, default-value-handling=NO-DEFAULT
          primitive attribute tailoring pid: in-scope=false, multiplicity-restriction={severity=ERROR, lower-multiplicity=0, upper-multiplicity=1}, default-value-handling=NO-DEFAULT
      concrete class tailoring FramePort: in-scope=false, multiplicity-restriction={severity=INFO, lower-multiplicity=0, upper-multiplicity-infinite=true}, validation-root=false
        class content conditional Invariant
      abstract class tailoring FrameTriggering: multiplicity-restriction={severity=INFO, lower-multiplicity=0, upper-multiplicity-infinite=true}
        class content conditional Invariant
          attribute-tailorings:
            reference tailoring frame: in-scope=false, multiplicity-restriction={severity=ERROR, lower-multiplicity=0, upper-multiplicity=1}, unresolved-reference-restriction=severity=ERROR
            reference tailoring framePort: in-scope=false, multiplicity-restriction={severity=ERROR, lower-multiplicity=0, upper-multiplicity-infinite=true}, unresolved-reference-restriction=severity=ERROR
            reference tailoring pduTriggering: in-scope=false, multiplicity-restriction={severity=ERROR, lower-multiplicity=0, upper-multiplicity-infinite=true}, variation-restriction={severity=ERROR, variation=true, valid-binding-times=[BLUEPRINT-DERIVATION-TIME, SYSTEM-DESIGN-TIME, CODE-GENERATION-TIME, PRE-COMPILE-TIME, LINK-TIME, POST-BUILD]}, unresolved-reference-restriction=severity=ERROR
      concrete class tailoring FreeFormat: in-scope=false, multiplicity-restriction={severity=INFO, lower-multiplicity=0, upper-multiplicity-infinite=true}, validation-root=false
        class content conditional Invariant
          primitive attribute tailoring byteValue: in-scope=false, multiplicity-restriction={severity=ERROR, lower-multiplicity=0, upper-multiplicity=8}, default-value-handling=NO-DEFAULT
      abstract class tailoring FreeFormatEntry: multiplicity-restriction={severity=INFO, lower-multiplicity=0, upper-multiplicity-infinite=true}
        class content conditional Invariant
      concrete class tailoring FunctionInhibitionNeeds: in-scope=false, multiplicity-restriction={severity=INFO, lower-multiplicity=0, upper-multiplicity-infinite=true}, validation-root=false
        class content conditional Invariant
      concrete class tailoring FunctionalRequirements: in-scope=false, multiplicity-restriction={severity=INFO, lower-multiplicity=0, upper-multiplicity-infinite=true}, validation-root=false
        class content conditional Invariant
      concrete class tailoring Gateway: in-scope=false, multiplicity-restriction={severity=INFO, lower-multiplicity=0, upper-multiplicity-infinite=true}, validation-root=false
        class content conditional Invariant
          attribute-tailorings:
            reference tailoring ecu: in-scope=false, multiplicity-restriction={severity=ERROR, lower-multiplicity=0, upper-multiplicity=1}, unresolved-reference-restriction=severity=ERROR
            aggregation tailoring frameMapping: in-scope=false, multiplicity-restriction={severity=ERROR, lower-multiplicity=0, upper-multiplicity-infinite=true}, variation-restriction={severity=ERROR, variation=true, valid-binding-times=[BLUEPRINT-DERIVATION-TIME, SYSTEM-DESIGN-TIME, CODE-GENERATION-TIME, PRE-COMPILE-TIME, LINK-TIME, POST-BUILD]}
            aggregation tailoring iPduMapping: in-scope=false, multiplicity-restriction={severity=ERROR, lower-multiplicity=0, upper-multiplicity-infinite=true}, variation-restriction={severity=ERROR, variation=true, valid-binding-times=[BLUEPRINT-DERIVATION-TIME, SYSTEM-DESIGN-TIME, CODE-GENERATION-TIME, PRE-COMPILE-TIME, LINK-TIME, POST-BUILD]}
            aggregation tailoring signalMapping: in-scope=false, multiplicity-restriction={severity=ERROR, lower-multiplicity=0, upper-multiplicity-infinite=true}, variation-restriction={severity=ERROR, variation=true, valid-binding-times=[BLUEPRINT-DERIVATION-TIME, SYSTEM-DESIGN-TIME, CODE-GENERATION-TIME, PRE-COMPILE-TIME, LINK-TIME, POST-BUILD]}
      abstract class tailoring GeneralAnnotation: multiplicity-restriction={severity=INFO, lower-multiplicity=0, upper-multiplicity-infinite=true}
        class content conditional Invariant
          attribute-tailorings:
            primitive attribute tailoring annotationOrigin: in-scope=false, multiplicity-restriction={severity=ERROR, lower-multiplicity=0, upper-multiplicity=1}, default-value-handling=NO-DEFAULT
            aggregation tailoring annotationText: in-scope=false, multiplicity-restriction={severity=ERROR, lower-multiplicity=0, upper-multiplicity=1}
            aggregation tailoring label: in-scope=false, multiplicity-restriction={severity=ERROR, lower-multiplicity=0, upper-multiplicity=1}
      13 x concrete class tailoring, all with in-scope=false, multiplicity-restriction={severity=INFO, lower-multiplicity=0, upper-multiplicity-infinite=true}, validation-root=false:
        GeneralHardware
          class content conditional Invariant
        GeneralInterfaces
          class content conditional Invariant
        GeneralParameter
          class content conditional Invariant
            attribute-tailorings:
              aggregation tailoring prmChar: in-scope=false, multiplicity-restriction={severity=ERROR, lower-multiplicity=0, upper-multiplicity-infinite=true}
        GeneralProductData1
          class content conditional Invariant
        GeneralProjectData
          class content conditional Invariant
        GeneralPurposeIPdu
          class content conditional Invariant
        GeneralPurposePdu
          class content conditional Invariant
        GeneralRequirements
          class content conditional Invariant
        GeneralSoftware
          class content conditional Invariant
        GenericModelReference
          class content conditional Invariant
            primitive attribute tailoring base: in-scope=false, multiplicity-restriction={severity=ERROR, lower-multiplicity=0, upper-multiplicity=1}, default-value-handling=NO-DEFAULT
            primitive attribute tailoring dest: in-scope=false, multiplicity-restriction={severity=ERROR, lower-multiplicity=0, upper-multiplicity=1}, default-value-handling=NO-DEFAULT
            primitive attribute tailoring ref: in-scope=false, multiplicity-restriction={severity=ERROR, lower-multiplicity=0, upper-multiplicity=1}, default-value-handling=NO-DEFAULT
              sub-attribute-tailorings:
                primitive attribute tailoring base: in-scope=false, multiplicity-restriction={severity=ERROR, lower-multiplicity=0, upper-multiplicity=1}, default-value-handling=NO-DEFAULT
                primitive attribute tailoring index: in-scope=false, multiplicity-restriction={severity=ERROR, lower-multiplicity=0, upper-multiplicity=1}, default-value-handling=NO-DEFAULT
        GenericTp
          class content conditional Invariant
            primitive attribute tailoring tpAddress: in-scope=false, multiplicity-restriction={severity=ERROR, lower-multiplicity=0, upper-multiplicity=1}, default-value-handling=NO-DEFAULT
            primitive attribute tailoring tpTechnology: in-scope=false, multiplicity-restriction={severity=ERROR, lower-multiplicity=0, upper-multiplicity=1}, default-value-handling=NO-DEFAULT
        Graphic
          class content conditional Invariant
            15 x primitive attribute tailoring, all with in-scope=false, multiplicity-restriction={severity=ERROR, lower-multiplicity=0, upper-multiplicity=1}, default-value-handling=NO-DEFAULT:
              editHeight
              editWidth
              editfit
              editscale
              filename
              fit
              generator
              height
              htmlFit
              htmlHeight
              htmlScale
              htmlWidth
              notation
              scale
              width
        HardwareConfiguration
          class content conditional Invariant
            primitive attribute tailoring additionalInformation: in-scope=false, multiplicity-restriction={severity=ERROR, lower-multiplicity=0, upper-multiplicity=1}, default-value-handling=NO-DEFAULT
            primitive attribute tailoring processorMode: in-scope=false, multiplicity-restriction={severity=ERROR, lower-multiplicity=0, upper-multiplicity=1}, default-value-handling=NO-DEFAULT
            primitive attribute tailoring processorSpeed: in-scope=false, multiplicity-restriction={severity=ERROR, lower-multiplicity=0, upper-multiplicity=1}, default-value-handling=NO-DEFAULT
      abstract class tailoring HeapUsage: multiplicity-restriction={severity=INFO, lower-multiplicity=0, upper-multiplicity-infinite=true}
        class content conditional Invariant
          attribute-tailorings:
            aggregation tailoring hardwareConfiguration: in-scope=false, multiplicity-restriction={severity=ERROR, lower-multiplicity=0, upper-multiplicity=1}
            reference tailoring hwElement: in-scope=false, multiplicity-restriction={severity=ERROR, lower-multiplicity=0, upper-multiplicity=1}, unresolved-reference-restriction=severity=ERROR
            aggregation tailoring softwareContext: in-scope=false, multiplicity-restriction={severity=ERROR, lower-multiplicity=0, upper-multiplicity=1}
      5 x concrete class tailoring, all with in-scope=false, multiplicity-restriction={severity=INFO, lower-multiplicity=0, upper-multiplicity-infinite=true}, validation-root=false:
        HttpTp
          class content conditional Invariant
            attribute-tailorings:
              primitive attribute tailoring contentType: in-scope=false, multiplicity-restriction={severity=ERROR, lower-multiplicity=0, upper-multiplicity=1}, default-value-handling=NO-DEFAULT
              primitive attribute tailoring protocolVersion: in-scope=false, multiplicity-restriction={severity=ERROR, lower-multiplicity=0, upper-multiplicity=1}, default-value-handling=NO-DEFAULT
              primitive attribute tailoring requestMethod: in-scope=false, multiplicity-restriction={severity=ERROR, lower-multiplicity=0, upper-multiplicity=1}, default-value-handling=NO-DEFAULT
              aggregation tailoring tcpTpConfig: in-scope=false, multiplicity-restriction={severity=ERROR, lower-multiplicity=0, upper-multiplicity=1}
              primitive attribute tailoring uri: in-scope=false, multiplicity-restriction={severity=ERROR, lower-multiplicity=0, upper-multiplicity=1}, default-value-handling=NO-DEFAULT
        HwAttributeDef
          class content conditional Invariant
            attribute-tailorings:
              aggregation tailoring hwAttributeLiteral: in-scope=false, multiplicity-restriction={severity=ERROR, lower-multiplicity=0, upper-multiplicity-infinite=true}
              primitive attribute tailoring isRequired: in-scope=false, multiplicity-restriction={severity=ERROR, lower-multiplicity=0, upper-multiplicity=1}, default-value-handling=NO-DEFAULT
              reference tailoring unit: in-scope=false, multiplicity-restriction={severity=ERROR, lower-multiplicity=0, upper-multiplicity=1}, unresolved-reference-restriction=severity=ERROR
        HwAttributeLiteralDef
          class content conditional Invariant
        HwAttributeValue
          class content conditional Invariant
            attribute-tailorings:
              aggregation tailoring annotation: in-scope=false, multiplicity-restriction={severity=ERROR, lower-multiplicity=0, upper-multiplicity=1}
              reference tailoring hwAttributeDef: in-scope=false, multiplicity-restriction={severity=ERROR, lower-multiplicity=0, upper-multiplicity=1}, unresolved-reference-restriction=severity=ERROR
              primitive attribute tailoring v: in-scope=false, multiplicity-restriction={severity=ERROR, lower-multiplicity=0, upper-multiplicity=1}, variation-restriction={severity=ERROR, variation=true, valid-binding-times=[BLUEPRINT-DERIVATION-TIME, SYSTEM-DESIGN-TIME]}, default-value-handling=NO-DEFAULT
              primitive attribute tailoring vt: in-scope=false, multiplicity-restriction={severity=ERROR, lower-multiplicity=0, upper-multiplicity=1}, default-value-handling=NO-DEFAULT
                sub-attribute-tailorings:
                  primitive attribute tailoring xmlSpace: in-scope=false, multiplicity-restriction={severity=ERROR, lower-multiplicity=0, upper-multiplicity=1}, default-value-handling=NO-DEFAULT
        HwCategory
          class content conditional Invariant
            attribute-tailorings:
              aggregation tailoring hwAttributeDef: in-scope=false, multiplicity-restriction={severity=ERROR, lower-multiplicity=0, upper-multiplicity-infinite=true}
      abstract class tailoring HwDescriptionEntity: multiplicity-restriction={severity=INFO, lower-multiplicity=0, upper-multiplicity-infinite=true}
        class content conditional Invariant
          attribute-tailorings:
            aggregation tailoring hwAttributeValue: in-scope=false, multiplicity-restriction={severity=ERROR, lower-multiplicity=0, upper-multiplicity-infinite=true}, variation-restriction={severity=ERROR, variation=true, valid-binding-times=[BLUEPRINT-DERIVATION-TIME, SYSTEM-DESIGN-TIME]}
            reference tailoring hwCategory: in-scope=false, multiplicity-restriction={severity=ERROR, lower-multiplicity=0, upper-multiplicity-infinite=true}, unresolved-reference-restriction=severity=ERROR
            reference tailoring hwType: in-scope=false, multiplicity-restriction={severity=ERROR, lower-multiplicity=0, upper-multiplicity=1}, unresolved-reference-restriction=severity=ERROR
      9 x concrete class tailoring, all with in-scope=false, multiplicity-restriction={severity=INFO, lower-multiplicity=0, upper-multiplicity-infinite=true}, validation-root=false:
        HwElement
          class content conditional Invariant
            attribute-tailorings:
              aggregation tailoring hwElementConnection: in-scope=false, multiplicity-restriction={severity=ERROR, lower-multiplicity=0, upper-multiplicity-infinite=true}, variation-restriction={severity=ERROR, variation=true, valid-binding-times=[BLUEPRINT-DERIVATION-TIME, SYSTEM-DESIGN-TIME]}
              aggregation tailoring hwPinGroup: in-scope=false, multiplicity-restriction={severity=ERROR, lower-multiplicity=0, upper-multiplicity-infinite=true}, variation-restriction={severity=ERROR, variation=true, valid-binding-times=[BLUEPRINT-DERIVATION-TIME, SYSTEM-DESIGN-TIME]}
              reference tailoring nestedElement: in-scope=false, multiplicity-restriction={severity=ERROR, lower-multiplicity=0, upper-multiplicity-infinite=true}, variation-restriction={severity=ERROR, variation=true, valid-binding-times=[BLUEPRINT-DERIVATION-TIME, SYSTEM-DESIGN-TIME]}, unresolved-reference-restriction=severity=ERROR
        HwElementConnector
          class content conditional Invariant
            attribute-tailorings:
              reference tailoring hwElement: in-scope=false, multiplicity-restriction={severity=ERROR, lower-multiplicity=0, upper-multiplicity=2}, unresolved-reference-restriction=severity=ERROR
              aggregation tailoring hwPinConnection: in-scope=false, multiplicity-restriction={severity=ERROR, lower-multiplicity=0, upper-multiplicity-infinite=true}, variation-restriction={severity=ERROR, variation=true, valid-binding-times=[BLUEPRINT-DERIVATION-TIME, SYSTEM-DESIGN-TIME]}
              aggregation tailoring hwPinGroupConnection: in-scope=false, multiplicity-restriction={severity=ERROR, lower-multiplicity=0, upper-multiplicity-infinite=true}, variation-restriction={severity=ERROR, variation=true, valid-binding-times=[BLUEPRINT-DERIVATION-TIME, SYSTEM-DESIGN-TIME]}
        HwPin
          class content conditional Invariant
            primitive attribute tailoring pinNumber: in-scope=false, multiplicity-restriction={severity=ERROR, lower-multiplicity=0, upper-multiplicity=1}, default-value-handling=NO-DEFAULT
        HwPinConnector
          class content conditional Invariant
            attribute-tailorings:
              reference tailoring hwPin: in-scope=false, multiplicity-restriction={severity=ERROR, lower-multiplicity=0, upper-multiplicity=2}, unresolved-reference-restriction=severity=ERROR
        HwPinGroup
          class content conditional Invariant
            attribute-tailorings:
              aggregation tailoring hwPinGroupContent: in-scope=false, multiplicity-restriction={severity=ERROR, lower-multiplicity=0, upper-multiplicity=1}
        HwPinGroupConnector
          class content conditional Invariant
            attribute-tailorings:
              aggregation tailoring hwPinConnection: in-scope=false, multiplicity-restriction={severity=ERROR, lower-multiplicity=0, upper-multiplicity-infinite=true}, variation-restriction={severity=ERROR, variation=true, valid-binding-times=[BLUEPRINT-DERIVATION-TIME, SYSTEM-DESIGN-TIME]}
              reference tailoring hwPinGroup: in-scope=false, multiplicity-restriction={severity=ERROR, lower-multiplicity=0, upper-multiplicity=2}, unresolved-reference-restriction=severity=ERROR
        HwPinGroupContent
          class content conditional Invariant
            attribute-tailorings:
              aggregation tailoring hwPin: in-scope=false, multiplicity-restriction={severity=ERROR, lower-multiplicity=0, upper-multiplicity-infinite=true}, variation-restriction={severity=ERROR, variation=true, valid-binding-times=[BLUEPRINT-DERIVATION-TIME, SYSTEM-DESIGN-TIME]}  # Multiplicity is 0..* since attribute is contained in mixed / mixedString class.
              aggregation tailoring hwPinGroup: in-scope=false, multiplicity-restriction={severity=ERROR, lower-multiplicity=0, upper-multiplicity-infinite=true}, variation-restriction={severity=ERROR, variation=true, valid-binding-times=[BLUEPRINT-DERIVATION-TIME, SYSTEM-DESIGN-TIME]}  # Multiplicity is 0..* since attribute is contained in mixed / mixedString class.
        HwPortMapping
          class content conditional Invariant
            attribute-tailorings:
              reference tailoring communicationConnector: in-scope=false, multiplicity-restriction={severity=ERROR, lower-multiplicity=0, upper-multiplicity=1}, unresolved-reference-restriction=severity=ERROR
              reference tailoring hwCommunicationPort: in-scope=false, multiplicity-restriction={severity=ERROR, lower-multiplicity=0, upper-multiplicity=1}, unresolved-reference-restriction=severity=ERROR
        HwType
          class content conditional Invariant
      abstract class tailoring IPdu: multiplicity-restriction={severity=INFO, lower-multiplicity=0, upper-multiplicity-infinite=true}
        class content conditional Invariant
      12 x concrete class tailoring, all with in-scope=false, multiplicity-restriction={severity=INFO, lower-multiplicity=0, upper-multiplicity-infinite=true}, validation-root=false:
        IPduMapping
          class content conditional Invariant
            attribute-tailorings:
              aggregation tailoring introduction: in-scope=false, multiplicity-restriction={severity=ERROR, lower-multiplicity=0, upper-multiplicity=1}
              primitive attribute tailoring pdurTpChunkSize: in-scope=false, multiplicity-restriction={severity=ERROR, lower-multiplicity=0, upper-multiplicity=1}, default-value-handling=NO-DEFAULT
              reference tailoring sourceIPdu: in-scope=false, multiplicity-restriction={severity=ERROR, lower-multiplicity=0, upper-multiplicity=1}, unresolved-reference-restriction=severity=ERROR
              aggregation tailoring targetIPdu: in-scope=false, multiplicity-restriction={severity=ERROR, lower-multiplicity=0, upper-multiplicity=1}
        IPduPort
          class content conditional Invariant
            primitive attribute tailoring iPduSignalProcessing: in-scope=false, multiplicity-restriction={severity=ERROR, lower-multiplicity=0, upper-multiplicity=1}, default-value-handling=NO-DEFAULT
        IPduTiming
          class content conditional Invariant
            attribute-tailorings:
              primitive attribute tailoring minimumDelay: in-scope=false, multiplicity-restriction={severity=ERROR, lower-multiplicity=0, upper-multiplicity=1}, default-value-handling=NO-DEFAULT
              aggregation tailoring transmissionModeDeclaration: in-scope=false, multiplicity-restriction={severity=ERROR, lower-multiplicity=0, upper-multiplicity=1}
        ISignal
          class content conditional Invariant
            attribute-tailorings:
              primitive attribute tailoring dataTypePolicy: in-scope=false, multiplicity-restriction={severity=ERROR, lower-multiplicity=0, upper-multiplicity=1}, default-value-handling=NO-DEFAULT
              aggregation tailoring iSignalProps: in-scope=false, multiplicity-restriction={severity=ERROR, lower-multiplicity=0, upper-multiplicity=1}
              aggregation tailoring initValue: in-scope=false, multiplicity-restriction={severity=ERROR, lower-multiplicity=0, upper-multiplicity=1}
              primitive attribute tailoring length: in-scope=false, multiplicity-restriction={severity=ERROR, lower-multiplicity=0, upper-multiplicity=1}, default-value-handling=NO-DEFAULT
              aggregation tailoring networkRepresentationProps: in-scope=false, multiplicity-restriction={severity=ERROR, lower-multiplicity=0, upper-multiplicity=1}
              reference tailoring systemSignal: in-scope=false, multiplicity-restriction={severity=ERROR, lower-multiplicity=0, upper-multiplicity=1}, unresolved-reference-restriction=severity=ERROR
        ISignalGroup
          class content conditional Invariant
            attribute-tailorings:
              reference tailoring iSignal: in-scope=false, multiplicity-restriction={severity=ERROR, lower-multiplicity=0, upper-multiplicity-infinite=true}, unresolved-reference-restriction=severity=ERROR
              reference tailoring systemSignalGroup: in-scope=false, multiplicity-restriction={severity=ERROR, lower-multiplicity=0, upper-multiplicity=1}, unresolved-reference-restriction=severity=ERROR
        ISignalIPdu
          class content conditional Invariant
            attribute-tailorings:
              4 x aggregation tailoring, all with in-scope=false:
                iPduTimingSpecification: multiplicity-restriction={severity=ERROR, lower-multiplicity=0, upper-multiplicity=1}, variation-restriction={severity=ERROR, variation=true, valid-binding-times=[BLUEPRINT-DERIVATION-TIME, SYSTEM-DESIGN-TIME, CODE-GENERATION-TIME, PRE-COMPILE-TIME, LINK-TIME, POST-BUILD]}
                iSignalToPduMapping: multiplicity-restriction={severity=ERROR, lower-multiplicity=0, upper-multiplicity-infinite=true}, variation-restriction={severity=ERROR, variation=true, valid-binding-times=[BLUEPRINT-DERIVATION-TIME, SYSTEM-DESIGN-TIME, CODE-GENERATION-TIME, PRE-COMPILE-TIME, LINK-TIME, POST-BUILD]}
                pduCounter: multiplicity-restriction={severity=ERROR, lower-multiplicity=0, upper-multiplicity=1}, variation-restriction={severity=ERROR, variation=true, valid-binding-times=[BLUEPRINT-DERIVATION-TIME, SYSTEM-DESIGN-TIME, CODE-GENERATION-TIME, PRE-COMPILE-TIME]}
                pduReplication: multiplicity-restriction={severity=ERROR, lower-multiplicity=0, upper-multiplicity=1}, variation-restriction={severity=ERROR, variation=true, valid-binding-times=[BLUEPRINT-DERIVATION-TIME, SYSTEM-DESIGN-TIME, CODE-GENERATION-TIME, PRE-COMPILE-TIME]}
              primitive attribute tailoring unusedBitPattern: in-scope=false, multiplicity-restriction={severity=ERROR, lower-multiplicity=0, upper-multiplicity=1}, default-value-handling=NO-DEFAULT
        ISignalIPduGroup
          class content conditional Invariant
            attribute-tailorings:
              primitive attribute tailoring communicationDirection: in-scope=false, multiplicity-restriction={severity=ERROR, lower-multiplicity=0, upper-multiplicity=1}, default-value-handling=NO-DEFAULT
              primitive attribute tailoring communicationMode: in-scope=false, multiplicity-restriction={severity=ERROR, lower-multiplicity=0, upper-multiplicity=1}, default-value-handling=NO-DEFAULT
              reference tailoring containedISignalIPduGroup: in-scope=false, multiplicity-restriction={severity=ERROR, lower-multiplicity=0, upper-multiplicity-infinite=true}, unresolved-reference-restriction=severity=ERROR
              reference tailoring iSignalIPdu: in-scope=false, multiplicity-restriction={severity=ERROR, lower-multiplicity=0, upper-multiplicity-infinite=true}, variation-restriction={severity=ERROR, variation=true, valid-binding-times=[BLUEPRINT-DERIVATION-TIME, SYSTEM-DESIGN-TIME, CODE-GENERATION-TIME, PRE-COMPILE-TIME, LINK-TIME, POST-BUILD]}, unresolved-reference-restriction=severity=ERROR
        ISignalMapping
          class content conditional Invariant
            attribute-tailorings:
              aggregation tailoring introduction: in-scope=false, multiplicity-restriction={severity=ERROR, lower-multiplicity=0, upper-multiplicity=1}
              reference tailoring sourceSignal: in-scope=false, multiplicity-restriction={severity=ERROR, lower-multiplicity=0, upper-multiplicity=1}, unresolved-reference-restriction=severity=ERROR
              reference tailoring targetSignal: in-scope=false, multiplicity-restriction={severity=ERROR, lower-multiplicity=0, upper-multiplicity=1}, unresolved-reference-restriction=severity=ERROR
        ISignalPort
          class content conditional Invariant
            attribute-tailorings:
              aggregation tailoring dataFilter: in-scope=false, multiplicity-restriction={severity=ERROR, lower-multiplicity=0, upper-multiplicity=1}
              primitive attribute tailoring timeout: in-scope=false, multiplicity-restriction={severity=ERROR, lower-multiplicity=0, upper-multiplicity=1}, default-value-handling=NO-DEFAULT
        ISignalProps
          class content conditional Invariant
            primitive attribute tailoring handleOutOfRange: in-scope=false, multiplicity-restriction={severity=ERROR, lower-multiplicity=0, upper-multiplicity=1}, default-value-handling=NO-DEFAULT
        ISignalToIPduMapping
          class content conditional Invariant
            attribute-tailorings:
              reference tailoring iSignal: in-scope=false, multiplicity-restriction={severity=ERROR, lower-multiplicity=0, upper-multiplicity=1}, unresolved-reference-restriction=severity=ERROR
              reference tailoring iSignalGroup: in-scope=false, multiplicity-restriction={severity=ERROR, lower-multiplicity=0, upper-multiplicity=1}, unresolved-reference-restriction=severity=ERROR
              4 x primitive attribute tailoring, all with in-scope=false, multiplicity-restriction={severity=ERROR, lower-multiplicity=0, upper-multiplicity=1}, default-value-handling=NO-DEFAULT:
                packingByteOrder
                startPosition
                transferProperty
                updateIndicationBitPosition
        ISignalTriggering
          class content conditional Invariant
            attribute-tailorings:
              reference tailoring iSignal: in-scope=false, multiplicity-restriction={severity=ERROR, lower-multiplicity=0, upper-multiplicity=1}, unresolved-reference-restriction=severity=ERROR
              reference tailoring iSignalGroup: in-scope=false, multiplicity-restriction={severity=ERROR, lower-multiplicity=0, upper-multiplicity=1}, unresolved-reference-restriction=severity=ERROR
              reference tailoring iSignalPort: in-scope=false, multiplicity-restriction={severity=ERROR, lower-multiplicity=0, upper-multiplicity-infinite=true}, unresolved-reference-restriction=severity=ERROR
      abstract class tailoring IdentCaption: multiplicity-restriction={severity=INFO, lower-multiplicity=0, upper-multiplicity-infinite=true}
        class content conditional Invariant
      abstract class tailoring Identifiable: multiplicity-restriction={severity=INFO, lower-multiplicity=0, upper-multiplicity-infinite=true}
        class content conditional Invariant
          attribute-tailorings:
            aggregation tailoring adminData: in-scope=false, multiplicity-restriction={severity=ERROR, lower-multiplicity=0, upper-multiplicity=1}
            aggregation tailoring annotation: in-scope=false, multiplicity-restriction={severity=ERROR, lower-multiplicity=0, upper-multiplicity-infinite=true}
            primitive attribute tailoring category: in-scope=false, multiplicity-restriction={severity=ERROR, lower-multiplicity=0, upper-multiplicity=1}, default-value-handling=NO-DEFAULT
            aggregation tailoring desc: in-scope=false, multiplicity-restriction={severity=ERROR, lower-multiplicity=0, upper-multiplicity=1}
            aggregation tailoring introduction: in-scope=false, multiplicity-restriction={severity=ERROR, lower-multiplicity=0, upper-multiplicity=1}
            primitive attribute tailoring uuid: in-scope=false, multiplicity-restriction={severity=ERROR, lower-multiplicity=0, upper-multiplicity=1}, default-value-handling=NO-DEFAULT
      concrete class tailoring Ieee1722Tp: in-scope=false, multiplicity-restriction={severity=INFO, lower-multiplicity=0, upper-multiplicity-infinite=true}, validation-root=false
        class content conditional Invariant
          4 x primitive attribute tailoring, all with in-scope=false, multiplicity-restriction={severity=ERROR, lower-multiplicity=0, upper-multiplicity=1}, default-value-handling=NO-DEFAULT:
            relativeRepresentationTime
            streamIdentifier
            subType
            version
      abstract class tailoring Implementation: multiplicity-restriction={severity=INFO, lower-multiplicity=0, upper-multiplicity-infinite=true}
        class content conditional Invariant
          attribute-tailorings:
            reference tailoring buildActionManifest: in-scope=false, multiplicity-restriction={severity=ERROR, lower-multiplicity=0, upper-multiplicity=1}, variation-restriction={severity=ERROR, variation=true, valid-binding-times=[BLUEPRINT-DERIVATION-TIME, SYSTEM-DESIGN-TIME, CODE-GENERATION-TIME]}, unresolved-reference-restriction=severity=ERROR
            aggregation tailoring codeDescriptor: in-scope=false, multiplicity-restriction={severity=ERROR, lower-multiplicity=0, upper-multiplicity-infinite=true}
            aggregation tailoring compiler: in-scope=false, multiplicity-restriction={severity=ERROR, lower-multiplicity=0, upper-multiplicity-infinite=true}
            aggregation tailoring generatedArtifact: in-scope=false, multiplicity-restriction={severity=ERROR, lower-multiplicity=0, upper-multiplicity-infinite=true}, variation-restriction={severity=ERROR, variation=true, valid-binding-times=[BLUEPRINT-DERIVATION-TIME, SYSTEM-DESIGN-TIME, CODE-GENERATION-TIME, PRE-COMPILE-TIME]}
            reference tailoring hwElement: in-scope=false, multiplicity-restriction={severity=ERROR, lower-multiplicity=0, upper-multiplicity-infinite=true}, unresolved-reference-restriction=severity=ERROR
            aggregation tailoring linker: in-scope=false, multiplicity-restriction={severity=ERROR, lower-multiplicity=0, upper-multiplicity-infinite=true}
            aggregation tailoring mcSupport: in-scope=false, multiplicity-restriction={severity=ERROR, lower-multiplicity=0, upper-multiplicity=1}
            primitive attribute tailoring programmingLanguage: in-scope=false, multiplicity-restriction={severity=ERROR, lower-multiplicity=0, upper-multiplicity=1}, default-value-handling=NO-DEFAULT
            aggregation tailoring requiredArtifact: in-scope=false, multiplicity-restriction={severity=ERROR, lower-multiplicity=0, upper-multiplicity-infinite=true}, variation-restriction={severity=ERROR, variation=true, valid-binding-times=[BLUEPRINT-DERIVATION-TIME, SYSTEM-DESIGN-TIME, CODE-GENERATION-TIME, PRE-COMPILE-TIME]}
            aggregation tailoring requiredGeneratorTool: in-scope=false, multiplicity-restriction={severity=ERROR, lower-multiplicity=0, upper-multiplicity-infinite=true}, variation-restriction={severity=ERROR, variation=true, valid-binding-times=[BLUEPRINT-DERIVATION-TIME, SYSTEM-DESIGN-TIME, CODE-GENERATION-TIME, PRE-COMPILE-TIME]}
            aggregation tailoring resourceConsumption: in-scope=false, multiplicity-restriction={severity=ERROR, lower-multiplicity=0, upper-multiplicity=1}
            primitive attribute tailoring swVersion: in-scope=false, multiplicity-restriction={severity=ERROR, lower-multiplicity=0, upper-multiplicity=1}, default-value-handling=NO-DEFAULT
            reference tailoring swcBswMapping: in-scope=false, multiplicity-restriction={severity=ERROR, lower-multiplicity=0, upper-multiplicity=1}, unresolved-reference-restriction=severity=ERROR
            primitive attribute tailoring usedCodeGenerator: in-scope=false, multiplicity-restriction={severity=ERROR, lower-multiplicity=0, upper-multiplicity=1}, default-value-handling=NO-DEFAULT
            primitive attribute tailoring vendorId: in-scope=false, multiplicity-restriction={severity=ERROR, lower-multiplicity=0, upper-multiplicity=1}, default-value-handling=NO-DEFAULT
      4 x concrete class tailoring, all with in-scope=false, multiplicity-restriction={severity=INFO, lower-multiplicity=0, upper-multiplicity-infinite=true}, validation-root=false:
        ImplementationDataType
          class content conditional Invariant
            attribute-tailorings:
              aggregation tailoring subElement: in-scope=false, multiplicity-restriction={severity=ERROR, lower-multiplicity=0, upper-multiplicity-infinite=true}, variation-restriction={severity=ERROR, variation=true, valid-binding-times=[BLUEPRINT-DERIVATION-TIME, SYSTEM-DESIGN-TIME, CODE-GENERATION-TIME, PRE-COMPILE-TIME]}
              aggregation tailoring symbolProps: in-scope=false, multiplicity-restriction={severity=ERROR, lower-multiplicity=0, upper-multiplicity=1}
              primitive attribute tailoring typeEmitter: in-scope=false, multiplicity-restriction={severity=ERROR, lower-multiplicity=0, upper-multiplicity=1}, default-value-handling=NO-DEFAULT
        ImplementationDataTypeElement
          class content conditional Invariant
            attribute-tailorings:
              primitive attribute tailoring arraySize: in-scope=false, multiplicity-restriction={severity=ERROR, lower-multiplicity=0, upper-multiplicity=1}, variation-restriction={severity=ERROR, variation=true, valid-binding-times=[BLUEPRINT-DERIVATION-TIME, SYSTEM-DESIGN-TIME, CODE-GENERATION-TIME, PRE-COMPILE-TIME]}, default-value-handling=NO-DEFAULT
              primitive attribute tailoring arraySizeSemantics: in-scope=false, multiplicity-restriction={severity=ERROR, lower-multiplicity=0, upper-multiplicity=1}, default-value-handling=NO-DEFAULT
              aggregation tailoring subElement: in-scope=false, multiplicity-restriction={severity=ERROR, lower-multiplicity=0, upper-multiplicity-infinite=true}, variation-restriction={severity=ERROR, variation=true, valid-binding-times=[BLUEPRINT-DERIVATION-TIME, SYSTEM-DESIGN-TIME, CODE-GENERATION-TIME, PRE-COMPILE-TIME]}
              aggregation tailoring swDataDefProps: in-scope=false, multiplicity-restriction={severity=ERROR, lower-multiplicity=0, upper-multiplicity=1}
        ImplementationDataTypeSubElementRef
          class content conditional Invariant
            attribute-tailorings:
              aggregation tailoring implementationDataTypeElement: in-scope=false, multiplicity-restriction={severity=ERROR, lower-multiplicity=0, upper-multiplicity=1}
        ImplementationElementInParameterInstanceRef
          class content conditional Invariant
            attribute-tailorings:
              reference tailoring context: in-scope=false, multiplicity-restriction={severity=ERROR, lower-multiplicity=0, upper-multiplicity=1}, unresolved-reference-restriction=severity=ERROR
              reference tailoring target: in-scope=false, multiplicity-restriction={severity=ERROR, lower-multiplicity=0, upper-multiplicity=1}, unresolved-reference-restriction=severity=ERROR
      abstract class tailoring ImplementationProps: multiplicity-restriction={severity=INFO, lower-multiplicity=0, upper-multiplicity-infinite=true}
        class content conditional Invariant
          primitive attribute tailoring symbol: in-scope=false, multiplicity-restriction={severity=ERROR, lower-multiplicity=0, upper-multiplicity=1}, default-value-handling=NO-DEFAULT
            sub-attribute-tailorings:
              primitive attribute tailoring namePattern: in-scope=false, multiplicity-restriction={severity=ERROR, lower-multiplicity=0, upper-multiplicity=1}, default-value-handling=NO-DEFAULT
      13 x concrete class tailoring, all with in-scope=false, multiplicity-restriction={severity=INFO, lower-multiplicity=0, upper-multiplicity-infinite=true}, validation-root=false:
        IncludedDataTypeSet
          class content conditional Invariant
            attribute-tailorings:
              reference tailoring dataType: in-scope=false, multiplicity-restriction={severity=ERROR, lower-multiplicity=0, upper-multiplicity-infinite=true}, unresolved-reference-restriction=severity=ERROR
              primitive attribute tailoring literalPrefix: in-scope=false, multiplicity-restriction={severity=ERROR, lower-multiplicity=0, upper-multiplicity=1}, default-value-handling=NO-DEFAULT
                sub-attribute-tailorings:
                  primitive attribute tailoring namePattern: in-scope=false, multiplicity-restriction={severity=ERROR, lower-multiplicity=0, upper-multiplicity=1}, default-value-handling=NO-DEFAULT
        IncludedModeDeclarationGroupSet
          class content conditional Invariant
            attribute-tailorings:
              reference tailoring modeDeclarationGroup: in-scope=false, multiplicity-restriction={severity=ERROR, lower-multiplicity=0, upper-multiplicity-infinite=true}, unresolved-reference-restriction=severity=ERROR
              primitive attribute tailoring prefix: in-scope=false, multiplicity-restriction={severity=ERROR, lower-multiplicity=0, upper-multiplicity=1}, default-value-handling=NO-DEFAULT
                sub-attribute-tailorings:
                  primitive attribute tailoring namePattern: in-scope=false, multiplicity-restriction={severity=ERROR, lower-multiplicity=0, upper-multiplicity=1}, default-value-handling=NO-DEFAULT
        IndentSample
          class content conditional Invariant
            attribute-tailorings:
              primitive attribute tailoring itemLabelPos: in-scope=false, multiplicity-restriction={severity=ERROR, lower-multiplicity=0, upper-multiplicity=1}, default-value-handling=NO-DEFAULT
              aggregation tailoring l2: in-scope=false, multiplicity-restriction={severity=ERROR, lower-multiplicity=0, upper-multiplicity-infinite=true}
        IndexEntry
          class content conditional Invariant
            primitive attribute tailoring sub: in-scope=false, multiplicity-restriction={severity=ERROR, lower-multiplicity=0, upper-multiplicity-infinite=true}, default-value-handling=NO-DEFAULT  # Multiplicity is 0..* since attribute is contained in mixed / mixedString class.
            primitive attribute tailoring sup: in-scope=false, multiplicity-restriction={severity=ERROR, lower-multiplicity=0, upper-multiplicity-infinite=true}, default-value-handling=NO-DEFAULT  # Multiplicity is 0..* since attribute is contained in mixed / mixedString class.
        IndexedArrayElement
          class content conditional Invariant
            attribute-tailorings:
              reference tailoring applicationArrayElement: in-scope=false, multiplicity-restriction={severity=ERROR, lower-multiplicity=0, upper-multiplicity=1}, unresolved-reference-restriction=severity=ERROR
              reference tailoring implementationArrayElement: in-scope=false, multiplicity-restriction={severity=ERROR, lower-multiplicity=0, upper-multiplicity=1}, unresolved-reference-restriction=severity=ERROR
              primitive attribute tailoring index: in-scope=false, multiplicity-restriction={severity=ERROR, lower-multiplicity=0, upper-multiplicity=1}, default-value-handling=NO-DEFAULT
        InfrastructureServices
          class content conditional Invariant
            attribute-tailorings:
              aggregation tailoring dhcpServerConfiguration: in-scope=false, multiplicity-restriction={severity=ERROR, lower-multiplicity=0, upper-multiplicity=1}
              aggregation tailoring doIpEntity: in-scope=false, multiplicity-restriction={severity=ERROR, lower-multiplicity=0, upper-multiplicity=1}
              aggregation tailoring timeSynchronization: in-scope=false, multiplicity-restriction={severity=ERROR, lower-multiplicity=0, upper-multiplicity=1}
        InitEvent
          class content conditional Invariant
        InitialSdDelayConfig
          class content conditional Invariant
            4 x primitive attribute tailoring, all with in-scope=false, multiplicity-restriction={severity=ERROR, lower-multiplicity=0, upper-multiplicity=1}, default-value-handling=NO-DEFAULT:
              initialDelayMaxValue
              initialDelayMinValue
              initialRepetitionsBaseDelay
              initialRepetitionsMax
        InnerDataPrototypeGroupInCompositionInstanceRef
          class content conditional Invariant
            attribute-tailorings:
              reference tailoring contextSwComponentPrototype: in-scope=false, multiplicity-restriction={severity=ERROR, lower-multiplicity=0, upper-multiplicity-infinite=true}, unresolved-reference-restriction=severity=ERROR
              reference tailoring targetDataPrototypeGroup: in-scope=false, multiplicity-restriction={severity=ERROR, lower-multiplicity=0, upper-multiplicity=1}, unresolved-reference-restriction=severity=ERROR
        InnerPortGroupInCompositionInstanceRef
          class content conditional Invariant
            attribute-tailorings:
              reference tailoring context: in-scope=false, multiplicity-restriction={severity=ERROR, lower-multiplicity=0, upper-multiplicity-infinite=true}, unresolved-reference-restriction=severity=ERROR
              reference tailoring target: in-scope=false, multiplicity-restriction={severity=ERROR, lower-multiplicity=0, upper-multiplicity=1}, unresolved-reference-restriction=severity=ERROR
        InnerRunnableEntityGroupInCompositionInstanceRef
          class content conditional Invariant
            attribute-tailorings:
              reference tailoring contextSwComponentPrototype: in-scope=false, multiplicity-restriction={severity=ERROR, lower-multiplicity=0, upper-multiplicity-infinite=true}, unresolved-reference-restriction=severity=ERROR
              reference tailoring targetRunnableEntityGroup: in-scope=false, multiplicity-restriction={severity=ERROR, lower-multiplicity=0, upper-multiplicity=1}, unresolved-reference-restriction=severity=ERROR
        InstanceEventInCompositionInstanceRef
          class content conditional Invariant
            attribute-tailorings:
              reference tailoring contextComponentPrototype: in-scope=false, multiplicity-restriction={severity=ERROR, lower-multiplicity=0, upper-multiplicity-infinite=true}, unresolved-reference-restriction=severity=ERROR
              reference tailoring targetEvent: in-scope=false, multiplicity-restriction={severity=ERROR, lower-multiplicity=0, upper-multiplicity=1}, unresolved-reference-restriction=severity=ERROR
        InstantiationDataDefProps
          class content conditional Invariant
            attribute-tailorings:
              aggregation tailoring parameterInstance: in-scope=false, multiplicity-restriction={severity=ERROR, lower-multiplicity=0, upper-multiplicity=1}
              aggregation tailoring swDataDefProps: in-scope=false, multiplicity-restriction={severity=ERROR, lower-multiplicity=0, upper-multiplicity=1}
              aggregation tailoring variableInstance: in-scope=false, multiplicity-restriction={severity=ERROR, lower-multiplicity=0, upper-multiplicity=1}
      abstract class tailoring InstantiationRTEEventProps: multiplicity-restriction={severity=INFO, lower-multiplicity=0, upper-multiplicity-infinite=true}
        class content conditional Invariant
          attribute-tailorings:
            aggregation tailoring refinedEvent: in-scope=false, multiplicity-restriction={severity=ERROR, lower-multiplicity=0, upper-multiplicity=1}
            primitive attribute tailoring shortLabel: in-scope=false, multiplicity-restriction={severity=ERROR, lower-multiplicity=0, upper-multiplicity=1}, default-value-handling=NO-DEFAULT
              sub-attribute-tailorings:
                primitive attribute tailoring namePattern: in-scope=false, multiplicity-restriction={severity=ERROR, lower-multiplicity=0, upper-multiplicity=1}, default-value-handling=NO-DEFAULT
      concrete class tailoring InstantiationTimingEventProps: in-scope=false, multiplicity-restriction={severity=INFO, lower-multiplicity=0, upper-multiplicity-infinite=true}, validation-root=false
        class content conditional Invariant
          primitive attribute tailoring period: in-scope=false, multiplicity-restriction={severity=ERROR, lower-multiplicity=0, upper-multiplicity=1}, default-value-handling=NO-DEFAULT
      concrete class tailoring IntegerValueVariationPoint: in-scope=false, multiplicity-restriction={severity=INFO, lower-multiplicity=0, upper-multiplicity-infinite=true}, validation-root=false
        class content conditional Invariant
      abstract class tailoring InternalBehavior: multiplicity-restriction={severity=INFO, lower-multiplicity=0, upper-multiplicity-infinite=true}
        class content conditional Invariant
          attribute-tailorings:
            aggregation tailoring constantMemory: in-scope=false, multiplicity-restriction={severity=ERROR, lower-multiplicity=0, upper-multiplicity-infinite=true}, variation-restriction={severity=ERROR, variation=true, valid-binding-times=[BLUEPRINT-DERIVATION-TIME, SYSTEM-DESIGN-TIME, CODE-GENERATION-TIME, PRE-COMPILE-TIME]}
            reference tailoring constantValueMapping: in-scope=false, multiplicity-restriction={severity=ERROR, lower-multiplicity=0, upper-multiplicity-infinite=true}, unresolved-reference-restriction=severity=ERROR
            reference tailoring dataTypeMapping: in-scope=false, multiplicity-restriction={severity=ERROR, lower-multiplicity=0, upper-multiplicity-infinite=true}, unresolved-reference-restriction=severity=ERROR
            aggregation tailoring exclusiveArea: in-scope=false, multiplicity-restriction={severity=ERROR, lower-multiplicity=0, upper-multiplicity-infinite=true}, variation-restriction={severity=ERROR, variation=true, valid-binding-times=[BLUEPRINT-DERIVATION-TIME, SYSTEM-DESIGN-TIME, CODE-GENERATION-TIME, PRE-COMPILE-TIME]}
            aggregation tailoring exclusiveAreaNestingOrder: in-scope=false, multiplicity-restriction={severity=ERROR, lower-multiplicity=0, upper-multiplicity-infinite=true}, variation-restriction={severity=ERROR, variation=true, valid-binding-times=[BLUEPRINT-DERIVATION-TIME, SYSTEM-DESIGN-TIME, CODE-GENERATION-TIME, PRE-COMPILE-TIME]}
            aggregation tailoring staticMemory: in-scope=false, multiplicity-restriction={severity=ERROR, lower-multiplicity=0, upper-multiplicity-infinite=true}, variation-restriction={severity=ERROR, variation=true, valid-binding-times=[BLUEPRINT-DERIVATION-TIME, SYSTEM-DESIGN-TIME, CODE-GENERATION-TIME, PRE-COMPILE-TIME]}
      33 x concrete class tailoring, all with in-scope=false, validation-root=false:
        InternalConstrs: multiplicity-restriction={severity=INFO, lower-multiplicity=0, upper-multiplicity-infinite=true}
          class content conditional Invariant
            attribute-tailorings:
              4 x primitive attribute tailoring, all with in-scope=false, multiplicity-restriction={severity=ERROR, lower-multiplicity=0, upper-multiplicity=1}, default-value-handling=NO-DEFAULT:
                lowerLimit: variation-restriction={severity=ERROR, variation=true, valid-binding-times=[BLUEPRINT-DERIVATION-TIME, SYSTEM-DESIGN-TIME, CODE-GENERATION-TIME, PRE-COMPILE-TIME]}
                  sub-attribute-tailorings:
                    primitive attribute tailoring intervalType: in-scope=false, multiplicity-restriction={severity=ERROR, lower-multiplicity=0, upper-multiplicity=1}, default-value-handling=NO-DEFAULT
                maxDiff
                maxGradient
                monotony
              aggregation tailoring scaleConstr: in-scope=false, multiplicity-restriction={severity=ERROR, lower-multiplicity=0, upper-multiplicity-infinite=true}
              primitive attribute tailoring upperLimit: in-scope=false, multiplicity-restriction={severity=ERROR, lower-multiplicity=0, upper-multiplicity=1}, variation-restriction={severity=ERROR, variation=true, valid-binding-times=[BLUEPRINT-DERIVATION-TIME, SYSTEM-DESIGN-TIME, CODE-GENERATION-TIME, PRE-COMPILE-TIME]}, default-value-handling=NO-DEFAULT
                sub-attribute-tailorings:
                  primitive attribute tailoring intervalType: in-scope=false, multiplicity-restriction={severity=ERROR, lower-multiplicity=0, upper-multiplicity=1}, default-value-handling=NO-DEFAULT
        InternalTriggerOccurredEvent: multiplicity-restriction={severity=INFO, lower-multiplicity=0, upper-multiplicity-infinite=true}
          class content conditional Invariant
            attribute-tailorings:
              reference tailoring eventSource: in-scope=false, multiplicity-restriction={severity=ERROR, lower-multiplicity=0, upper-multiplicity=1}, unresolved-reference-restriction=severity=ERROR
        InternalTriggeringPoint: multiplicity-restriction={severity=INFO, lower-multiplicity=0, upper-multiplicity-infinite=true}
          class content conditional Invariant
            primitive attribute tailoring swImplPolicy: in-scope=false, multiplicity-restriction={severity=ERROR, lower-multiplicity=0, upper-multiplicity=1}, default-value-handling=NO-DEFAULT
        InterpolationRoutine: multiplicity-restriction={severity=INFO, lower-multiplicity=0, upper-multiplicity-infinite=true}
          class content conditional Invariant
            attribute-tailorings:
              reference tailoring interpolationRoutine: in-scope=false, multiplicity-restriction={severity=ERROR, lower-multiplicity=0, upper-multiplicity=1}, unresolved-reference-restriction=severity=ERROR
              primitive attribute tailoring isDefault: in-scope=false, multiplicity-restriction={severity=ERROR, lower-multiplicity=0, upper-multiplicity=1}, default-value-handling=NO-DEFAULT
              primitive attribute tailoring shortLabel: in-scope=false, multiplicity-restriction={severity=ERROR, lower-multiplicity=0, upper-multiplicity=1}, default-value-handling=NO-DEFAULT
                sub-attribute-tailorings:
                  primitive attribute tailoring namePattern: in-scope=false, multiplicity-restriction={severity=ERROR, lower-multiplicity=0, upper-multiplicity=1}, default-value-handling=NO-DEFAULT
        InterpolationRoutineMapping: multiplicity-restriction={severity=INFO, lower-multiplicity=0, upper-multiplicity-infinite=true}
          class content conditional Invariant
            attribute-tailorings:
              aggregation tailoring interpolationRoutine: in-scope=false, multiplicity-restriction={severity=ERROR, lower-multiplicity=0, upper-multiplicity-infinite=true}
              reference tailoring swRecordLayout: in-scope=false, multiplicity-restriction={severity=ERROR, lower-multiplicity=0, upper-multiplicity=1}, unresolved-reference-restriction=severity=ERROR
        InterpolationRoutineMappingSet: multiplicity-restriction={severity=INFO, lower-multiplicity=0, upper-multiplicity-infinite=true}
          class content conditional Invariant
            attribute-tailorings:
              aggregation tailoring interpolationRoutineMapping: in-scope=false, multiplicity-restriction={severity=ERROR, lower-multiplicity=0, upper-multiplicity-infinite=true}
        InvalidationPolicy: multiplicity-restriction={severity=INFO, lower-multiplicity=0, upper-multiplicity-infinite=true}
          class content conditional Invariant
            attribute-tailorings:
              reference tailoring dataElement: in-scope=false, multiplicity-restriction={severity=ERROR, lower-multiplicity=0, upper-multiplicity=1}, unresolved-reference-restriction=severity=ERROR
              primitive attribute tailoring handleInvalid: in-scope=false, multiplicity-restriction={severity=ERROR, lower-multiplicity=0, upper-multiplicity=1}, default-value-handling=NO-DEFAULT
        IoHwAbstractionServerAnnotation: multiplicity-restriction={severity=INFO, lower-multiplicity=0, upper-multiplicity-infinite=true}
          class content conditional Invariant
            attribute-tailorings:
              aggregation tailoring age: in-scope=false, multiplicity-restriction={severity=ERROR, lower-multiplicity=0, upper-multiplicity=1}
              reference tailoring argument: in-scope=false, multiplicity-restriction={severity=ERROR, lower-multiplicity=0, upper-multiplicity=1}, unresolved-reference-restriction=severity=ERROR
              primitive attribute tailoring bswResolution: in-scope=false, multiplicity-restriction={severity=ERROR, lower-multiplicity=0, upper-multiplicity=1}, default-value-handling=NO-DEFAULT
              reference tailoring dataElement: in-scope=false, multiplicity-restriction={severity=ERROR, lower-multiplicity=0, upper-multiplicity=1}, unresolved-reference-restriction=severity=ERROR
              reference tailoring failureMonitoring: in-scope=false, multiplicity-restriction={severity=ERROR, lower-multiplicity=0, upper-multiplicity=1}, unresolved-reference-restriction=severity=ERROR
              primitive attribute tailoring filteringDebouncing: in-scope=false, multiplicity-restriction={severity=ERROR, lower-multiplicity=0, upper-multiplicity=1}, default-value-handling=NO-DEFAULT
              primitive attribute tailoring pulseTest: in-scope=false, multiplicity-restriction={severity=ERROR, lower-multiplicity=0, upper-multiplicity=1}, default-value-handling=NO-DEFAULT
              reference tailoring trigger: in-scope=false, multiplicity-restriction={severity=ERROR, lower-multiplicity=0, upper-multiplicity=1}, unresolved-reference-restriction=severity=ERROR
        Ipv4Configuration: multiplicity-restriction={severity=INFO, lower-multiplicity=0, upper-multiplicity-infinite=true}
          class content conditional Invariant
            6 x primitive attribute tailoring, all with in-scope=false, default-value-handling=NO-DEFAULT:
              defaultGateway: multiplicity-restriction={severity=ERROR, lower-multiplicity=0, upper-multiplicity=1}
              dnsServerAddress: multiplicity-restriction={severity=ERROR, lower-multiplicity=0, upper-multiplicity-infinite=true}
              ipv4Address: multiplicity-restriction={severity=ERROR, lower-multiplicity=0, upper-multiplicity=1}
              ipv4AddressSource: multiplicity-restriction={severity=ERROR, lower-multiplicity=0, upper-multiplicity=1}
              networkMask: multiplicity-restriction={severity=ERROR, lower-multiplicity=0, upper-multiplicity=1}
              ttl: multiplicity-restriction={severity=ERROR, lower-multiplicity=0, upper-multiplicity=1}
        Ipv4DhcpServerConfiguration: multiplicity-restriction={severity=INFO, lower-multiplicity=0, upper-multiplicity-infinite=true}
          class content conditional Invariant
            6 x primitive attribute tailoring, all with in-scope=false, default-value-handling=NO-DEFAULT:
              addressRangeLowerBound: multiplicity-restriction={severity=ERROR, lower-multiplicity=0, upper-multiplicity=1}
              addressRangeUpperBound: multiplicity-restriction={severity=ERROR, lower-multiplicity=0, upper-multiplicity=1}
              defaultGateway: multiplicity-restriction={severity=ERROR, lower-multiplicity=0, upper-multiplicity=1}
              defaultLeaseTime: multiplicity-restriction={severity=ERROR, lower-multiplicity=0, upper-multiplicity=1}
              dnsServerAddress: multiplicity-restriction={severity=ERROR, lower-multiplicity=0, upper-multiplicity-infinite=true}
              networkMask: multiplicity-restriction={severity=ERROR, lower-multiplicity=0, upper-multiplicity=1}
        Ipv6Configuration: multiplicity-restriction={severity=INFO, lower-multiplicity=0, upper-multiplicity-infinite=true}
          class content conditional Invariant
            6 x primitive attribute tailoring, all with in-scope=false, default-value-handling=NO-DEFAULT:
              defaultRouter: multiplicity-restriction={severity=ERROR, lower-multiplicity=0, upper-multiplicity=1}
              dnsServerAddress: multiplicity-restriction={severity=ERROR, lower-multiplicity=0, upper-multiplicity-infinite=true}
              hopCount: multiplicity-restriction={severity=ERROR, lower-multiplicity=0, upper-multiplicity=1}
              ipAddressPrefixLength: multiplicity-restriction={severity=ERROR, lower-multiplicity=0, upper-multiplicity=1}
              ipv6Address: multiplicity-restriction={severity=ERROR, lower-multiplicity=0, upper-multiplicity=1}
              ipv6AddressSource: multiplicity-restriction={severity=ERROR, lower-multiplicity=0, upper-multiplicity=1}
        Ipv6DhcpServerConfiguration: multiplicity-restriction={severity=INFO, lower-multiplicity=0, upper-multiplicity-infinite=true}
          class content conditional Invariant
            6 x primitive attribute tailoring, all with in-scope=false, default-value-handling=NO-DEFAULT:
              addressRangeLowerBound: multiplicity-restriction={severity=ERROR, lower-multiplicity=0, upper-multiplicity=1}
              addressRangeUpperBound: multiplicity-restriction={severity=ERROR, lower-multiplicity=0, upper-multiplicity=1}
              defaultGateway: multiplicity-restriction={severity=ERROR, lower-multiplicity=0, upper-multiplicity=1}
              defaultLeaseTime: multiplicity-restriction={severity=ERROR, lower-multiplicity=0, upper-multiplicity=1}
              dnsServerAddress: multiplicity-restriction={severity=ERROR, lower-multiplicity=0, upper-multiplicity-infinite=true}
              networkMask: multiplicity-restriction={severity=ERROR, lower-multiplicity=0, upper-multiplicity=1}
        Item: multiplicity-restriction={severity=INFO, lower-multiplicity=0, upper-multiplicity-infinite=true}
          class content conditional Invariant
            attribute-tailorings:
              aggregation tailoring itemContents: in-scope=false, multiplicity-restriction={severity=ERROR, lower-multiplicity=0, upper-multiplicity=1}
        J1939Cluster: multiplicity-restriction={severity=INFO, lower-multiplicity=0, upper-multiplicity-infinite=true}
          class content conditional Invariant
        J1939DcmIPdu: multiplicity-restriction={severity=WARNING, lower-multiplicity=0, upper-multiplicity=0}  # Spec element has lifecycle state 'obsolete' since 4.1.2. The GeneralPurposeIPdu with the category "J1939Dcm" shall be used instead..
          class content conditional Invariant
        J1939NmCluster: multiplicity-restriction={severity=INFO, lower-multiplicity=0, upper-multiplicity-infinite=true}
          class content conditional Invariant
            primitive attribute tailoring addressClaimEnabled: in-scope=false, multiplicity-restriction={severity=ERROR, lower-multiplicity=0, upper-multiplicity=1}, default-value-handling=NO-DEFAULT
        J1939NmEcu: multiplicity-restriction={severity=INFO, lower-multiplicity=0, upper-multiplicity-infinite=true}
          class content conditional Invariant
        J1939NmNode: multiplicity-restriction={severity=INFO, lower-multiplicity=0, upper-multiplicity-infinite=true}
          class content conditional Invariant
        J1939TpConfig: multiplicity-restriction={severity=INFO, lower-multiplicity=0, upper-multiplicity-infinite=true}
          class content conditional Invariant
            attribute-tailorings:
              aggregation tailoring tpAddress: in-scope=false, multiplicity-restriction={severity=ERROR, lower-multiplicity=0, upper-multiplicity-infinite=true}, variation-restriction={severity=ERROR, variation=true, valid-binding-times=[BLUEPRINT-DERIVATION-TIME, SYSTEM-DESIGN-TIME, CODE-GENERATION-TIME, PRE-COMPILE-TIME, LINK-TIME, POST-BUILD]}
              aggregation tailoring tpConnection: in-scope=false, multiplicity-restriction={severity=ERROR, lower-multiplicity=0, upper-multiplicity-infinite=true}, variation-restriction={severity=ERROR, variation=true, valid-binding-times=[BLUEPRINT-DERIVATION-TIME, SYSTEM-DESIGN-TIME, CODE-GENERATION-TIME, PRE-COMPILE-TIME, LINK-TIME, POST-BUILD]}
              aggregation tailoring tpNode: in-scope=false, multiplicity-restriction={severity=ERROR, lower-multiplicity=0, upper-multiplicity-infinite=true}, variation-restriction={severity=ERROR, variation=true, valid-binding-times=[BLUEPRINT-DERIVATION-TIME, SYSTEM-DESIGN-TIME, CODE-GENERATION-TIME, PRE-COMPILE-TIME, LINK-TIME, POST-BUILD]}
        J1939TpConnection: multiplicity-restriction={severity=INFO, lower-multiplicity=0, upper-multiplicity-infinite=true}
          class content conditional Invariant
            attribute-tailorings:
              primitive attribute tailoring broadcast: in-scope=false, multiplicity-restriction={severity=ERROR, lower-multiplicity=0, upper-multiplicity=1}, default-value-handling=NO-DEFAULT
              primitive attribute tailoring bufferRatio: in-scope=false, multiplicity-restriction={severity=ERROR, lower-multiplicity=0, upper-multiplicity=1}, default-value-handling=NO-DEFAULT
              primitive attribute tailoring cancellation: in-scope=false, multiplicity-restriction={severity=ERROR, lower-multiplicity=0, upper-multiplicity=1}, default-value-handling=NO-DEFAULT
              reference tailoring dataPdu: in-scope=false, multiplicity-restriction={severity=ERROR, lower-multiplicity=0, upper-multiplicity=1}, unresolved-reference-restriction=severity=ERROR
              reference tailoring directPdu: in-scope=false, multiplicity-restriction={severity=ERROR, lower-multiplicity=0, upper-multiplicity=1}, unresolved-reference-restriction=severity=ERROR
              primitive attribute tailoring dynamicBs: in-scope=false, multiplicity-restriction={severity=ERROR, lower-multiplicity=0, upper-multiplicity=1}, default-value-handling=NO-DEFAULT
              reference tailoring flowControlPdu: in-scope=false, multiplicity-restriction={severity=ERROR, lower-multiplicity=0, upper-multiplicity=2}, unresolved-reference-restriction=severity=ERROR
              primitive attribute tailoring maxBs: in-scope=false, multiplicity-restriction={severity=ERROR, lower-multiplicity=0, upper-multiplicity=1}, default-value-handling=NO-DEFAULT
              primitive attribute tailoring maxExpBs: in-scope=false, multiplicity-restriction={severity=ERROR, lower-multiplicity=0, upper-multiplicity=1}, default-value-handling=NO-DEFAULT
              reference tailoring receiver: in-scope=false, multiplicity-restriction={severity=ERROR, lower-multiplicity=0, upper-multiplicity-infinite=true}, unresolved-reference-restriction=severity=ERROR
              primitive attribute tailoring retry: in-scope=false, multiplicity-restriction={severity=ERROR, lower-multiplicity=0, upper-multiplicity=1}, default-value-handling=NO-DEFAULT
              aggregation tailoring tpPg: in-scope=false, multiplicity-restriction={severity=ERROR, lower-multiplicity=0, upper-multiplicity-infinite=true}
              reference tailoring tpSdu: in-scope=false, multiplicity-restriction={severity=ERROR, lower-multiplicity=0, upper-multiplicity-infinite=true}, unresolved-reference-restriction=severity=ERROR
              reference tailoring transmitter: in-scope=false, multiplicity-restriction={severity=ERROR, lower-multiplicity=0, upper-multiplicity=1}, unresolved-reference-restriction=severity=ERROR
        J1939TpNode: multiplicity-restriction={severity=INFO, lower-multiplicity=0, upper-multiplicity-infinite=true}
          class content conditional Invariant
            attribute-tailorings:
              reference tailoring connector: in-scope=false, multiplicity-restriction={severity=ERROR, lower-multiplicity=0, upper-multiplicity=1}, unresolved-reference-restriction=severity=ERROR
              reference tailoring tpAddress: in-scope=false, multiplicity-restriction={severity=ERROR, lower-multiplicity=0, upper-multiplicity=1}, unresolved-reference-restriction=severity=ERROR
        J1939TpPg: multiplicity-restriction={severity=INFO, lower-multiplicity=0, upper-multiplicity-infinite=true}
          class content conditional Invariant
            attribute-tailorings:
              reference tailoring directPdu: in-scope=false, multiplicity-restriction={severity=ERROR, lower-multiplicity=0, upper-multiplicity=1}, unresolved-reference-restriction=severity=ERROR
              primitive attribute tailoring pgn: in-scope=false, multiplicity-restriction={severity=ERROR, lower-multiplicity=0, upper-multiplicity=1}, default-value-handling=NO-DEFAULT
              reference tailoring sdu: in-scope=false, multiplicity-restriction={severity=ERROR, lower-multiplicity=0, upper-multiplicity-infinite=true}, unresolved-reference-restriction=severity=ERROR
              reference tailoring tpSdu: in-scope=false, multiplicity-restriction={severity=ERROR, lower-multiplicity=0, upper-multiplicity=1}, unresolved-reference-restriction=severity=ERROR
        KeyData: multiplicity-restriction={severity=INFO, lower-multiplicity=0, upper-multiplicity-infinite=true}
          class content conditional Invariant
        Keyword: multiplicity-restriction={severity=INFO, lower-multiplicity=0, upper-multiplicity-infinite=true}
          class content conditional Invariant
            primitive attribute tailoring abbrName: in-scope=false, multiplicity-restriction={severity=ERROR, lower-multiplicity=0, upper-multiplicity=1}, default-value-handling=NO-DEFAULT
            primitive attribute tailoring classification: in-scope=false, multiplicity-restriction={severity=ERROR, lower-multiplicity=0, upper-multiplicity-infinite=true}, default-value-handling=NO-DEFAULT
        KeywordSet: multiplicity-restriction={severity=INFO, lower-multiplicity=0, upper-multiplicity-infinite=true}
          class content conditional Invariant
            attribute-tailorings:
              aggregation tailoring keyword: in-scope=false, multiplicity-restriction={severity=ERROR, lower-multiplicity=0, upper-multiplicity-infinite=true}
        LGraphic: multiplicity-restriction={severity=INFO, lower-multiplicity=0, upper-multiplicity-infinite=true}
          class content conditional Invariant
            attribute-tailorings:
              aggregation tailoring graphic: in-scope=false, multiplicity-restriction={severity=ERROR, lower-multiplicity=0, upper-multiplicity=1}
              aggregation tailoring map: in-scope=false, multiplicity-restriction={severity=ERROR, lower-multiplicity=0, upper-multiplicity=1}
        LLongName: multiplicity-restriction={severity=INFO, lower-multiplicity=0, upper-multiplicity-infinite=true}
          class content conditional Invariant
        LOverviewParagraph: multiplicity-restriction={severity=INFO, lower-multiplicity=0, upper-multiplicity-infinite=true}
          class content conditional Invariant
        LParagraph: multiplicity-restriction={severity=INFO, lower-multiplicity=0, upper-multiplicity-infinite=true}
          class content conditional Invariant
        LPlainText: multiplicity-restriction={severity=INFO, lower-multiplicity=0, upper-multiplicity-infinite=true}
          class content conditional Invariant
        LVerbatim: multiplicity-restriction={severity=INFO, lower-multiplicity=0, upper-multiplicity-infinite=true}
          class content conditional Invariant
        LabeledItem: multiplicity-restriction={severity=INFO, lower-multiplicity=0, upper-multiplicity-infinite=true}
          class content conditional Invariant
            attribute-tailorings:
              primitive attribute tailoring helpEntry: in-scope=false, multiplicity-restriction={severity=ERROR, lower-multiplicity=0, upper-multiplicity=1}, default-value-handling=NO-DEFAULT
              aggregation tailoring itemContents: in-scope=false, multiplicity-restriction={severity=ERROR, lower-multiplicity=0, upper-multiplicity=1}
              aggregation tailoring itemLabel: in-scope=false, multiplicity-restriction={severity=ERROR, lower-multiplicity=0, upper-multiplicity=1}
        LabeledList: multiplicity-restriction={severity=INFO, lower-multiplicity=0, upper-multiplicity-infinite=true}
          class content conditional Invariant
            attribute-tailorings:
              aggregation tailoring indentSample: in-scope=false, multiplicity-restriction={severity=ERROR, lower-multiplicity=0, upper-multiplicity=1}
              aggregation tailoring labeledItem: in-scope=false, multiplicity-restriction={severity=ERROR, lower-multiplicity=0, upper-multiplicity-infinite=true}, variation-restriction={severity=ERROR, variation=true, valid-binding-times=[BLUEPRINT-DERIVATION-TIME, SYSTEM-DESIGN-TIME, CODE-GENERATION-TIME, PRE-COMPILE-TIME, LINK-TIME, POST-BUILD]}
      abstract class tailoring LanguageSpecific: multiplicity-restriction={severity=INFO, lower-multiplicity=0, upper-multiplicity-infinite=true}
        class content conditional Invariant
          primitive attribute tailoring l: in-scope=false, multiplicity-restriction={severity=ERROR, lower-multiplicity=1, upper-multiplicity=1}, default-value-handling=NO-DEFAULT
      9 x concrete class tailoring, all with in-scope=false, multiplicity-restriction={severity=INFO, lower-multiplicity=0, upper-multiplicity-infinite=true}, validation-root=false:
        LatencyTimingConstraint
          class content conditional Invariant
            attribute-tailorings:
              primitive attribute tailoring latencyConstraintType: in-scope=false, multiplicity-restriction={severity=ERROR, lower-multiplicity=0, upper-multiplicity=1}, default-value-handling=NO-DEFAULT
              aggregation tailoring maximum: in-scope=false, multiplicity-restriction={severity=ERROR, lower-multiplicity=0, upper-multiplicity=1}
              aggregation tailoring minimum: in-scope=false, multiplicity-restriction={severity=ERROR, lower-multiplicity=0, upper-multiplicity=1}
              aggregation tailoring nominal: in-scope=false, multiplicity-restriction={severity=ERROR, lower-multiplicity=0, upper-multiplicity=1}
              reference tailoring scope: in-scope=false, multiplicity-restriction={severity=ERROR, lower-multiplicity=0, upper-multiplicity=1}, unresolved-reference-restriction=severity=ERROR
        LifeCycleInfo
          class content conditional Invariant
            attribute-tailorings:
              reference tailoring lcObject: in-scope=false, multiplicity-restriction={severity=ERROR, lower-multiplicity=0, upper-multiplicity=1}, unresolved-reference-restriction=severity=ERROR
              reference tailoring lcState: in-scope=false, multiplicity-restriction={severity=ERROR, lower-multiplicity=0, upper-multiplicity=1}, unresolved-reference-restriction=severity=ERROR
              aggregation tailoring periodBegin: in-scope=false, multiplicity-restriction={severity=ERROR, lower-multiplicity=0, upper-multiplicity=1}
              aggregation tailoring periodEnd: in-scope=false, multiplicity-restriction={severity=ERROR, lower-multiplicity=0, upper-multiplicity=1}
              aggregation tailoring remark: in-scope=false, multiplicity-restriction={severity=ERROR, lower-multiplicity=0, upper-multiplicity=1}
              reference tailoring useInstead: in-scope=false, multiplicity-restriction={severity=ERROR, lower-multiplicity=0, upper-multiplicity-infinite=true}, unresolved-reference-restriction=severity=ERROR
        LifeCycleInfoSet
          class content conditional Invariant
            attribute-tailorings:
              reference tailoring defaultLcState: in-scope=false, multiplicity-restriction={severity=ERROR, lower-multiplicity=0, upper-multiplicity=1}, unresolved-reference-restriction=severity=ERROR
              aggregation tailoring defaultPeriodBegin: in-scope=false, multiplicity-restriction={severity=ERROR, lower-multiplicity=0, upper-multiplicity=1}
              aggregation tailoring defaultPeriodEnd: in-scope=false, multiplicity-restriction={severity=ERROR, lower-multiplicity=0, upper-multiplicity=1}
              aggregation tailoring lifeCycleInfo: in-scope=false, multiplicity-restriction={severity=ERROR, lower-multiplicity=0, upper-multiplicity-infinite=true}
              reference tailoring usedLifeCycleStateDefinitionGroup: in-scope=false, multiplicity-restriction={severity=ERROR, lower-multiplicity=0, upper-multiplicity=1}, unresolved-reference-restriction=severity=ERROR
        LifeCyclePeriod
          class content conditional Invariant
            primitive attribute tailoring arReleaseVersion: in-scope=false, multiplicity-restriction={severity=ERROR, lower-multiplicity=0, upper-multiplicity=1}, default-value-handling=NO-DEFAULT
            primitive attribute tailoring date: in-scope=false, multiplicity-restriction={severity=ERROR, lower-multiplicity=0, upper-multiplicity=1}, default-value-handling=NO-DEFAULT
            primitive attribute tailoring productRelease: in-scope=false, multiplicity-restriction={severity=ERROR, lower-multiplicity=0, upper-multiplicity=1}, default-value-handling=NO-DEFAULT
        LifeCycleState
          class content conditional Invariant
        LifeCycleStateDefinitionGroup
          class content conditional Invariant
            attribute-tailorings:
              aggregation tailoring lcState: in-scope=false, multiplicity-restriction={severity=ERROR, lower-multiplicity=0, upper-multiplicity-infinite=true}
        LimitValueVariationPoint
          class content conditional Invariant
            primitive attribute tailoring intervalType: in-scope=false, multiplicity-restriction={severity=ERROR, lower-multiplicity=0, upper-multiplicity=1}, default-value-handling=NO-DEFAULT
        LinCluster
          class content conditional Invariant
        LinCommunicationConnector
          class content conditional Invariant
            attribute-tailorings:
              primitive attribute tailoring initialNad: in-scope=false, multiplicity-restriction={severity=ERROR, lower-multiplicity=0, upper-multiplicity=1}, default-value-handling=NO-DEFAULT
              aggregation tailoring linConfigurableFrame: in-scope=false, multiplicity-restriction={severity=ERROR, lower-multiplicity=0, upper-multiplicity-infinite=true}
              aggregation tailoring linOrderedConfigurableFrame: in-scope=false, multiplicity-restriction={severity=ERROR, lower-multiplicity=0, upper-multiplicity-infinite=true}
      abstract class tailoring LinCommunicationController: multiplicity-restriction={severity=INFO, lower-multiplicity=0, upper-multiplicity-infinite=true}
        class content conditional Invariant
          primitive attribute tailoring protocolVersion: in-scope=false, multiplicity-restriction={severity=ERROR, lower-multiplicity=0, upper-multiplicity=1}, default-value-handling=NO-DEFAULT
      concrete class tailoring LinConfigurableFrame: in-scope=false, multiplicity-restriction={severity=INFO, lower-multiplicity=0, upper-multiplicity-infinite=true}, validation-root=false
        class content conditional Invariant
          attribute-tailorings:
            reference tailoring frame: in-scope=false, multiplicity-restriction={severity=ERROR, lower-multiplicity=0, upper-multiplicity=1}, unresolved-reference-restriction=severity=ERROR
            primitive attribute tailoring messageId: in-scope=false, multiplicity-restriction={severity=ERROR, lower-multiplicity=0, upper-multiplicity=1}, default-value-handling=NO-DEFAULT
      abstract class tailoring LinConfigurationEntry: multiplicity-restriction={severity=INFO, lower-multiplicity=0, upper-multiplicity-infinite=true}
        class content conditional Invariant
          attribute-tailorings:
            reference tailoring assignedController: in-scope=false, multiplicity-restriction={severity=ERROR, lower-multiplicity=0, upper-multiplicity=1}, unresolved-reference-restriction=severity=ERROR
