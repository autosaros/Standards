[part 2 of 3: package /AUTOSAR/DataExchangePoints]
AUTOSAR XML (schema 00046)
package /AUTOSAR/DataExchangePoints  (continued)
  data exchange point Default: kind=AGREED, referenced-baseline=standard-revisions=CP 4.0.2  (continued)
    data-format-tailoring:  (continued)
      9 x concrete class tailoring, all with in-scope=false, multiplicity-restriction={severity=INFO, lower-multiplicity=0, upper-multiplicity-infinite=true}, validation-root=false:
        GeneralHardware
          class content conditional Invariant
            attribute-tailorings:
              aggregation tailoring introduction: in-scope=false, multiplicity-restriction={severity=ERROR, lower-multiplicity=0, upper-multiplicity=1}
              aggregation tailoring reliability: in-scope=false, multiplicity-restriction={severity=ERROR, lower-multiplicity=0, upper-multiplicity=1}
              aggregation tailoring usefulLife: in-scope=false, multiplicity-restriction={severity=ERROR, lower-multiplicity=0, upper-multiplicity=1}
        GeneralInterfaces
          class content conditional Invariant
            attribute-tailorings:
              aggregation tailoring introduction: in-scope=false, multiplicity-restriction={severity=ERROR, lower-multiplicity=0, upper-multiplicity=1}
        GeneralParameter
          class content conditional Invariant
            attribute-tailorings:
              aggregation tailoring prmChar: in-scope=false, multiplicity-restriction={severity=ERROR, lower-multiplicity=0, upper-multiplicity-infinite=true}
        GeneralProductData1
          class content conditional Invariant
            attribute-tailorings:
              7 x aggregation tailoring, all with in-scope=false, multiplicity-restriction={severity=ERROR, lower-multiplicity=0, upper-multiplicity=1}:
                adminData
                failureManagement
                generalHardware
                generalInterfaces
                generalSoftware
                introduction
                keyData
        GeneralProjectData
          class content conditional Invariant
            attribute-tailorings:
              5 x aggregation tailoring, all with in-scope=false, multiplicity-restriction={severity=ERROR, lower-multiplicity=0, upper-multiplicity=1}:
                adminData
                contractAspects
                introduction
                sampleSpec
                variantSpec
        GeneralRequirements
          class content conditional Invariant
            attribute-tailorings:
              4 x aggregation tailoring, all with in-scope=false, multiplicity-restriction={severity=ERROR, lower-multiplicity=0, upper-multiplicity=1}:
                adminData
                functionalRequirements
                generalProductData1
                introduction
        GeneralSoftware
          class content conditional Invariant
            attribute-tailorings:
              aggregation tailoring dataRequirements: in-scope=false, multiplicity-restriction={severity=ERROR, lower-multiplicity=0, upper-multiplicity=1}
              aggregation tailoring designRequirements: in-scope=false, multiplicity-restriction={severity=ERROR, lower-multiplicity=0, upper-multiplicity=1}
              aggregation tailoring introduction: in-scope=false, multiplicity-restriction={severity=ERROR, lower-multiplicity=0, upper-multiplicity=1}
        Graphic
          class content conditional Invariant
            15 x primitive attribute tailoring, all with in-scope=false, multiplicity-restriction={severity=ERROR, lower-multiplicity=0, upper-multiplicity=1}, default-value-handling=NO-DEFAULT:
              editHeight
              editWidth
              editfit
              editscale
              filename
              fit
              generator
              height
              htmlFit
              htmlHeight
              htmlScale
              htmlWidth
              notation
              scale
              width
        HardwareConfiguration
          class content conditional Invariant
            primitive attribute tailoring additionalInformation: in-scope=false, multiplicity-restriction={severity=ERROR, lower-multiplicity=0, upper-multiplicity=1}, default-value-handling=NO-DEFAULT
            primitive attribute tailoring processorMode: in-scope=false, multiplicity-restriction={severity=ERROR, lower-multiplicity=0, upper-multiplicity=1}, default-value-handling=NO-DEFAULT
            primitive attribute tailoring processorSpeed: in-scope=false, multiplicity-restriction={severity=ERROR, lower-multiplicity=0, upper-multiplicity=1}, default-value-handling=NO-DEFAULT
      abstract class tailoring HeapUsage: multiplicity-restriction={severity=INFO, lower-multiplicity=0, upper-multiplicity-infinite=true}
        class content conditional Invariant
          attribute-tailorings:
            aggregation tailoring hardwareConfiguration: in-scope=false, multiplicity-restriction={severity=ERROR, lower-multiplicity=0, upper-multiplicity=1}
            reference tailoring hwElement: in-scope=false, multiplicity-restriction={severity=ERROR, lower-multiplicity=0, upper-multiplicity=1}, unresolved-reference-restriction=severity=ERROR
            aggregation tailoring softwareContext: in-scope=false, multiplicity-restriction={severity=ERROR, lower-multiplicity=0, upper-multiplicity=1}
      4 x concrete class tailoring, all with in-scope=false, multiplicity-restriction={severity=INFO, lower-multiplicity=0, upper-multiplicity-infinite=true}, validation-root=false:
        HwAttributeDef
          class content conditional Invariant
            attribute-tailorings:
              aggregation tailoring hwAttributeLiteral: in-scope=false, multiplicity-restriction={severity=ERROR, lower-multiplicity=0, upper-multiplicity-infinite=true}
              primitive attribute tailoring isRequired: in-scope=false, multiplicity-restriction={severity=ERROR, lower-multiplicity=0, upper-multiplicity=1}, default-value-handling=NO-DEFAULT
              reference tailoring unit: in-scope=false, multiplicity-restriction={severity=ERROR, lower-multiplicity=0, upper-multiplicity=1}, unresolved-reference-restriction=severity=ERROR
        HwAttributeLiteralDef
          class content conditional Invariant
        HwAttributeValue
          class content conditional Invariant
            attribute-tailorings:
              aggregation tailoring annotation: in-scope=false, multiplicity-restriction={severity=ERROR, lower-multiplicity=0, upper-multiplicity=1}
              reference tailoring hwAttributeDef: in-scope=false, multiplicity-restriction={severity=ERROR, lower-multiplicity=0, upper-multiplicity=1}, unresolved-reference-restriction=severity=ERROR
              primitive attribute tailoring v: in-scope=false, multiplicity-restriction={severity=ERROR, lower-multiplicity=0, upper-multiplicity=1}, variation-restriction={severity=ERROR, variation=true, valid-binding-times=[BLUEPRINT-DERIVATION-TIME, SYSTEM-DESIGN-TIME, CODE-GENERATION-TIME, PRE-COMPILE-TIME, LINK-TIME, POST-BUILD]}, default-value-handling=NO-DEFAULT
              primitive attribute tailoring vt: in-scope=false, multiplicity-restriction={severity=ERROR, lower-multiplicity=0, upper-multiplicity=1}, default-value-handling=NO-DEFAULT
        HwCategory
          class content conditional Invariant
            attribute-tailorings:
              aggregation tailoring hwAttributeDef: in-scope=false, multiplicity-restriction={severity=ERROR, lower-multiplicity=0, upper-multiplicity-infinite=true}
      abstract class tailoring HwDescriptionEntity: multiplicity-restriction={severity=INFO, lower-multiplicity=0, upper-multiplicity-infinite=true}
        class content conditional Invariant
          attribute-tailorings:
            aggregation tailoring hwAttributeValue: in-scope=false, multiplicity-restriction={severity=ERROR, lower-multiplicity=0, upper-multiplicity-infinite=true}, variation-restriction={severity=ERROR, variation=true, valid-binding-times=[BLUEPRINT-DERIVATION-TIME, SYSTEM-DESIGN-TIME, CODE-GENERATION-TIME, PRE-COMPILE-TIME, LINK-TIME, POST-BUILD]}
            reference tailoring hwCategory: in-scope=false, multiplicity-restriction={severity=ERROR, lower-multiplicity=0, upper-multiplicity-infinite=true}, unresolved-reference-restriction=severity=ERROR
            reference tailoring hwType: in-scope=false, multiplicity-restriction={severity=ERROR, lower-multiplicity=0, upper-multiplicity=1}, unresolved-reference-restriction=severity=ERROR
      9 x concrete class tailoring, all with in-scope=false, multiplicity-restriction={severity=INFO, lower-multiplicity=0, upper-multiplicity-infinite=true}, validation-root=false:
        HwElement
          class content conditional Invariant
            attribute-tailorings:
              aggregation tailoring hwElementConnection: in-scope=false, multiplicity-restriction={severity=ERROR, lower-multiplicity=0, upper-multiplicity-infinite=true}, variation-restriction={severity=ERROR, variation=true, valid-binding-times=[BLUEPRINT-DERIVATION-TIME, SYSTEM-DESIGN-TIME, CODE-GENERATION-TIME, PRE-COMPILE-TIME, LINK-TIME, POST-BUILD]}
              aggregation tailoring hwPinGroup: in-scope=false, multiplicity-restriction={severity=ERROR, lower-multiplicity=0, upper-multiplicity-infinite=true}, variation-restriction={severity=ERROR, variation=true, valid-binding-times=[BLUEPRINT-DERIVATION-TIME, SYSTEM-DESIGN-TIME, CODE-GENERATION-TIME, PRE-COMPILE-TIME, LINK-TIME, POST-BUILD]}
              reference tailoring nestedElement: in-scope=false, multiplicity-restriction={severity=ERROR, lower-multiplicity=0, upper-multiplicity-infinite=true}, variation-restriction={severity=ERROR, variation=true, valid-binding-times=[BLUEPRINT-DERIVATION-TIME, SYSTEM-DESIGN-TIME, CODE-GENERATION-TIME, PRE-COMPILE-TIME, LINK-TIME, POST-BUILD]}, unresolved-reference-restriction=severity=ERROR
        HwElementConnector
          class content conditional Invariant
            attribute-tailorings:
              reference tailoring hwElement: in-scope=false, multiplicity-restriction={severity=ERROR, lower-multiplicity=0, upper-multiplicity=2}, unresolved-reference-restriction=severity=ERROR
              aggregation tailoring hwPinConnection: in-scope=false, multiplicity-restriction={severity=ERROR, lower-multiplicity=0, upper-multiplicity-infinite=true}, variation-restriction={severity=ERROR, variation=true, valid-binding-times=[BLUEPRINT-DERIVATION-TIME, SYSTEM-DESIGN-TIME, CODE-GENERATION-TIME, PRE-COMPILE-TIME, LINK-TIME, POST-BUILD]}
              aggregation tailoring hwPinGroupConnection: in-scope=false, multiplicity-restriction={severity=ERROR, lower-multiplicity=0, upper-multiplicity-infinite=true}, variation-restriction={severity=ERROR, variation=true, valid-binding-times=[BLUEPRINT-DERIVATION-TIME, SYSTEM-DESIGN-TIME, CODE-GENERATION-TIME, PRE-COMPILE-TIME, LINK-TIME, POST-BUILD]}
        HwPin
          class content conditional Invariant
            primitive attribute tailoring pinNumber: in-scope=false, multiplicity-restriction={severity=ERROR, lower-multiplicity=0, upper-multiplicity=1}, default-value-handling=NO-DEFAULT
        HwPinConnector
          class content conditional Invariant
            attribute-tailorings:
              reference tailoring hwPin: in-scope=false, multiplicity-restriction={severity=ERROR, lower-multiplicity=0, upper-multiplicity=2}, unresolved-reference-restriction=severity=ERROR
        HwPinGroup
          class content conditional Invariant
            attribute-tailorings:
              aggregation tailoring hwPinGroupContent: in-scope=false, multiplicity-restriction={severity=ERROR, lower-multiplicity=0, upper-multiplicity=1}
        HwPinGroupConnector
          class content conditional Invariant
            attribute-tailorings:
              aggregation tailoring hwPinConnection: in-scope=false, multiplicity-restriction={severity=ERROR, lower-multiplicity=0, upper-multiplicity-infinite=true}, variation-restriction={severity=ERROR, variation=true, valid-binding-times=[BLUEPRINT-DERIVATION-TIME, SYSTEM-DESIGN-TIME, CODE-GENERATION-TIME, PRE-COMPILE-TIME, LINK-TIME, POST-BUILD]}
              reference tailoring hwPinGroup: in-scope=false, multiplicity-restriction={severity=ERROR, lower-multiplicity=0, upper-multiplicity=2}, unresolved-reference-restriction=severity=ERROR
        HwPinGroupContent
          class content conditional Invariant
            attribute-tailorings:
              aggregation tailoring hwPin: in-scope=false, multiplicity-restriction={severity=ERROR, lower-multiplicity=0, upper-multiplicity-infinite=true}, variation-restriction={severity=ERROR, variation=true, valid-binding-times=[BLUEPRINT-DERIVATION-TIME, SYSTEM-DESIGN-TIME, CODE-GENERATION-TIME, PRE-COMPILE-TIME, LINK-TIME, POST-BUILD]}  # Multiplicity is 0..* since attribute is contained in mixed / mixedString class.
              aggregation tailoring hwPinGroup: in-scope=false, multiplicity-restriction={severity=ERROR, lower-multiplicity=0, upper-multiplicity-infinite=true}, variation-restriction={severity=ERROR, variation=true, valid-binding-times=[BLUEPRINT-DERIVATION-TIME, SYSTEM-DESIGN-TIME, CODE-GENERATION-TIME, PRE-COMPILE-TIME, LINK-TIME, POST-BUILD]}  # Multiplicity is 0..* since attribute is contained in mixed / mixedString class.
        HwPortMapping
          class content conditional Invariant
            attribute-tailorings:
              reference tailoring communicationConnector: in-scope=false, multiplicity-restriction={severity=ERROR, lower-multiplicity=0, upper-multiplicity=1}, unresolved-reference-restriction=severity=ERROR
              reference tailoring hwCommunicationPort: in-scope=false, multiplicity-restriction={severity=ERROR, lower-multiplicity=0, upper-multiplicity=1}, unresolved-reference-restriction=severity=ERROR
        HwType
          class content conditional Invariant
      abstract class tailoring IPdu: multiplicity-restriction={severity=INFO, lower-multiplicity=0, upper-multiplicity-infinite=true}
        class content conditional Invariant
      11 x concrete class tailoring, all with in-scope=false, multiplicity-restriction={severity=INFO, lower-multiplicity=0, upper-multiplicity-infinite=true}, validation-root=false:
        IPduMapping
          class content conditional Invariant
            attribute-tailorings:
              aggregation tailoring introduction: in-scope=false, multiplicity-restriction={severity=ERROR, lower-multiplicity=0, upper-multiplicity=1}
              reference tailoring sourceIPdu: in-scope=false, multiplicity-restriction={severity=ERROR, lower-multiplicity=0, upper-multiplicity=1}, unresolved-reference-restriction=severity=ERROR
              aggregation tailoring targetIPdu: in-scope=false, multiplicity-restriction={severity=ERROR, lower-multiplicity=0, upper-multiplicity=1}
        IPduPort
          class content conditional Invariant
        IPduTiming
          class content conditional Invariant
            attribute-tailorings:
              primitive attribute tailoring minimumDelay: in-scope=false, multiplicity-restriction={severity=ERROR, lower-multiplicity=0, upper-multiplicity=1}, default-value-handling=NO-DEFAULT
              aggregation tailoring transmissionModeDeclaration: in-scope=false, multiplicity-restriction={severity=ERROR, lower-multiplicity=0, upper-multiplicity=1}
        ISignal
          class content conditional Invariant
            attribute-tailorings:
              primitive attribute tailoring dataTypePolicy: in-scope=false, multiplicity-restriction={severity=ERROR, lower-multiplicity=0, upper-multiplicity=1}, default-value-handling=NO-DEFAULT
              aggregation tailoring initValue: in-scope=false, multiplicity-restriction={severity=ERROR, lower-multiplicity=0, upper-multiplicity=1}
              primitive attribute tailoring length: in-scope=false, multiplicity-restriction={severity=ERROR, lower-multiplicity=0, upper-multiplicity=1}, default-value-handling=NO-DEFAULT
              aggregation tailoring networkRepresentationProps: in-scope=false, multiplicity-restriction={severity=ERROR, lower-multiplicity=0, upper-multiplicity=1}
              reference tailoring systemSignal: in-scope=false, multiplicity-restriction={severity=ERROR, lower-multiplicity=0, upper-multiplicity=1}, unresolved-reference-restriction=severity=ERROR
        ISignalGroup
          class content conditional Invariant
            attribute-tailorings:
              reference tailoring iSignal: in-scope=false, multiplicity-restriction={severity=ERROR, lower-multiplicity=0, upper-multiplicity-infinite=true}, unresolved-reference-restriction=severity=ERROR
              reference tailoring systemSignalGroup: in-scope=false, multiplicity-restriction={severity=ERROR, lower-multiplicity=0, upper-multiplicity=1}, unresolved-reference-restriction=severity=ERROR
        ISignalIPdu
          class content conditional Invariant
            attribute-tailorings:
              4 x aggregation tailoring, all with in-scope=false, variation-restriction={severity=ERROR, variation=true, valid-binding-times=[BLUEPRINT-DERIVATION-TIME, SYSTEM-DESIGN-TIME, CODE-GENERATION-TIME, PRE-COMPILE-TIME, LINK-TIME, POST-BUILD]}:
                iPduTimingSpecification: multiplicity-restriction={severity=ERROR, lower-multiplicity=0, upper-multiplicity=1}
                iSignalToPduMapping: multiplicity-restriction={severity=ERROR, lower-multiplicity=0, upper-multiplicity-infinite=true}
                pduCounter: multiplicity-restriction={severity=ERROR, lower-multiplicity=0, upper-multiplicity=1}
                pduReplication: multiplicity-restriction={severity=ERROR, lower-multiplicity=0, upper-multiplicity=1}
              primitive attribute tailoring unusedBitPattern: in-scope=false, multiplicity-restriction={severity=ERROR, lower-multiplicity=0, upper-multiplicity=1}, default-value-handling=NO-DEFAULT
        ISignalIPduGroup
          class content conditional Invariant
            attribute-tailorings:
              primitive attribute tailoring communicationDirection: in-scope=false, multiplicity-restriction={severity=ERROR, lower-multiplicity=0, upper-multiplicity=1}, default-value-handling=NO-DEFAULT
              primitive attribute tailoring communicationMode: in-scope=false, multiplicity-restriction={severity=ERROR, lower-multiplicity=0, upper-multiplicity=1}, default-value-handling=NO-DEFAULT
              reference tailoring containedISignalIPduGroup: in-scope=false, multiplicity-restriction={severity=ERROR, lower-multiplicity=0, upper-multiplicity-infinite=true}, unresolved-reference-restriction=severity=ERROR
              reference tailoring iSignalIPdu: in-scope=false, multiplicity-restriction={severity=ERROR, lower-multiplicity=0, upper-multiplicity-infinite=true}, variation-restriction={severity=ERROR, variation=true, valid-binding-times=[BLUEPRINT-DERIVATION-TIME, SYSTEM-DESIGN-TIME, CODE-GENERATION-TIME, PRE-COMPILE-TIME, LINK-TIME, POST-BUILD]}, unresolved-reference-restriction=severity=ERROR
        ISignalMapping
          class content conditional Invariant
            attribute-tailorings:
              aggregation tailoring introduction: in-scope=false, multiplicity-restriction={severity=ERROR, lower-multiplicity=0, upper-multiplicity=1}
              reference tailoring sourceSignal: in-scope=false, multiplicity-restriction={severity=ERROR, lower-multiplicity=0, upper-multiplicity=1}, unresolved-reference-restriction=severity=ERROR
              reference tailoring targetSignal: in-scope=false, multiplicity-restriction={severity=ERROR, lower-multiplicity=0, upper-multiplicity=1}, unresolved-reference-restriction=severity=ERROR
        ISignalPort
          class content conditional Invariant
            primitive attribute tailoring timeout: in-scope=false, multiplicity-restriction={severity=ERROR, lower-multiplicity=0, upper-multiplicity=1}, default-value-handling=NO-DEFAULT
        ISignalToIPduMapping
          class content conditional Invariant
            attribute-tailorings:
              reference tailoring iSignal: in-scope=false, multiplicity-restriction={severity=ERROR, lower-multiplicity=0, upper-multiplicity=1}, unresolved-reference-restriction=severity=ERROR
              reference tailoring iSignalGroup: in-scope=false, multiplicity-restriction={severity=ERROR, lower-multiplicity=0, upper-multiplicity=1}, unresolved-reference-restriction=severity=ERROR
              4 x primitive attribute tailoring, all with in-scope=false, multiplicity-restriction={severity=ERROR, lower-multiplicity=0, upper-multiplicity=1}, default-value-handling=NO-DEFAULT:
                packingByteOrder
                startPosition
                transferProperty
                updateIndicationBitPosition
        ISignalTriggering
          class content conditional Invariant
            attribute-tailorings:
              reference tailoring iSignal: in-scope=false, multiplicity-restriction={severity=ERROR, lower-multiplicity=0, upper-multiplicity=1}, unresolved-reference-restriction=severity=ERROR
              reference tailoring iSignalGroup: in-scope=false, multiplicity-restriction={severity=ERROR, lower-multiplicity=0, upper-multiplicity=1}, unresolved-reference-restriction=severity=ERROR
              reference tailoring iSignalPort: in-scope=false, multiplicity-restriction={severity=ERROR, lower-multiplicity=0, upper-multiplicity-infinite=true}, unresolved-reference-restriction=severity=ERROR
      abstract class tailoring Identifiable: multiplicity-restriction={severity=INFO, lower-multiplicity=0, upper-multiplicity-infinite=true}
        class content conditional Invariant
          attribute-tailorings:
            aggregation tailoring adminData: in-scope=false, multiplicity-restriction={severity=ERROR, lower-multiplicity=0, upper-multiplicity=1}
            aggregation tailoring annotation: in-scope=false, multiplicity-restriction={severity=ERROR, lower-multiplicity=0, upper-multiplicity-infinite=true}
            primitive attribute tailoring category: in-scope=false, multiplicity-restriction={severity=ERROR, lower-multiplicity=0, upper-multiplicity=1}, default-value-handling=NO-DEFAULT
            aggregation tailoring desc: in-scope=false, multiplicity-restriction={severity=ERROR, lower-multiplicity=0, upper-multiplicity=1}
            aggregation tailoring introduction: in-scope=false, multiplicity-restriction={severity=ERROR, lower-multiplicity=0, upper-multiplicity=1}
            aggregation tailoring longName: in-scope=false, multiplicity-restriction={severity=ERROR, lower-multiplicity=0, upper-multiplicity=1}
            primitive attribute tailoring uuid: in-scope=false, multiplicity-restriction={severity=ERROR, lower-multiplicity=0, upper-multiplicity=1}, default-value-handling=NO-DEFAULT
      abstract class tailoring Implementation: multiplicity-restriction={severity=INFO, lower-multiplicity=0, upper-multiplicity-infinite=true}
        class content conditional Invariant
          attribute-tailorings:
            aggregation tailoring codeDescriptor: in-scope=false, multiplicity-restriction={severity=ERROR, lower-multiplicity=0, upper-multiplicity-infinite=true}
            aggregation tailoring compiler: in-scope=false, multiplicity-restriction={severity=ERROR, lower-multiplicity=0, upper-multiplicity-infinite=true}
            aggregation tailoring generatedArtifact: in-scope=false, multiplicity-restriction={severity=ERROR, lower-multiplicity=0, upper-multiplicity-infinite=true}, variation-restriction={severity=ERROR, variation=true, valid-binding-times=[BLUEPRINT-DERIVATION-TIME, SYSTEM-DESIGN-TIME, CODE-GENERATION-TIME, PRE-COMPILE-TIME, LINK-TIME, POST-BUILD]}
            reference tailoring hwElement: in-scope=false, multiplicity-restriction={severity=ERROR, lower-multiplicity=0, upper-multiplicity-infinite=true}, unresolved-reference-restriction=severity=ERROR
            aggregation tailoring linker: in-scope=false, multiplicity-restriction={severity=ERROR, lower-multiplicity=0, upper-multiplicity-infinite=true}
            aggregation tailoring mcSupport: in-scope=false, multiplicity-restriction={severity=ERROR, lower-multiplicity=0, upper-multiplicity=1}
            primitive attribute tailoring programmingLanguage: in-scope=false, multiplicity-restriction={severity=ERROR, lower-multiplicity=0, upper-multiplicity=1}, default-value-handling=NO-DEFAULT
            aggregation tailoring requiredArtifact: in-scope=false, multiplicity-restriction={severity=ERROR, lower-multiplicity=0, upper-multiplicity-infinite=true}, variation-restriction={severity=ERROR, variation=true, valid-binding-times=[BLUEPRINT-DERIVATION-TIME, SYSTEM-DESIGN-TIME, CODE-GENERATION-TIME, PRE-COMPILE-TIME, LINK-TIME, POST-BUILD]}
            aggregation tailoring requiredGeneratorTool: in-scope=false, multiplicity-restriction={severity=ERROR, lower-multiplicity=0, upper-multiplicity-infinite=true}, variation-restriction={severity=ERROR, variation=true, valid-binding-times=[BLUEPRINT-DERIVATION-TIME, SYSTEM-DESIGN-TIME, CODE-GENERATION-TIME, PRE-COMPILE-TIME, LINK-TIME, POST-BUILD]}
            aggregation tailoring resourceConsumption: in-scope=false, multiplicity-restriction={severity=ERROR, lower-multiplicity=0, upper-multiplicity=1}
            primitive attribute tailoring swVersion: in-scope=false, multiplicity-restriction={severity=ERROR, lower-multiplicity=0, upper-multiplicity=1}, default-value-handling=NO-DEFAULT
            reference tailoring swcBswMapping: in-scope=false, multiplicity-restriction={severity=ERROR, lower-multiplicity=0, upper-multiplicity=1}, unresolved-reference-restriction=severity=ERROR
            primitive attribute tailoring usedCodeGenerator: in-scope=false, multiplicity-restriction={severity=ERROR, lower-multiplicity=0, upper-multiplicity=1}, default-value-handling=NO-DEFAULT
            primitive attribute tailoring vendorId: in-scope=false, multiplicity-restriction={severity=ERROR, lower-multiplicity=0, upper-multiplicity=1}, default-value-handling=NO-DEFAULT
      10 x concrete class tailoring, all with in-scope=false, multiplicity-restriction={severity=INFO, lower-multiplicity=0, upper-multiplicity-infinite=true}, validation-root=false:
        ImplementationDataType
          class content conditional Invariant
            attribute-tailorings:
              aggregation tailoring subElement: in-scope=false, multiplicity-restriction={severity=ERROR, lower-multiplicity=0, upper-multiplicity-infinite=true}, variation-restriction={severity=ERROR, variation=true, valid-binding-times=[BLUEPRINT-DERIVATION-TIME, SYSTEM-DESIGN-TIME, CODE-GENERATION-TIME, PRE-COMPILE-TIME, LINK-TIME, POST-BUILD]}
        ImplementationDataTypeElement
          class content conditional Invariant
            attribute-tailorings:
              primitive attribute tailoring arraySize: in-scope=false, multiplicity-restriction={severity=ERROR, lower-multiplicity=0, upper-multiplicity=1}, variation-restriction={severity=ERROR, variation=true, valid-binding-times=[BLUEPRINT-DERIVATION-TIME, SYSTEM-DESIGN-TIME, CODE-GENERATION-TIME, PRE-COMPILE-TIME, LINK-TIME, POST-BUILD]}, default-value-handling=NO-DEFAULT
              primitive attribute tailoring arraySizeSemantics: in-scope=false, multiplicity-restriction={severity=ERROR, lower-multiplicity=0, upper-multiplicity=1}, default-value-handling=NO-DEFAULT
              aggregation tailoring subElement: in-scope=false, multiplicity-restriction={severity=ERROR, lower-multiplicity=0, upper-multiplicity-infinite=true}, variation-restriction={severity=ERROR, variation=true, valid-binding-times=[BLUEPRINT-DERIVATION-TIME, SYSTEM-DESIGN-TIME, CODE-GENERATION-TIME, PRE-COMPILE-TIME, LINK-TIME, POST-BUILD]}
              aggregation tailoring swDataDefProps: in-scope=false, multiplicity-restriction={severity=ERROR, lower-multiplicity=0, upper-multiplicity=1}
        ImplementationElementInParameterInstanceRef
          class content conditional Invariant
            attribute-tailorings:
              reference tailoring context: in-scope=false, multiplicity-restriction={severity=ERROR, lower-multiplicity=0, upper-multiplicity=1}, unresolved-reference-restriction=severity=ERROR
              reference tailoring target: in-scope=false, multiplicity-restriction={severity=ERROR, lower-multiplicity=0, upper-multiplicity=1}, unresolved-reference-restriction=severity=ERROR
        IncludedDataTypeSet
          class content conditional Invariant
            attribute-tailorings:
              reference tailoring dataType: in-scope=false, multiplicity-restriction={severity=ERROR, lower-multiplicity=0, upper-multiplicity-infinite=true}, unresolved-reference-restriction=severity=ERROR
              primitive attribute tailoring literalPrefix: in-scope=false, multiplicity-restriction={severity=ERROR, lower-multiplicity=0, upper-multiplicity=1}, default-value-handling=NO-DEFAULT
        IndentSample
          class content conditional Invariant
            attribute-tailorings:
              primitive attribute tailoring itemLabelPos: in-scope=false, multiplicity-restriction={severity=ERROR, lower-multiplicity=0, upper-multiplicity=1}, default-value-handling=NO-DEFAULT
              aggregation tailoring l2: in-scope=false, multiplicity-restriction={severity=ERROR, lower-multiplicity=0, upper-multiplicity-infinite=true}
        IndexEntry
          class content conditional Invariant
            primitive attribute tailoring sub: in-scope=false, multiplicity-restriction={severity=ERROR, lower-multiplicity=0, upper-multiplicity-infinite=true}, default-value-handling=NO-DEFAULT  # Multiplicity is 0..* since attribute is contained in mixed / mixedString class.
            primitive attribute tailoring sup: in-scope=false, multiplicity-restriction={severity=ERROR, lower-multiplicity=0, upper-multiplicity-infinite=true}, default-value-handling=NO-DEFAULT  # Multiplicity is 0..* since attribute is contained in mixed / mixedString class.
        IndexedArrayElement
          class content conditional Invariant
            attribute-tailorings:
              reference tailoring applicationArrayElement: in-scope=false, multiplicity-restriction={severity=ERROR, lower-multiplicity=0, upper-multiplicity=1}, unresolved-reference-restriction=severity=ERROR
              reference tailoring implementationArrayElement: in-scope=false, multiplicity-restriction={severity=ERROR, lower-multiplicity=0, upper-multiplicity=1}, unresolved-reference-restriction=severity=ERROR
              primitive attribute tailoring index: in-scope=false, multiplicity-restriction={severity=ERROR, lower-multiplicity=0, upper-multiplicity=1}, default-value-handling=NO-DEFAULT
        InnerPortGroupInCompositionInstanceRef
          class content conditional Invariant
            attribute-tailorings:
              reference tailoring context: in-scope=false, multiplicity-restriction={severity=ERROR, lower-multiplicity=0, upper-multiplicity-infinite=true}, unresolved-reference-restriction=severity=ERROR
              reference tailoring target: in-scope=false, multiplicity-restriction={severity=ERROR, lower-multiplicity=0, upper-multiplicity=1}, unresolved-reference-restriction=severity=ERROR
        InstantiationDataDefProps
          class content conditional Invariant
            attribute-tailorings:
              aggregation tailoring parameterInstance: in-scope=false, multiplicity-restriction={severity=ERROR, lower-multiplicity=0, upper-multiplicity=1}
              aggregation tailoring swDataDefProps: in-scope=false, multiplicity-restriction={severity=ERROR, lower-multiplicity=0, upper-multiplicity=1}
              aggregation tailoring variableInstance: in-scope=false, multiplicity-restriction={severity=ERROR, lower-multiplicity=0, upper-multiplicity=1}
        IntegerValueVariationPoint
          class content conditional Invariant
      abstract class tailoring InternalBehavior: multiplicity-restriction={severity=INFO, lower-multiplicity=0, upper-multiplicity-infinite=true}
        class content conditional Invariant
          attribute-tailorings:
            aggregation tailoring constantMemory: in-scope=false, multiplicity-restriction={severity=ERROR, lower-multiplicity=0, upper-multiplicity-infinite=true}, variation-restriction={severity=ERROR, variation=true, valid-binding-times=[BLUEPRINT-DERIVATION-TIME, SYSTEM-DESIGN-TIME, CODE-GENERATION-TIME, PRE-COMPILE-TIME, LINK-TIME, POST-BUILD]}
            reference tailoring constantValueMapping: in-scope=false, multiplicity-restriction={severity=ERROR, lower-multiplicity=0, upper-multiplicity-infinite=true}, unresolved-reference-restriction=severity=ERROR
            reference tailoring dataTypeMapping: in-scope=false, multiplicity-restriction={severity=ERROR, lower-multiplicity=0, upper-multiplicity-infinite=true}, unresolved-reference-restriction=severity=ERROR
            aggregation tailoring exclusiveArea: in-scope=false, multiplicity-restriction={severity=ERROR, lower-multiplicity=0, upper-multiplicity-infinite=true}, variation-restriction={severity=ERROR, variation=true, valid-binding-times=[BLUEPRINT-DERIVATION-TIME, SYSTEM-DESIGN-TIME, CODE-GENERATION-TIME, PRE-COMPILE-TIME, LINK-TIME, POST-BUILD]}
            aggregation tailoring staticMemory: in-scope=false, multiplicity-restriction={severity=ERROR, lower-multiplicity=0, upper-multiplicity-infinite=true}, variation-restriction={severity=ERROR, variation=true, valid-binding-times=[BLUEPRINT-DERIVATION-TIME, SYSTEM-DESIGN-TIME, CODE-GENERATION-TIME, PRE-COMPILE-TIME, LINK-TIME, POST-BUILD]}
      8 x concrete class tailoring, all with in-scope=false, multiplicity-restriction={severity=INFO, lower-multiplicity=0, upper-multiplicity-infinite=true}, validation-root=false:
        InternalConstrs
          class content conditional Invariant
            attribute-tailorings:
              aggregation tailoring lowerLimit: in-scope=false, multiplicity-restriction={severity=ERROR, lower-multiplicity=0, upper-multiplicity=1}
              primitive attribute tailoring maxDiff: in-scope=false, multiplicity-restriction={severity=ERROR, lower-multiplicity=0, upper-multiplicity=1}, default-value-handling=NO-DEFAULT
              primitive attribute tailoring maxGradient: in-scope=false, multiplicity-restriction={severity=ERROR, lower-multiplicity=0, upper-multiplicity=1}, default-value-handling=NO-DEFAULT
              primitive attribute tailoring monotony: in-scope=false, multiplicity-restriction={severity=ERROR, lower-multiplicity=0, upper-multiplicity=1}, default-value-handling=NO-DEFAULT
              aggregation tailoring scaleConstr: in-scope=false, multiplicity-restriction={severity=ERROR, lower-multiplicity=0, upper-multiplicity-infinite=true}
              aggregation tailoring swRelatedConstrs: in-scope=false, multiplicity-restriction={severity=ERROR, lower-multiplicity=0, upper-multiplicity=1}
              aggregation tailoring upperLimit: in-scope=false, multiplicity-restriction={severity=ERROR, lower-multiplicity=0, upper-multiplicity=1}
        InternalTriggerOccurredEvent
          class content conditional Invariant
            attribute-tailorings:
              reference tailoring eventSource: in-scope=false, multiplicity-restriction={severity=ERROR, lower-multiplicity=0, upper-multiplicity=1}, unresolved-reference-restriction=severity=ERROR
        InternalTriggeringPoint
          class content conditional Invariant
        InterpolationRoutine
          class content conditional Invariant
            attribute-tailorings:
              reference tailoring interpolationRoutine: in-scope=false, multiplicity-restriction={severity=ERROR, lower-multiplicity=0, upper-multiplicity=1}, unresolved-reference-restriction=severity=ERROR
              primitive attribute tailoring isDefault: in-scope=false, multiplicity-restriction={severity=ERROR, lower-multiplicity=0, upper-multiplicity=1}, default-value-handling=NO-DEFAULT
              primitive attribute tailoring shortLabel: in-scope=false, multiplicity-restriction={severity=ERROR, lower-multiplicity=0, upper-multiplicity=1}, default-value-handling=NO-DEFAULT
        InterpolationRoutineMapping
          class content conditional Invariant
            attribute-tailorings:
              aggregation tailoring interpolationRoutine: in-scope=false, multiplicity-restriction={severity=ERROR, lower-multiplicity=0, upper-multiplicity-infinite=true}
              reference tailoring swRecordLayout: in-scope=false, multiplicity-restriction={severity=ERROR, lower-multiplicity=0, upper-multiplicity=1}, unresolved-reference-restriction=severity=ERROR
        InterpolationRoutineMappingSet
          class content conditional Invariant
            attribute-tailorings:
              aggregation tailoring interpolationRoutineMapping: in-scope=false, multiplicity-restriction={severity=ERROR, lower-multiplicity=0, upper-multiplicity-infinite=true}
        InvalidationPolicy
          class content conditional Invariant
            attribute-tailorings:
              reference tailoring dataElement: in-scope=false, multiplicity-restriction={severity=ERROR, lower-multiplicity=0, upper-multiplicity=1}, unresolved-reference-restriction=severity=ERROR
              primitive attribute tailoring handleInvalid: in-scope=false, multiplicity-restriction={severity=ERROR, lower-multiplicity=0, upper-multiplicity=1}, default-value-handling=NO-DEFAULT
        IoHwAbstractionServerAnnotation
          class content conditional Invariant
            attribute-tailorings:
              aggregation tailoring age: in-scope=false, multiplicity-restriction={severity=ERROR, lower-multiplicity=0, upper-multiplicity=1}
              reference tailoring argument: in-scope=false, multiplicity-restriction={severity=ERROR, lower-multiplicity=0, upper-multiplicity=1}, unresolved-reference-restriction=severity=ERROR
              primitive attribute tailoring bswResolution: in-scope=false, multiplicity-restriction={severity=ERROR, lower-multiplicity=0, upper-multiplicity=1}, default-value-handling=NO-DEFAULT
              reference tailoring dataElement: in-scope=false, multiplicity-restriction={severity=ERROR, lower-multiplicity=0, upper-multiplicity=1}, unresolved-reference-restriction=severity=ERROR
              reference tailoring failureMonitoring: in-scope=false, multiplicity-restriction={severity=ERROR, lower-multiplicity=0, upper-multiplicity=1}, unresolved-reference-restriction=severity=ERROR
              primitive attribute tailoring filteringDebouncing: in-scope=false, multiplicity-restriction={severity=ERROR, lower-multiplicity=0, upper-multiplicity=1}, default-value-handling=NO-DEFAULT
              primitive attribute tailoring pulseTest: in-scope=false, multiplicity-restriction={severity=ERROR, lower-multiplicity=0, upper-multiplicity=1}, default-value-handling=NO-DEFAULT
      abstract class tailoring IsSyscond: multiplicity-restriction={severity=INFO, lower-multiplicity=0, upper-multiplicity-infinite=true}
        class content conditional Invariant
          attribute-tailorings:
            aggregation tailoring swSyscond: in-scope=false, multiplicity-restriction={severity=ERROR, lower-multiplicity=0, upper-multiplicity=1}
      15 x concrete class tailoring, all with in-scope=false, multiplicity-restriction={severity=INFO, lower-multiplicity=0, upper-multiplicity-infinite=true}, validation-root=false:
        Item
          class content conditional Invariant
            attribute-tailorings:
              aggregation tailoring itemContents: in-scope=false, multiplicity-restriction={severity=ERROR, lower-multiplicity=0, upper-multiplicity=1}
        J1939TpConfig
          class content conditional Invariant
            attribute-tailorings:
              aggregation tailoring tpAddress: in-scope=false, multiplicity-restriction={severity=ERROR, lower-multiplicity=0, upper-multiplicity-infinite=true}, variation-restriction={severity=ERROR, variation=true, valid-binding-times=[BLUEPRINT-DERIVATION-TIME, SYSTEM-DESIGN-TIME, CODE-GENERATION-TIME, PRE-COMPILE-TIME, LINK-TIME, POST-BUILD]}
              aggregation tailoring tpConnection: in-scope=false, multiplicity-restriction={severity=ERROR, lower-multiplicity=0, upper-multiplicity-infinite=true}, variation-restriction={severity=ERROR, variation=true, valid-binding-times=[BLUEPRINT-DERIVATION-TIME, SYSTEM-DESIGN-TIME, CODE-GENERATION-TIME, PRE-COMPILE-TIME, LINK-TIME, POST-BUILD]}
              aggregation tailoring tpNode: in-scope=false, multiplicity-restriction={severity=ERROR, lower-multiplicity=0, upper-multiplicity-infinite=true}, variation-restriction={severity=ERROR, variation=true, valid-binding-times=[BLUEPRINT-DERIVATION-TIME, SYSTEM-DESIGN-TIME, CODE-GENERATION-TIME, PRE-COMPILE-TIME, LINK-TIME, POST-BUILD]}
        J1939TpConnection
          class content conditional Invariant
            attribute-tailorings:
              primitive attribute tailoring broadcast: in-scope=false, multiplicity-restriction={severity=ERROR, lower-multiplicity=0, upper-multiplicity=1}, default-value-handling=NO-DEFAULT
              6 x reference tailoring, all with in-scope=false, unresolved-reference-restriction=severity=ERROR:
                dataPdu: multiplicity-restriction={severity=ERROR, lower-multiplicity=0, upper-multiplicity=1}
                directPdu: multiplicity-restriction={severity=ERROR, lower-multiplicity=0, upper-multiplicity=1}
                flowControlPdu: multiplicity-restriction={severity=ERROR, lower-multiplicity=0, upper-multiplicity=2}
                receiver: multiplicity-restriction={severity=ERROR, lower-multiplicity=0, upper-multiplicity-infinite=true}
                tpSdu: multiplicity-restriction={severity=ERROR, lower-multiplicity=0, upper-multiplicity-infinite=true}
                transmitter: multiplicity-restriction={severity=ERROR, lower-multiplicity=0, upper-multiplicity=1}
        J1939TpNode
          class content conditional Invariant
            attribute-tailorings:
              reference tailoring connector: in-scope=false, multiplicity-restriction={severity=ERROR, lower-multiplicity=0, upper-multiplicity=1}, unresolved-reference-restriction=severity=ERROR
              reference tailoring tpAddress: in-scope=false, multiplicity-restriction={severity=ERROR, lower-multiplicity=0, upper-multiplicity=1}, unresolved-reference-restriction=severity=ERROR
        KeyData
          class content conditional Invariant
            attribute-tailorings:
              aggregation tailoring freeInfo: in-scope=false, multiplicity-restriction={severity=ERROR, lower-multiplicity=0, upper-multiplicity=1}
              aggregation tailoring introduction: in-scope=false, multiplicity-restriction={severity=ERROR, lower-multiplicity=0, upper-multiplicity=1}
              reference tailoring prm: in-scope=false, multiplicity-restriction={severity=ERROR, lower-multiplicity=0, upper-multiplicity-infinite=true}, unresolved-reference-restriction=severity=ERROR
        Keyword
          class content conditional Invariant
            primitive attribute tailoring classification: in-scope=false, multiplicity-restriction={severity=ERROR, lower-multiplicity=0, upper-multiplicity-infinite=true}, default-value-handling=NO-DEFAULT
        KeywordSet
          class content conditional Invariant
            attribute-tailorings:
              aggregation tailoring keyword: in-scope=false, multiplicity-restriction={severity=ERROR, lower-multiplicity=0, upper-multiplicity-infinite=true}
        LGraphic
          class content conditional Invariant
            attribute-tailorings:
              aggregation tailoring graphic: in-scope=false, multiplicity-restriction={severity=ERROR, lower-multiplicity=0, upper-multiplicity=1}
              aggregation tailoring map: in-scope=false, multiplicity-restriction={severity=ERROR, lower-multiplicity=0, upper-multiplicity=1}
        LLongName
          class content conditional Invariant
        LOverviewParagraph
          class content conditional Invariant
        LParagraph
          class content conditional Invariant
        LPlainText
          class content conditional Invariant
        LVerbatim
          class content conditional Invariant
        LabeledItem
          class content conditional Invariant
            attribute-tailorings:
              primitive attribute tailoring helpEntry: in-scope=false, multiplicity-restriction={severity=ERROR, lower-multiplicity=0, upper-multiplicity=1}, default-value-handling=NO-DEFAULT
              aggregation tailoring itemContents: in-scope=false, multiplicity-restriction={severity=ERROR, lower-multiplicity=0, upper-multiplicity=1}
              aggregation tailoring itemLabel: in-scope=false, multiplicity-restriction={severity=ERROR, lower-multiplicity=0, upper-multiplicity=1}
        LabeledList
          class content conditional Invariant
            attribute-tailorings:
              aggregation tailoring indentSample: in-scope=false, multiplicity-restriction={severity=ERROR, lower-multiplicity=0, upper-multiplicity=1}
              aggregation tailoring labeledItem: in-scope=false, multiplicity-restriction={severity=ERROR, lower-multiplicity=0, upper-multiplicity-infinite=true}, variation-restriction={severity=ERROR, variation=true, valid-binding-times=[BLUEPRINT-DERIVATION-TIME, SYSTEM-DESIGN-TIME, CODE-GENERATION-TIME, PRE-COMPILE-TIME, LINK-TIME, POST-BUILD]}
      abstract class tailoring LanguageSpecific: multiplicity-restriction={severity=INFO, lower-multiplicity=0, upper-multiplicity-infinite=true}
        class content conditional Invariant
          primitive attribute tailoring l: in-scope=false, multiplicity-restriction={severity=ERROR, lower-multiplicity=1, upper-multiplicity=1}, default-value-handling=NO-DEFAULT
      4 x concrete class tailoring, all with in-scope=false, multiplicity-restriction={severity=INFO, lower-multiplicity=0, upper-multiplicity-infinite=true}, validation-root=false:
        LatencyTimingConstraint
          class content conditional Invariant
            attribute-tailorings:
              primitive attribute tailoring latencyConstraintType: in-scope=false, multiplicity-restriction={severity=ERROR, lower-multiplicity=0, upper-multiplicity=1}, default-value-handling=NO-DEFAULT
              aggregation tailoring maximum: in-scope=false, multiplicity-restriction={severity=ERROR, lower-multiplicity=0, upper-multiplicity=1}
              aggregation tailoring minimum: in-scope=false, multiplicity-restriction={severity=ERROR, lower-multiplicity=0, upper-multiplicity=1}
              aggregation tailoring nominal: in-scope=false, multiplicity-restriction={severity=ERROR, lower-multiplicity=0, upper-multiplicity=1}
              reference tailoring scope: in-scope=false, multiplicity-restriction={severity=ERROR, lower-multiplicity=0, upper-multiplicity=1}, unresolved-reference-restriction=severity=ERROR
        Limit
          class content conditional Invariant
            primitive attribute tailoring intervalType: in-scope=false, multiplicity-restriction={severity=ERROR, lower-multiplicity=0, upper-multiplicity=1}, default-value-handling=NO-DEFAULT
        LinCluster
          class content conditional Invariant
        LinCommunicationConnector
          class content conditional Invariant
            attribute-tailorings:
              primitive attribute tailoring initialNad: in-scope=false, multiplicity-restriction={severity=ERROR, lower-multiplicity=0, upper-multiplicity=1}, default-value-handling=NO-DEFAULT
              aggregation tailoring linConfigurableFrame: in-scope=false, multiplicity-restriction={severity=ERROR, lower-multiplicity=0, upper-multiplicity-infinite=true}
              aggregation tailoring linOrderedConfigurableFrame: in-scope=false, multiplicity-restriction={severity=ERROR, lower-multiplicity=0, upper-multiplicity-infinite=true}
      abstract class tailoring LinCommunicationController: multiplicity-restriction={severity=INFO, lower-multiplicity=0, upper-multiplicity-infinite=true}
        class content conditional Invariant
          primitive attribute tailoring protocolVersion: in-scope=false, multiplicity-restriction={severity=ERROR, lower-multiplicity=0, upper-multiplicity=1}, default-value-handling=NO-DEFAULT
      concrete class tailoring LinConfigurableFrame: in-scope=false, multiplicity-restriction={severity=INFO, lower-multiplicity=0, upper-multiplicity-infinite=true}, validation-root=false
        class content conditional Invariant
          attribute-tailorings:
            reference tailoring frame: in-scope=false, multiplicity-restriction={severity=ERROR, lower-multiplicity=0, upper-multiplicity=1}, unresolved-reference-restriction=severity=ERROR
            primitive attribute tailoring messageId: in-scope=false, multiplicity-restriction={severity=ERROR, lower-multiplicity=0, upper-multiplicity=1}, default-value-handling=NO-DEFAULT
      abstract class tailoring LinConfigurationEntry: multiplicity-restriction={severity=INFO, lower-multiplicity=0, upper-multiplicity-infinite=true}
        class content conditional Invariant
          attribute-tailorings:
            reference tailoring assignedController: in-scope=false, multiplicity-restriction={severity=ERROR, lower-multiplicity=0, upper-multiplicity=1}, unresolved-reference-restriction=severity=ERROR
      concrete class tailoring LinErrorResponse: in-scope=false, multiplicity-restriction={severity=INFO, lower-multiplicity=0, upper-multiplicity-infinite=true}, validation-root=false
        class content conditional Invariant
          attribute-tailorings:
            reference tailoring frameTriggering: in-scope=false, multiplicity-restriction={severity=ERROR, lower-multiplicity=0, upper-multiplicity=1}, unresolved-reference-restriction=severity=ERROR
            primitive attribute tailoring responseErrorPosition: in-scope=false, multiplicity-restriction={severity=ERROR, lower-multiplicity=0, upper-multiplicity=1}, default-value-handling=NO-DEFAULT
      concrete class tailoring LinEventTriggeredFrame: in-scope=false, multiplicity-restriction={severity=INFO, lower-multiplicity=0, upper-multiplicity-infinite=true}, validation-root=false
        class content conditional Invariant
          attribute-tailorings:
            reference tailoring collisionResolvingSchedule: in-scope=false, multiplicity-restriction={severity=ERROR, lower-multiplicity=0, upper-multiplicity=1}, unresolved-reference-restriction=severity=ERROR
            reference tailoring linUnconditionalFrame: in-scope=false, multiplicity-restriction={severity=ERROR, lower-multiplicity=0, upper-multiplicity-infinite=true}, unresolved-reference-restriction=severity=ERROR
      abstract class tailoring LinFrame: multiplicity-restriction={severity=INFO, lower-multiplicity=0, upper-multiplicity-infinite=true}
        class content conditional Invariant
      16 x concrete class tailoring, all with in-scope=false, multiplicity-restriction={severity=INFO, lower-multiplicity=0, upper-multiplicity-infinite=true}, validation-root=false:
        LinFrameTriggering
          class content conditional Invariant
            primitive attribute tailoring identifier: in-scope=false, multiplicity-restriction={severity=ERROR, lower-multiplicity=0, upper-multiplicity=1}, default-value-handling=NO-DEFAULT
            primitive attribute tailoring linChecksum: in-scope=false, multiplicity-restriction={severity=ERROR, lower-multiplicity=0, upper-multiplicity=1}, default-value-handling=NO-DEFAULT
        LinMaster
          class content conditional Invariant
            primitive attribute tailoring timeBase: in-scope=false, multiplicity-restriction={severity=ERROR, lower-multiplicity=0, upper-multiplicity=1}, default-value-handling=NO-DEFAULT
            primitive attribute tailoring timeBaseJitter: in-scope=false, multiplicity-restriction={severity=ERROR, lower-multiplicity=0, upper-multiplicity=1}, default-value-handling=NO-DEFAULT
        LinOrderedConfigurableFrame
          class content conditional Invariant
            attribute-tailorings:
              reference tailoring frame: in-scope=false, multiplicity-restriction={severity=ERROR, lower-multiplicity=0, upper-multiplicity=1}, unresolved-reference-restriction=severity=ERROR
              primitive attribute tailoring index: in-scope=false, multiplicity-restriction={severity=ERROR, lower-multiplicity=0, upper-multiplicity=1}, default-value-handling=NO-DEFAULT
        LinPhysicalChannel
          class content conditional Invariant
            attribute-tailorings:
              aggregation tailoring scheduleTable: in-scope=false, multiplicity-restriction={severity=ERROR, lower-multiplicity=0, upper-multiplicity-infinite=true}, variation-restriction={severity=ERROR, variation=true, valid-binding-times=[BLUEPRINT-DERIVATION-TIME, SYSTEM-DESIGN-TIME, CODE-GENERATION-TIME, PRE-COMPILE-TIME, LINK-TIME, POST-BUILD]}
        LinScheduleTable
          class content conditional Invariant
            attribute-tailorings:
              primitive attribute tailoring resumePosition: in-scope=false, multiplicity-restriction={severity=ERROR, lower-multiplicity=0, upper-multiplicity=1}, default-value-handling=NO-DEFAULT
              primitive attribute tailoring runMode: in-scope=false, multiplicity-restriction={severity=ERROR, lower-multiplicity=0, upper-multiplicity=1}, default-value-handling=NO-DEFAULT
              aggregation tailoring tableEntry: in-scope=false, multiplicity-restriction={severity=ERROR, lower-multiplicity=0, upper-multiplicity-infinite=true}
        LinSlave
          class content conditional Invariant
            attribute-tailorings:
              primitive attribute tailoring configuredNad: in-scope=false, multiplicity-restriction={severity=ERROR, lower-multiplicity=0, upper-multiplicity=1}, default-value-handling=NO-DEFAULT
              primitive attribute tailoring functionId: in-scope=false, multiplicity-restriction={severity=ERROR, lower-multiplicity=0, upper-multiplicity=1}, default-value-handling=NO-DEFAULT
              aggregation tailoring linErrorResponse: in-scope=false, multiplicity-restriction={severity=ERROR, lower-multiplicity=0, upper-multiplicity=1}
              primitive attribute tailoring supplierId: in-scope=false, multiplicity-restriction={severity=ERROR, lower-multiplicity=0, upper-multiplicity=1}, default-value-handling=NO-DEFAULT
              primitive attribute tailoring variantId: in-scope=false, multiplicity-restriction={severity=ERROR, lower-multiplicity=0, upper-multiplicity=1}, default-value-handling=NO-DEFAULT
        LinSporadicFrame
          class content conditional Invariant
            attribute-tailorings:
              reference tailoring substitutedFrame: in-scope=false, multiplicity-restriction={severity=ERROR, lower-multiplicity=0, upper-multiplicity-infinite=true}, unresolved-reference-restriction=severity=ERROR
        LinTpConfig
          class content conditional Invariant
            attribute-tailorings:
              aggregation tailoring tpAddress: in-scope=false, multiplicity-restriction={severity=ERROR, lower-multiplicity=0, upper-multiplicity-infinite=true}, variation-restriction={severity=ERROR, variation=true, valid-binding-times=[BLUEPRINT-DERIVATION-TIME, SYSTEM-DESIGN-TIME, CODE-GENERATION-TIME, PRE-COMPILE-TIME, LINK-TIME, POST-BUILD]}
              aggregation tailoring tpConnection: in-scope=false, multiplicity-restriction={severity=ERROR, lower-multiplicity=0, upper-multiplicity=2}, variation-restriction={severity=ERROR, variation=true, valid-binding-times=[BLUEPRINT-DERIVATION-TIME, SYSTEM-DESIGN-TIME, CODE-GENERATION-TIME, PRE-COMPILE-TIME, LINK-TIME, POST-BUILD]}
              aggregation tailoring tpNode: in-scope=false, multiplicity-restriction={severity=ERROR, lower-multiplicity=0, upper-multiplicity-infinite=true}, variation-restriction={severity=ERROR, variation=true, valid-binding-times=[BLUEPRINT-DERIVATION-TIME, SYSTEM-DESIGN-TIME, CODE-GENERATION-TIME, PRE-COMPILE-TIME, LINK-TIME, POST-BUILD]}
        LinTpConnection
          class content conditional Invariant
            attribute-tailorings:
              6 x reference tailoring, all with in-scope=false, unresolved-reference-restriction=severity=ERROR:
                dataPdu: multiplicity-restriction={severity=ERROR, lower-multiplicity=0, upper-multiplicity=1}
                flowControl: multiplicity-restriction={severity=ERROR, lower-multiplicity=0, upper-multiplicity=1}
                linTpNSdu: multiplicity-restriction={severity=ERROR, lower-multiplicity=0, upper-multiplicity=1}
                multicast: multiplicity-restriction={severity=ERROR, lower-multiplicity=0, upper-multiplicity=1}
                receiver: multiplicity-restriction={severity=ERROR, lower-multiplicity=0, upper-multiplicity-infinite=true}
                transmitter: multiplicity-restriction={severity=ERROR, lower-multiplicity=0, upper-multiplicity=1}
        LinTpNode
          class content conditional Invariant
            attribute-tailorings:
              reference tailoring connector: in-scope=false, multiplicity-restriction={severity=ERROR, lower-multiplicity=0, upper-multiplicity=1}, unresolved-reference-restriction=severity=ERROR
              primitive attribute tailoring maxNumberOfRespPendingFrames: in-scope=false, multiplicity-restriction={severity=ERROR, lower-multiplicity=0, upper-multiplicity=1}, default-value-handling=NO-DEFAULT
              primitive attribute tailoring p2Max: in-scope=false, multiplicity-restriction={severity=ERROR, lower-multiplicity=0, upper-multiplicity=1}, default-value-handling=NO-DEFAULT
              primitive attribute tailoring p2Timing: in-scope=false, multiplicity-restriction={severity=ERROR, lower-multiplicity=0, upper-multiplicity=1}, default-value-handling=NO-DEFAULT
              reference tailoring tpAddress: in-scope=false, multiplicity-restriction={severity=ERROR, lower-multiplicity=0, upper-multiplicity=1}, unresolved-reference-restriction=severity=ERROR
        LinUnconditionalFrame
          class content conditional Invariant
        Linker
          class content conditional Invariant
            4 x primitive attribute tailoring, all with in-scope=false, multiplicity-restriction={severity=ERROR, lower-multiplicity=0, upper-multiplicity=1}, default-value-handling=NO-DEFAULT:
              name
              options
              vendor
              version
        List
          class content conditional Invariant
            attribute-tailorings:
              aggregation tailoring item: in-scope=false, multiplicity-restriction={severity=ERROR, lower-multiplicity=0, upper-multiplicity-infinite=true}, variation-restriction={severity=ERROR, variation=true, valid-binding-times=[BLUEPRINT-DERIVATION-TIME, SYSTEM-DESIGN-TIME, CODE-GENERATION-TIME, PRE-COMPILE-TIME, LINK-TIME, POST-BUILD]}
              primitive attribute tailoring type: in-scope=false, multiplicity-restriction={severity=ERROR, lower-multiplicity=0, upper-multiplicity=1}, default-value-handling=NO-DEFAULT
        Locs
          class content conditional Invariant
            attribute-tailorings:
              aggregation tailoring nameloc: in-scope=false, multiplicity-restriction={severity=ERROR, lower-multiplicity=0, upper-multiplicity-infinite=true}
        LogicAddress
          class content conditional Invariant
            primitive attribute tailoring address: in-scope=false, multiplicity-restriction={severity=ERROR, lower-multiplicity=0, upper-multiplicity=1}, default-value-handling=NO-DEFAULT
        Map
          class content conditional Invariant
            attribute-tailorings:
              aggregation tailoring area: in-scope=false, multiplicity-restriction={severity=ERROR, lower-multiplicity=0, upper-multiplicity-infinite=true}
              14 x primitive attribute tailoring, all with in-scope=false, multiplicity-restriction={severity=ERROR, lower-multiplicity=0, upper-multiplicity=1}, default-value-handling=NO-DEFAULT:
                class
                name
                onclick
                ondblclick
                onkeydown
                onkeypress
                onkeyup
                onmousedown
                onmousemove
                onmouseout
                onmouseover
                onmouseup
                style
                title
      abstract class tailoring MappingConstraint: multiplicity-restriction={severity=INFO, lower-multiplicity=0, upper-multiplicity-infinite=true}
        class content conditional Invariant
          attribute-tailorings:
            aggregation tailoring introduction: in-scope=false, multiplicity-restriction={severity=ERROR, lower-multiplicity=0, upper-multiplicity=1}
      concrete class tailoring MatchingDci: in-scope=false, multiplicity-restriction={severity=INFO, lower-multiplicity=0, upper-multiplicity-infinite=true}, validation-root=false
        class content conditional Invariant
          attribute-tailorings:
            aggregation tailoring label: in-scope=false, multiplicity-restriction={severity=ERROR, lower-multiplicity=0, upper-multiplicity=1}
            aggregation tailoring remark: in-scope=false, multiplicity-restriction={severity=ERROR, lower-multiplicity=0, upper-multiplicity=1}
            primitive attribute tailoring shortLabel: in-scope=false, multiplicity-restriction={severity=ERROR, lower-multiplicity=0, upper-multiplicity=1}, default-value-handling=NO-DEFAULT
            aggregation tailoring url: in-scope=false, multiplicity-restriction={severity=ERROR, lower-multiplicity=0, upper-multiplicity=1}
      concrete class tailoring McBlobConts: in-scope=false, multiplicity-restriction={severity=INFO, lower-multiplicity=0, upper-multiplicity-infinite=true}, validation-root=false
        class content conditional Invariant
          attribute-tailorings:
            aggregation tailoring mcBlobContsContents: in-scope=false, multiplicity-restriction={severity=ERROR, lower-multiplicity=0, upper-multiplicity=1}
      abstract class tailoring McBlobContsContents: multiplicity-restriction={severity=INFO, lower-multiplicity=0, upper-multiplicity-infinite=true}
        class content conditional Invariant
      11 x concrete class tailoring, all with in-scope=false, multiplicity-restriction={severity=INFO, lower-multiplicity=0, upper-multiplicity-infinite=true}, validation-root=false:
        McBlobContsDepositInEcu
          class content conditional Invariant
            attribute-tailorings:
              aggregation tailoring swMcBlobEcuDeposit: in-scope=false, multiplicity-restriction={severity=ERROR, lower-multiplicity=0, upper-multiplicity=1}
        McBlobContsValueInFile
          class content conditional Invariant
            primitive attribute tailoring swMcBlobValue: in-scope=false, multiplicity-restriction={severity=ERROR, lower-multiplicity=0, upper-multiplicity=1}, default-value-handling=NO-DEFAULT
        McDataInstance
          class content conditional Invariant
            attribute-tailorings:
              primitive attribute tailoring arraySize: in-scope=false, multiplicity-restriction={severity=ERROR, lower-multiplicity=0, upper-multiplicity=1}, default-value-handling=NO-DEFAULT
              reference tailoring flatMapEntry: in-scope=false, multiplicity-restriction={severity=ERROR, lower-multiplicity=0, upper-multiplicity=1}, unresolved-reference-restriction=severity=ERROR
              aggregation tailoring instanceInMemory: in-scope=false, multiplicity-restriction={severity=ERROR, lower-multiplicity=0, upper-multiplicity=1}
              aggregation tailoring resultingProperties: in-scope=false, multiplicity-restriction={severity=ERROR, lower-multiplicity=0, upper-multiplicity=1}
              aggregation tailoring subElement: in-scope=false, multiplicity-restriction={severity=ERROR, lower-multiplicity=0, upper-multiplicity-infinite=true}, variation-restriction={severity=ERROR, variation=true, valid-binding-times=[BLUEPRINT-DERIVATION-TIME, SYSTEM-DESIGN-TIME, CODE-GENERATION-TIME, PRE-COMPILE-TIME, LINK-TIME, POST-BUILD]}
              primitive attribute tailoring symbol: in-scope=false, multiplicity-restriction={severity=ERROR, lower-multiplicity=0, upper-multiplicity=1}, default-value-handling=NO-DEFAULT
        McParameterElementGroup
          class content conditional Invariant
            attribute-tailorings:
              reference tailoring ramLocation: in-scope=false, multiplicity-restriction={severity=ERROR, lower-multiplicity=0, upper-multiplicity=1}, unresolved-reference-restriction=severity=ERROR
              reference tailoring romLocation: in-scope=false, multiplicity-restriction={severity=ERROR, lower-multiplicity=0, upper-multiplicity=1}, unresolved-reference-restriction=severity=ERROR
              primitive attribute tailoring shortLabel: in-scope=false, multiplicity-restriction={severity=ERROR, lower-multiplicity=0, upper-multiplicity=1}, default-value-handling=NO-DEFAULT
        McSupportData
          class content conditional Invariant
            attribute-tailorings:
              aggregation tailoring emulationSupport: in-scope=false, multiplicity-restriction={severity=ERROR, lower-multiplicity=0, upper-multiplicity-infinite=true}, variation-restriction={severity=ERROR, variation=true, valid-binding-times=[BLUEPRINT-DERIVATION-TIME, SYSTEM-DESIGN-TIME, CODE-GENERATION-TIME, PRE-COMPILE-TIME, LINK-TIME, POST-BUILD]}
              aggregation tailoring mcParameterInstance: in-scope=false, multiplicity-restriction={severity=ERROR, lower-multiplicity=0, upper-multiplicity-infinite=true}, variation-restriction={severity=ERROR, variation=true, valid-binding-times=[BLUEPRINT-DERIVATION-TIME, SYSTEM-DESIGN-TIME, CODE-GENERATION-TIME, PRE-COMPILE-TIME, LINK-TIME, POST-BUILD]}
              aggregation tailoring mcVariableInstance: in-scope=false, multiplicity-restriction={severity=ERROR, lower-multiplicity=0, upper-multiplicity-infinite=true}, variation-restriction={severity=ERROR, variation=true, valid-binding-times=[BLUEPRINT-DERIVATION-TIME, SYSTEM-DESIGN-TIME, CODE-GENERATION-TIME, PRE-COMPILE-TIME, LINK-TIME, POST-BUILD]}
              reference tailoring measurableSystemConstantValues: in-scope=false, multiplicity-restriction={severity=ERROR, lower-multiplicity=0, upper-multiplicity-infinite=true}, unresolved-reference-restriction=severity=ERROR
        McSwEmulationMethodSupport
          class content conditional Invariant
            attribute-tailorings:
              reference tailoring baseReference: in-scope=false, multiplicity-restriction={severity=ERROR, lower-multiplicity=0, upper-multiplicity=1}, unresolved-reference-restriction=severity=ERROR
              primitive attribute tailoring category: in-scope=false, multiplicity-restriction={severity=ERROR, lower-multiplicity=0, upper-multiplicity=1}, default-value-handling=NO-DEFAULT
              aggregation tailoring elementGroup: in-scope=false, multiplicity-restriction={severity=ERROR, lower-multiplicity=0, upper-multiplicity-infinite=true}
              reference tailoring referenceTable: in-scope=false, multiplicity-restriction={severity=ERROR, lower-multiplicity=0, upper-multiplicity=1}, unresolved-reference-restriction=severity=ERROR
              primitive attribute tailoring shortLabel: in-scope=false, multiplicity-restriction={severity=ERROR, lower-multiplicity=0, upper-multiplicity=1}, default-value-handling=NO-DEFAULT
        MeasuredExecutionTime
          class content conditional Invariant
            attribute-tailorings:
              aggregation tailoring maximumExecutionTime: in-scope=false, multiplicity-restriction={severity=ERROR, lower-multiplicity=0, upper-multiplicity=1}
              aggregation tailoring minimumExecutionTime: in-scope=false, multiplicity-restriction={severity=ERROR, lower-multiplicity=0, upper-multiplicity=1}
              aggregation tailoring nominalExecutionTime: in-scope=false, multiplicity-restriction={severity=ERROR, lower-multiplicity=0, upper-multiplicity=1}
        MeasuredHeapUsage
          class content conditional Invariant
            4 x primitive attribute tailoring, all with in-scope=false, multiplicity-restriction={severity=ERROR, lower-multiplicity=0, upper-multiplicity=1}, default-value-handling=NO-DEFAULT:
              averageMemoryConsumption
              maximumMemoryConsumption
              minimumMemoryConsumption
              testPattern
        MeasuredStackUsage
          class content conditional Invariant
            4 x primitive attribute tailoring, all with in-scope=false, multiplicity-restriction={severity=ERROR, lower-multiplicity=0, upper-multiplicity=1}, default-value-handling=NO-DEFAULT:
              averageMemoryConsumption
              maximumMemoryConsumption
              minimumMemoryConsumption
              testPattern
        MemorySection
          class content conditional Invariant
            attribute-tailorings:
              primitive attribute tailoring alignment: in-scope=false, multiplicity-restriction={severity=ERROR, lower-multiplicity=0, upper-multiplicity=1}, default-value-handling=NO-DEFAULT
              primitive attribute tailoring option: in-scope=false, multiplicity-restriction={severity=ERROR, lower-multiplicity=0, upper-multiplicity-infinite=true}, default-value-handling=NO-DEFAULT
              primitive attribute tailoring size: in-scope=false, multiplicity-restriction={severity=ERROR, lower-multiplicity=0, upper-multiplicity=1}, default-value-handling=NO-DEFAULT
              reference tailoring swAddrmethod: in-scope=false, multiplicity-restriction={severity=ERROR, lower-multiplicity=0, upper-multiplicity=1}, unresolved-reference-restriction=severity=ERROR
        MemorySectionLocation
          class content conditional Invariant
            attribute-tailorings:
              reference tailoring providedMemory: in-scope=false, multiplicity-restriction={severity=ERROR, lower-multiplicity=0, upper-multiplicity=1}, unresolved-reference-restriction=severity=ERROR
              reference tailoring softwareMemorySection: in-scope=false, multiplicity-restriction={severity=ERROR, lower-multiplicity=0, upper-multiplicity=1}, unresolved-reference-restriction=severity=ERROR
      6 x abstract class tailoring, all with multiplicity-restriction={severity=INFO, lower-multiplicity=0, upper-multiplicity-infinite=true}:
        MixedContentForLongName
          class content conditional Invariant
            attribute-tailorings:
              aggregation tailoring e: in-scope=false, multiplicity-restriction={severity=ERROR, lower-multiplicity=0, upper-multiplicity-infinite=true}  # Multiplicity is 0..* since attribute is contained in mixed / mixedString class.
              aggregation tailoring ie: in-scope=false, multiplicity-restriction={severity=ERROR, lower-multiplicity=0, upper-multiplicity-infinite=true}  # Multiplicity is 0..* since attribute is contained in mixed / mixedString class.
              primitive attribute tailoring sub: in-scope=false, multiplicity-restriction={severity=ERROR, lower-multiplicity=0, upper-multiplicity-infinite=true}, default-value-handling=NO-DEFAULT  # Multiplicity is 0..* since attribute is contained in mixed / mixedString class.
              primitive attribute tailoring sup: in-scope=false, multiplicity-restriction={severity=ERROR, lower-multiplicity=0, upper-multiplicity-infinite=true}, default-value-handling=NO-DEFAULT  # Multiplicity is 0..* since attribute is contained in mixed / mixedString class.
              aggregation tailoring tt: in-scope=false, multiplicity-restriction={severity=ERROR, lower-multiplicity=0, upper-multiplicity-infinite=true}  # Multiplicity is 0..* since attribute is contained in mixed / mixedString class.
        MixedContentForOverviewParagraph
          class content conditional Invariant
            attribute-tailorings:
              4 x aggregation tailoring, all with in-scope=false, multiplicity-restriction={severity=ERROR, lower-multiplicity=0, upper-multiplicity-infinite=true}:
                br  # Multiplicity is 0..* since attribute is contained in mixed / mixedString class.
                e  # Multiplicity is 0..* since attribute is contained in mixed / mixedString class.
                ft  # Multiplicity is 0..* since attribute is contained in mixed / mixedString class.
                ie  # Multiplicity is 0..* since attribute is contained in mixed / mixedString class.
              primitive attribute tailoring sub: in-scope=false, multiplicity-restriction={severity=ERROR, lower-multiplicity=0, upper-multiplicity-infinite=true}, default-value-handling=NO-DEFAULT  # Multiplicity is 0..* since attribute is contained in mixed / mixedString class.
              primitive attribute tailoring sup: in-scope=false, multiplicity-restriction={severity=ERROR, lower-multiplicity=0, upper-multiplicity-infinite=true}, default-value-handling=NO-DEFAULT  # Multiplicity is 0..* since attribute is contained in mixed / mixedString class.
              aggregation tailoring tt: in-scope=false, multiplicity-restriction={severity=ERROR, lower-multiplicity=0, upper-multiplicity-infinite=true}  # Multiplicity is 0..* since attribute is contained in mixed / mixedString class.
              aggregation tailoring xref: in-scope=false, multiplicity-restriction={severity=ERROR, lower-multiplicity=0, upper-multiplicity-infinite=true}  # Multiplicity is 0..* since attribute is contained in mixed / mixedString class.
              aggregation tailoring xrefTarget: in-scope=false, multiplicity-restriction={severity=ERROR, lower-multiplicity=0, upper-multiplicity-infinite=true}  # Multiplicity is 0..* since attribute is contained in mixed / mixedString class.
        MixedContentForParagraph
          class content conditional Invariant
            attribute-tailorings:
              5 x aggregation tailoring, all with in-scope=false, multiplicity-restriction={severity=ERROR, lower-multiplicity=0, upper-multiplicity-infinite=true}:
                br  # Multiplicity is 0..* since attribute is contained in mixed / mixedString class.
                e  # Multiplicity is 0..* since attribute is contained in mixed / mixedString class.
                ft  # Multiplicity is 0..* since attribute is contained in mixed / mixedString class.
                ie  # Multiplicity is 0..* since attribute is contained in mixed / mixedString class.
                std  # Multiplicity is 0..* since attribute is contained in mixed / mixedString class.
              primitive attribute tailoring sub: in-scope=false, multiplicity-restriction={severity=ERROR, lower-multiplicity=0, upper-multiplicity-infinite=true}, default-value-handling=NO-DEFAULT  # Multiplicity is 0..* since attribute is contained in mixed / mixedString class.
              primitive attribute tailoring sup: in-scope=false, multiplicity-restriction={severity=ERROR, lower-multiplicity=0, upper-multiplicity-infinite=true}, default-value-handling=NO-DEFAULT  # Multiplicity is 0..* since attribute is contained in mixed / mixedString class.
              5 x aggregation tailoring, all with in-scope=false, multiplicity-restriction={severity=ERROR, lower-multiplicity=0, upper-multiplicity-infinite=true}:
                tt  # Multiplicity is 0..* since attribute is contained in mixed / mixedString class.
                xdoc  # Multiplicity is 0..* since attribute is contained in mixed / mixedString class.
                xfile  # Multiplicity is 0..* since attribute is contained in mixed / mixedString class.
                xref  # Multiplicity is 0..* since attribute is contained in mixed / mixedString class.
                xrefTarget  # Multiplicity is 0..* since attribute is contained in mixed / mixedString class.
        MixedContentForPlainText
          class content conditional Invariant
            primitive attribute tailoring contents: in-scope=false, multiplicity-restriction={severity=ERROR, lower-multiplicity=0, upper-multiplicity=1}, default-value-handling=NO-DEFAULT
        MixedContentForUnitNames
          class content conditional Invariant
            primitive attribute tailoring sub: in-scope=false, multiplicity-restriction={severity=ERROR, lower-multiplicity=0, upper-multiplicity-infinite=true}, default-value-handling=NO-DEFAULT  # Multiplicity is 0..* since attribute is contained in mixed / mixedString class.
            primitive attribute tailoring sup: in-scope=false, multiplicity-restriction={severity=ERROR, lower-multiplicity=0, upper-multiplicity-infinite=true}, default-value-handling=NO-DEFAULT  # Multiplicity is 0..* since attribute is contained in mixed / mixedString class.
        MixedContentForVerbatim
          class content conditional Invariant
            attribute-tailorings:
              4 x aggregation tailoring, all with in-scope=false, multiplicity-restriction={severity=ERROR, lower-multiplicity=0, upper-multiplicity-infinite=true}:
                br  # Multiplicity is 0..* since attribute is contained in mixed / mixedString class.
                e  # Multiplicity is 0..* since attribute is contained in mixed / mixedString class.
                tt  # Multiplicity is 0..* since attribute is contained in mixed / mixedString class.
                xref  # Multiplicity is 0..* since attribute is contained in mixed / mixedString class.
      7 x concrete class tailoring, all with in-scope=false, multiplicity-restriction={severity=INFO, lower-multiplicity=0, upper-multiplicity-infinite=true}, validation-root=false:
        MlFigure
          class content conditional Invariant
            attribute-tailorings:
              aggregation tailoring figureCaption: in-scope=false, multiplicity-restriction={severity=ERROR, lower-multiplicity=0, upper-multiplicity=1}
              primitive attribute tailoring frame: in-scope=false, multiplicity-restriction={severity=ERROR, lower-multiplicity=0, upper-multiplicity=1}, default-value-handling=NO-DEFAULT
              primitive attribute tailoring helpEntry: in-scope=false, multiplicity-restriction={severity=ERROR, lower-multiplicity=0, upper-multiplicity=1}, default-value-handling=NO-DEFAULT
              aggregation tailoring lGraphic: in-scope=false, multiplicity-restriction={severity=ERROR, lower-multiplicity=0, upper-multiplicity-infinite=true}
              primitive attribute tailoring pgwide: in-scope=false, multiplicity-restriction={severity=ERROR, lower-multiplicity=0, upper-multiplicity=1}, default-value-handling=NO-DEFAULT
              aggregation tailoring verbatim: in-scope=false, multiplicity-restriction={severity=ERROR, lower-multiplicity=0, upper-multiplicity=1}
        MlFormula
          class content conditional Invariant
            attribute-tailorings:
              5 x aggregation tailoring, all with in-scope=false:
                formulaCaption: multiplicity-restriction={severity=ERROR, lower-multiplicity=0, upper-multiplicity=1}
                genericMath: multiplicity-restriction={severity=ERROR, lower-multiplicity=0, upper-multiplicity=1}
                lGraphic: multiplicity-restriction={severity=ERROR, lower-multiplicity=0, upper-multiplicity-infinite=true}
                texMath: multiplicity-restriction={severity=ERROR, lower-multiplicity=0, upper-multiplicity=1}
                verbatim: multiplicity-restriction={severity=ERROR, lower-multiplicity=0, upper-multiplicity=1}
        ModeAccessPoint
          class content conditional Invariant
            attribute-tailorings:
              aggregation tailoring modeGroup: in-scope=false, multiplicity-restriction={severity=ERROR, lower-multiplicity=0, upper-multiplicity=1}
        ModeDeclaration
          class content conditional Invariant
        ModeDeclarationGroup
          class content conditional Invariant
            attribute-tailorings:
              reference tailoring initialMode: in-scope=false, multiplicity-restriction={severity=ERROR, lower-multiplicity=0, upper-multiplicity=1}, unresolved-reference-restriction=severity=ERROR
              aggregation tailoring modeDeclaration: in-scope=false, multiplicity-restriction={severity=ERROR, lower-multiplicity=0, upper-multiplicity-infinite=true}
        ModeDeclarationGroupPrototype
          class content conditional Invariant
            attribute-tailorings:
              reference tailoring type: in-scope=false, multiplicity-restriction={severity=ERROR, lower-multiplicity=0, upper-multiplicity=1}, unresolved-reference-restriction=severity=ERROR
        ModeDeclarationGroupPrototypeMapping
          class content conditional Invariant
            attribute-tailorings:
              reference tailoring firstModeGroup: in-scope=false, multiplicity-restriction={severity=ERROR, lower-multiplicity=0, upper-multiplicity=1}, unresolved-reference-restriction=severity=ERROR
              reference tailoring secondModeGroup: in-scope=false, multiplicity-restriction={severity=ERROR, lower-multiplicity=0, upper-multiplicity=1}, unresolved-reference-restriction=severity=ERROR
      abstract class tailoring ModeGroupInAtomicSwcInstanceRef: multiplicity-restriction={severity=INFO, lower-multiplicity=0, upper-multiplicity-infinite=true}
        class content conditional Invariant
      24 x concrete class tailoring, all with in-scope=false, multiplicity-restriction={severity=INFO, lower-multiplicity=0, upper-multiplicity-infinite=true}, validation-root=false:
        ModeInBswModuleDescriptionInstanceRef
          class content conditional Invariant
            attribute-tailorings:
              reference tailoring contextModeDeclarationGroup: in-scope=false, multiplicity-restriction={severity=ERROR, lower-multiplicity=0, upper-multiplicity=1}, unresolved-reference-restriction=severity=ERROR
              reference tailoring targetMode: in-scope=false, multiplicity-restriction={severity=ERROR, lower-multiplicity=0, upper-multiplicity=1}, unresolved-reference-restriction=severity=ERROR
        ModeInterfaceMapping
          class content conditional Invariant
            attribute-tailorings:
              aggregation tailoring modeMapping: in-scope=false, multiplicity-restriction={severity=ERROR, lower-multiplicity=0, upper-multiplicity=1}
        ModePortAnnotation
          class content conditional Invariant
            attribute-tailorings:
              reference tailoring modeGroup: in-scope=false, multiplicity-restriction={severity=ERROR, lower-multiplicity=0, upper-multiplicity=1}, unresolved-reference-restriction=severity=ERROR
        ModeRequestTypeMap
          class content conditional Invariant
            attribute-tailorings:
              reference tailoring implementationDataType: in-scope=false, multiplicity-restriction={severity=ERROR, lower-multiplicity=0, upper-multiplicity=1}, unresolved-reference-restriction=severity=ERROR
              reference tailoring modeGroup: in-scope=false, multiplicity-restriction={severity=ERROR, lower-multiplicity=0, upper-multiplicity=1}, unresolved-reference-restriction=severity=ERROR
        ModeSwitchInterface
          class content conditional Invariant
            attribute-tailorings:
              aggregation tailoring modeGroup: in-scope=false, multiplicity-restriction={severity=ERROR, lower-multiplicity=0, upper-multiplicity=1}
        ModeSwitchPoint
          class content conditional Invariant
            attribute-tailorings:
              aggregation tailoring modeGroup: in-scope=false, multiplicity-restriction={severity=ERROR, lower-multiplicity=0, upper-multiplicity=1}
        ModeSwitchReceiverComSpec
          class content conditional Invariant
            primitive attribute tailoring supportsAsynchronousModeSwitch: in-scope=false, multiplicity-restriction={severity=ERROR, lower-multiplicity=0, upper-multiplicity=1}, default-value-handling=NO-DEFAULT
        ModeSwitchSenderComSpec
          class content conditional Invariant
            attribute-tailorings:
              reference tailoring modeGroup: in-scope=false, multiplicity-restriction={severity=ERROR, lower-multiplicity=0, upper-multiplicity=1}, unresolved-reference-restriction=severity=ERROR
              aggregation tailoring modeSwitchedAck: in-scope=false, multiplicity-restriction={severity=ERROR, lower-multiplicity=0, upper-multiplicity=1}
              primitive attribute tailoring queueLength: in-scope=false, multiplicity-restriction={severity=ERROR, lower-multiplicity=0, upper-multiplicity=1}, default-value-handling=NO-DEFAULT
        ModeSwitchedAckEvent
          class content conditional Invariant
            attribute-tailorings:
              reference tailoring eventSource: in-scope=false, multiplicity-restriction={severity=ERROR, lower-multiplicity=0, upper-multiplicity=1}, unresolved-reference-restriction=severity=ERROR
        ModeSwitchedAckRequest
          class content conditional Invariant
            primitive attribute tailoring timeout: in-scope=false, multiplicity-restriction={severity=ERROR, lower-multiplicity=0, upper-multiplicity=1}, default-value-handling=NO-DEFAULT
        Modification
          class content conditional Invariant
            attribute-tailorings:
              aggregation tailoring change: in-scope=false, multiplicity-restriction={severity=ERROR, lower-multiplicity=0, upper-multiplicity=1}
              aggregation tailoring reason: in-scope=false, multiplicity-restriction={severity=ERROR, lower-multiplicity=0, upper-multiplicity=1}
              primitive attribute tailoring type: in-scope=false, multiplicity-restriction={severity=ERROR, lower-multiplicity=0, upper-multiplicity=1}, default-value-handling=NO-DEFAULT
        MsrQueryArg
          class content conditional Invariant
            primitive attribute tailoring arg: in-scope=false, multiplicity-restriction={severity=ERROR, lower-multiplicity=0, upper-multiplicity=1}, default-value-handling=NO-DEFAULT
            primitive attribute tailoring si: in-scope=false, multiplicity-restriction={severity=ERROR, lower-multiplicity=0, upper-multiplicity=1}, default-value-handling=NO-DEFAULT
        MsrQueryChapter
          class content conditional Invariant
            attribute-tailorings:
              aggregation tailoring msrQueryProps: in-scope=false, multiplicity-restriction={severity=ERROR, lower-multiplicity=0, upper-multiplicity=1}
              aggregation tailoring msrQueryResultChapter: in-scope=false, multiplicity-restriction={severity=ERROR, lower-multiplicity=0, upper-multiplicity=1}
        MsrQueryP1
          class content conditional Invariant
            attribute-tailorings:
              aggregation tailoring msrQueryProps: in-scope=false, multiplicity-restriction={severity=ERROR, lower-multiplicity=0, upper-multiplicity=1}
              aggregation tailoring msrQueryResultP1: in-scope=false, multiplicity-restriction={severity=ERROR, lower-multiplicity=0, upper-multiplicity=1}
        MsrQueryProps
          class content conditional Invariant
            attribute-tailorings:
              primitive attribute tailoring comment: in-scope=false, multiplicity-restriction={severity=ERROR, lower-multiplicity=0, upper-multiplicity=1}, default-value-handling=NO-DEFAULT
              aggregation tailoring msrQueryArg: in-scope=false, multiplicity-restriction={severity=ERROR, lower-multiplicity=0, upper-multiplicity-infinite=true}
              primitive attribute tailoring msrQueryName: in-scope=false, multiplicity-restriction={severity=ERROR, lower-multiplicity=0, upper-multiplicity=1}, default-value-handling=NO-DEFAULT
        MsrQueryResultChapter
          class content conditional Invariant
            attribute-tailorings:
              aggregation tailoring chapter: in-scope=false, multiplicity-restriction={severity=ERROR, lower-multiplicity=0, upper-multiplicity-infinite=true}
        MsrQueryResultTopic1
          class content conditional Invariant
            attribute-tailorings:
              aggregation tailoring topic1: in-scope=false, multiplicity-restriction={severity=ERROR, lower-multiplicity=0, upper-multiplicity-infinite=true}
        MsrQueryTopic1
          class content conditional Invariant
            attribute-tailorings:
              aggregation tailoring msrQueryProps: in-scope=false, multiplicity-restriction={severity=ERROR, lower-multiplicity=0, upper-multiplicity=1}
              aggregation tailoring msrQueryResultTopic1: in-scope=false, multiplicity-restriction={severity=ERROR, lower-multiplicity=0, upper-multiplicity=1}
        Msrsw
          class content conditional Invariant
            attribute-tailorings:
              6 x primitive attribute tailoring, all with in-scope=false, multiplicity-restriction={severity=ERROR, lower-multiplicity=0, upper-multiplicity=1}, default-value-handling=NO-DEFAULT:
                creator
                creatorVersion
                fCmToolId
                fDtdBuild
                fDtdVersion
                fPubid
              6 x aggregation tailoring, all with in-scope=false:
                generalRequirements: multiplicity-restriction={severity=ERROR, lower-multiplicity=0, upper-multiplicity=1}
                introduction: multiplicity-restriction={severity=ERROR, lower-multiplicity=0, upper-multiplicity=1}
                locs: multiplicity-restriction={severity=ERROR, lower-multiplicity=0, upper-multiplicity=1}
                matchingDci: multiplicity-restriction={severity=ERROR, lower-multiplicity=0, upper-multiplicity-infinite=true}
                msrProcessingLog: multiplicity-restriction={severity=ERROR, lower-multiplicity=0, upper-multiplicity=1}
                projectData: multiplicity-restriction={severity=ERROR, lower-multiplicity=0, upper-multiplicity=1}
              primitive attribute tailoring pubid: in-scope=false, multiplicity-restriction={severity=ERROR, lower-multiplicity=0, upper-multiplicity=1}, default-value-handling=NO-DEFAULT
              4 x aggregation tailoring, all with in-scope=false:
                sdg: multiplicity-restriction={severity=ERROR, lower-multiplicity=0, upper-multiplicity-infinite=true}
                swGlossary: multiplicity-restriction={severity=ERROR, lower-multiplicity=0, upper-multiplicity=1}
                swMcCommunicationSpec: multiplicity-restriction={severity=ERROR, lower-multiplicity=0, upper-multiplicity=1}
                swSystem: multiplicity-restriction={severity=ERROR, lower-multiplicity=0, upper-multiplicity-infinite=true}
        MultiLanguageOverviewParagraph
          class content conditional Invariant
            attribute-tailorings:
              aggregation tailoring l2: in-scope=false, multiplicity-restriction={severity=ERROR, lower-multiplicity=0, upper-multiplicity-infinite=true}
        MultiLanguageParagraph
          class content conditional Invariant
            attribute-tailorings:
              primitive attribute tailoring helpEntry: in-scope=false, multiplicity-restriction={severity=ERROR, lower-multiplicity=0, upper-multiplicity=1}, default-value-handling=NO-DEFAULT
              aggregation tailoring l1: in-scope=false, multiplicity-restriction={severity=ERROR, lower-multiplicity=0, upper-multiplicity-infinite=true}
        MultiLanguagePlainText
          class content conditional Invariant
            attribute-tailorings:
              aggregation tailoring l10: in-scope=false, multiplicity-restriction={severity=ERROR, lower-multiplicity=0, upper-multiplicity-infinite=true}
        MultiLanguageVerbatim
          class content conditional Invariant
            attribute-tailorings:
              primitive attribute tailoring allowBreak: in-scope=false, multiplicity-restriction={severity=ERROR, lower-multiplicity=0, upper-multiplicity=1}, default-value-handling=NO-DEFAULT
              primitive attribute tailoring float: in-scope=false, multiplicity-restriction={severity=ERROR, lower-multiplicity=0, upper-multiplicity=1}, default-value-handling=NO-DEFAULT
              primitive attribute tailoring helpEntry: in-scope=false, multiplicity-restriction={severity=ERROR, lower-multiplicity=0, upper-multiplicity=1}, default-value-handling=NO-DEFAULT
              aggregation tailoring l5: in-scope=false, multiplicity-restriction={severity=ERROR, lower-multiplicity=0, upper-multiplicity-infinite=true}
              primitive attribute tailoring pgwide: in-scope=false, multiplicity-restriction={severity=ERROR, lower-multiplicity=0, upper-multiplicity=1}, default-value-handling=NO-DEFAULT
        MultilanguageLongName
          class content conditional Invariant
            attribute-tailorings:
              aggregation tailoring l4: in-scope=false, multiplicity-restriction={severity=ERROR, lower-multiplicity=0, upper-multiplicity-infinite=true}
      abstract class tailoring MultilanguageReferrable: multiplicity-restriction={severity=INFO, lower-multiplicity=0, upper-multiplicity-infinite=true}
        class content conditional Invariant
          attribute-tailorings:
            aggregation tailoring longName: in-scope=false, multiplicity-restriction={severity=ERROR, lower-multiplicity=0, upper-multiplicity=1}
      concrete class tailoring MultiplexedIPdu: in-scope=false, multiplicity-restriction={severity=INFO, lower-multiplicity=0, upper-multiplicity-infinite=true}, validation-root=false
        class content conditional Invariant
          attribute-tailorings:
            aggregation tailoring dynamicPart: in-scope=false, multiplicity-restriction={severity=ERROR, lower-multiplicity=0, upper-multiplicity=1}, variation-restriction={severity=ERROR, variation=true, valid-binding-times=[BLUEPRINT-DERIVATION-TIME, SYSTEM-DESIGN-TIME, CODE-GENERATION-TIME, PRE-COMPILE-TIME, LINK-TIME, POST-BUILD]}
            primitive attribute tailoring selectorFieldByteOrder: in-scope=false, multiplicity-restriction={severity=ERROR, lower-multiplicity=0, upper-multiplicity=1}, default-value-handling=NO-DEFAULT
            primitive attribute tailoring selectorFieldLength: in-scope=false, multiplicity-restriction={severity=ERROR, lower-multiplicity=0, upper-multiplicity=1}, default-value-handling=NO-DEFAULT
            primitive attribute tailoring selectorFieldStartPosition: in-scope=false, multiplicity-restriction={severity=ERROR, lower-multiplicity=0, upper-multiplicity=1}, default-value-handling=NO-DEFAULT
            aggregation tailoring staticPart: in-scope=false, multiplicity-restriction={severity=ERROR, lower-multiplicity=0, upper-multiplicity=1}, variation-restriction={severity=ERROR, variation=true, valid-binding-times=[BLUEPRINT-DERIVATION-TIME, SYSTEM-DESIGN-TIME, CODE-GENERATION-TIME, PRE-COMPILE-TIME, LINK-TIME, POST-BUILD]}
            primitive attribute tailoring triggerMode: in-scope=false, multiplicity-restriction={severity=ERROR, lower-multiplicity=0, upper-multiplicity=1}, default-value-handling=NO-DEFAULT
            primitive attribute tailoring unusedBitPattern: in-scope=false, multiplicity-restriction={severity=ERROR, lower-multiplicity=0, upper-multiplicity=1}, default-value-handling=NO-DEFAULT
      abstract class tailoring MultiplexedPart: multiplicity-restriction={severity=INFO, lower-multiplicity=0, upper-multiplicity-infinite=true}
        class content conditional Invariant
          attribute-tailorings:
            aggregation tailoring segmentPosition: in-scope=false, multiplicity-restriction={severity=ERROR, lower-multiplicity=0, upper-multiplicity-infinite=true}
      concrete class tailoring NPdu: in-scope=false, multiplicity-restriction={severity=INFO, lower-multiplicity=0, upper-multiplicity-infinite=true}, validation-root=false
        class content conditional Invariant
      concrete class tailoring Nameloc: in-scope=false, multiplicity-restriction={severity=INFO, lower-multiplicity=0, upper-multiplicity-infinite=true}, validation-root=false
        class content conditional Invariant
          attribute-tailorings:
            primitive attribute tailoring extIdClass: in-scope=false, multiplicity-restriction={severity=ERROR, lower-multiplicity=0, upper-multiplicity=1}, default-value-handling=NO-DEFAULT
            aggregation tailoring nmlist: in-scope=false, multiplicity-restriction={severity=ERROR, lower-multiplicity=0, upper-multiplicity=1}
      abstract class tailoring NmCluster: multiplicity-restriction={severity=INFO, lower-multiplicity=0, upper-multiplicity-infinite=true}
        class content conditional Invariant
          attribute-tailorings:
            reference tailoring communicationCluster: in-scope=false, multiplicity-restriction={severity=ERROR, lower-multiplicity=0, upper-multiplicity=1}, unresolved-reference-restriction=severity=ERROR
            primitive attribute tailoring nmChannelId: in-scope=false, multiplicity-restriction={severity=ERROR, lower-multiplicity=0, upper-multiplicity=1}, default-value-handling=NO-DEFAULT
            primitive attribute tailoring nmChannelSleepMaster: in-scope=false, multiplicity-restriction={severity=ERROR, lower-multiplicity=0, upper-multiplicity=1}, default-value-handling=NO-DEFAULT
            aggregation tailoring nmNode: in-scope=false, multiplicity-restriction={severity=ERROR, lower-multiplicity=0, upper-multiplicity-infinite=true}, variation-restriction={severity=ERROR, variation=true, valid-binding-times=[BLUEPRINT-DERIVATION-TIME, SYSTEM-DESIGN-TIME, CODE-GENERATION-TIME, PRE-COMPILE-TIME, LINK-TIME, POST-BUILD]}
            primitive attribute tailoring nmSynchronizingNetwork: in-scope=false, multiplicity-restriction={severity=ERROR, lower-multiplicity=0, upper-multiplicity=1}, default-value-handling=NO-DEFAULT
      abstract class tailoring NmClusterCoupling: multiplicity-restriction={severity=INFO, lower-multiplicity=0, upper-multiplicity-infinite=true}
        class content conditional Invariant
      concrete class tailoring NmConfig: in-scope=false, multiplicity-restriction={severity=INFO, lower-multiplicity=0, upper-multiplicity-infinite=true}, validation-root=false
        class content conditional Invariant
          attribute-tailorings:
            aggregation tailoring nmCluster: in-scope=false, multiplicity-restriction={severity=ERROR, lower-multiplicity=0, upper-multiplicity-infinite=true}, variation-restriction={severity=ERROR, variation=true, valid-binding-times=[BLUEPRINT-DERIVATION-TIME, SYSTEM-DESIGN-TIME, CODE-GENERATION-TIME, PRE-COMPILE-TIME, LINK-TIME, POST-BUILD]}
            aggregation tailoring nmClusterCoupling: in-scope=false, multiplicity-restriction={severity=ERROR, lower-multiplicity=0, upper-multiplicity-infinite=true}
            aggregation tailoring nmIfEcu: in-scope=false, multiplicity-restriction={severity=ERROR, lower-multiplicity=0, upper-multiplicity-infinite=true}, variation-restriction={severity=ERROR, variation=true, valid-binding-times=[BLUEPRINT-DERIVATION-TIME, SYSTEM-DESIGN-TIME, CODE-GENERATION-TIME, PRE-COMPILE-TIME, LINK-TIME, POST-BUILD]}
      concrete class tailoring NmCoordinator: in-scope=false, multiplicity-restriction={severity=INFO, lower-multiplicity=0, upper-multiplicity-infinite=true}, validation-root=false
        class content conditional Invariant
          attribute-tailorings:
            primitive attribute tailoring index: in-scope=false, multiplicity-restriction={severity=ERROR, lower-multiplicity=0, upper-multiplicity=1}, default-value-handling=NO-DEFAULT
            reference tailoring nmNode: in-scope=false, multiplicity-restriction={severity=ERROR, lower-multiplicity=0, upper-multiplicity-infinite=true}, unresolved-reference-restriction=severity=ERROR
            primitive attribute tailoring nmShutdownDelayTimer: in-scope=false, multiplicity-restriction={severity=ERROR, lower-multiplicity=0, upper-multiplicity=1}, default-value-handling=NO-DEFAULT
      concrete class tailoring NmEcu: in-scope=false, multiplicity-restriction={severity=INFO, lower-multiplicity=0, upper-multiplicity-infinite=true}, validation-root=false
        class content conditional Invariant
          attribute-tailorings:
            aggregation tailoring busSpecificNmEcu: in-scope=false, multiplicity-restriction={severity=ERROR, lower-multiplicity=0, upper-multiplicity=1}
            reference tailoring ecuInstance: in-scope=false, multiplicity-restriction={severity=ERROR, lower-multiplicity=0, upper-multiplicity=1}, unresolved-reference-restriction=severity=ERROR
            primitive attribute tailoring nmBusSynchronizationEnabled: in-scope=false, multiplicity-restriction={severity=ERROR, lower-multiplicity=0, upper-multiplicity=1}, default-value-handling=NO-DEFAULT
            primitive attribute tailoring nmComControlEnabled: in-scope=false, multiplicity-restriction={severity=ERROR, lower-multiplicity=0, upper-multiplicity=1}, default-value-handling=NO-DEFAULT
            aggregation tailoring nmCoordinator: in-scope=false, multiplicity-restriction={severity=ERROR, lower-multiplicity=0, upper-multiplicity=1}
            10 x primitive attribute tailoring, all with in-scope=false, multiplicity-restriction={severity=ERROR, lower-multiplicity=0, upper-multiplicity=1}, default-value-handling=NO-DEFAULT:
              nmCycletimeMainFunction
              nmMultipleChannelsEnabled
              nmNodeDetectionEnabled
              nmNodeIdEnabled
              nmPassiveModeEnabled
              nmPduRxIndicationEnabled
              nmRemoteSleepIndEnabled
              nmRepeatMsgIndEnabled
              nmStateChangeIndEnabled
              nmUserDataEnabled
      abstract class tailoring NmNode: multiplicity-restriction={severity=INFO, lower-multiplicity=0, upper-multiplicity-infinite=true}
        class content conditional Invariant
          attribute-tailorings:
            reference tailoring controller: in-scope=false, multiplicity-restriction={severity=ERROR, lower-multiplicity=0, upper-multiplicity=1}, unresolved-reference-restriction=severity=ERROR
            reference tailoring nmIfEcu: in-scope=false, multiplicity-restriction={severity=ERROR, lower-multiplicity=0, upper-multiplicity=1}, unresolved-reference-restriction=severity=ERROR
            primitive attribute tailoring nmNodeId: in-scope=false, multiplicity-restriction={severity=ERROR, lower-multiplicity=0, upper-multiplicity=1}, default-value-handling=NO-DEFAULT
            reference tailoring rxNmPdu: in-scope=false, multiplicity-restriction={severity=ERROR, lower-multiplicity=0, upper-multiplicity-infinite=true}, unresolved-reference-restriction=severity=ERROR
            reference tailoring txNmPdu: in-scope=false, multiplicity-restriction={severity=ERROR, lower-multiplicity=0, upper-multiplicity-infinite=true}, unresolved-reference-restriction=severity=ERROR
      20 x concrete class tailoring, all with in-scope=false, multiplicity-restriction={severity=INFO, lower-multiplicity=0, upper-multiplicity-infinite=true}, validation-root=false:
        NmPdu
          class content conditional Invariant
            attribute-tailorings:
              aggregation tailoring iSignalToIPduMapping: in-scope=false, multiplicity-restriction={severity=ERROR, lower-multiplicity=0, upper-multiplicity-infinite=true}
              primitive attribute tailoring nmDataInformation: in-scope=false, multiplicity-restriction={severity=ERROR, lower-multiplicity=0, upper-multiplicity=1}, default-value-handling=NO-DEFAULT
              primitive attribute tailoring nmVoteInformation: in-scope=false, multiplicity-restriction={severity=ERROR, lower-multiplicity=0, upper-multiplicity=1}, default-value-handling=NO-DEFAULT
              primitive attribute tailoring unusedBitPattern: in-scope=false, multiplicity-restriction={severity=ERROR, lower-multiplicity=0, upper-multiplicity=1}, default-value-handling=NO-DEFAULT
        Nmlist
          class content conditional Invariant
            primitive attribute tailoring docorsub: in-scope=false, multiplicity-restriction={severity=ERROR, lower-multiplicity=0, upper-multiplicity-infinite=true}, default-value-handling=NO-DEFAULT  # Multiplicity is 0..* since attribute is contained in mixed / mixedString class.
            primitive attribute tailoring nametype: in-scope=false, multiplicity-restriction={severity=ERROR, lower-multiplicity=0, upper-multiplicity-infinite=true}, default-value-handling=NO-DEFAULT  # Multiplicity is 0..* since attribute is contained in mixed / mixedString class.
        NonqueuedReceiverComSpec
          class content conditional Invariant
            attribute-tailorings:
              primitive attribute tailoring aliveTimeout: in-scope=false, multiplicity-restriction={severity=ERROR, lower-multiplicity=0, upper-multiplicity=1}, default-value-handling=NO-DEFAULT
              primitive attribute tailoring enableUpdate: in-scope=false, multiplicity-restriction={severity=ERROR, lower-multiplicity=0, upper-multiplicity=1}, default-value-handling=NO-DEFAULT
              aggregation tailoring filter: in-scope=false, multiplicity-restriction={severity=ERROR, lower-multiplicity=0, upper-multiplicity=1}
              primitive attribute tailoring handleNeverReceived: in-scope=false, multiplicity-restriction={severity=ERROR, lower-multiplicity=0, upper-multiplicity=1}, default-value-handling=NO-DEFAULT
              primitive attribute tailoring handleTimeoutType: in-scope=false, multiplicity-restriction={severity=ERROR, lower-multiplicity=0, upper-multiplicity=1}, default-value-handling=NO-DEFAULT
              aggregation tailoring initValue: in-scope=false, multiplicity-restriction={severity=ERROR, lower-multiplicity=0, upper-multiplicity=1}
        NonqueuedSenderComSpec
          class content conditional Invariant
            attribute-tailorings:
              aggregation tailoring initValue: in-scope=false, multiplicity-restriction={severity=ERROR, lower-multiplicity=0, upper-multiplicity=1}
        Note
          class content conditional Invariant
            attribute-tailorings:
              aggregation tailoring label: in-scope=false, multiplicity-restriction={severity=ERROR, lower-multiplicity=0, upper-multiplicity=1}
              aggregation tailoring noteText: in-scope=false, multiplicity-restriction={severity=ERROR, lower-multiplicity=0, upper-multiplicity=1}
              primitive attribute tailoring noteType: in-scope=false, multiplicity-restriction={severity=ERROR, lower-multiplicity=0, upper-multiplicity=1}, default-value-handling=NO-DEFAULT
        NumericalValueSpecification
          class content conditional Invariant
            primitive attribute tailoring value: in-scope=false, multiplicity-restriction={severity=ERROR, lower-multiplicity=0, upper-multiplicity=1}, variation-restriction={severity=ERROR, variation=true, valid-binding-times=[BLUEPRINT-DERIVATION-TIME, SYSTEM-DESIGN-TIME, CODE-GENERATION-TIME, PRE-COMPILE-TIME, LINK-TIME, POST-BUILD]}, default-value-handling=NO-DEFAULT
        NumericalValueVariationPoint
          class content conditional Invariant
        NvBlockDataMapping
          class content conditional Invariant
            attribute-tailorings:
              aggregation tailoring nvRamBlockElement: in-scope=false, multiplicity-restriction={severity=ERROR, lower-multiplicity=0, upper-multiplicity=1}
              aggregation tailoring readNvData: in-scope=false, multiplicity-restriction={severity=ERROR, lower-multiplicity=0, upper-multiplicity=1}
              aggregation tailoring writtenNvData: in-scope=false, multiplicity-restriction={severity=ERROR, lower-multiplicity=0, upper-multiplicity=1}
        NvBlockDescriptor
          class content conditional Invariant
            attribute-tailorings:
              aggregation tailoring clientServerPort: in-scope=false, multiplicity-restriction={severity=ERROR, lower-multiplicity=0, upper-multiplicity-infinite=true}, variation-restriction={severity=ERROR, variation=true, valid-binding-times=[BLUEPRINT-DERIVATION-TIME, SYSTEM-DESIGN-TIME, CODE-GENERATION-TIME, PRE-COMPILE-TIME, LINK-TIME, POST-BUILD]}
              reference tailoring constantValueMapping: in-scope=false, multiplicity-restriction={severity=ERROR, lower-multiplicity=0, upper-multiplicity-infinite=true}, unresolved-reference-restriction=severity=ERROR
              reference tailoring dataTypeMapping: in-scope=false, multiplicity-restriction={severity=ERROR, lower-multiplicity=0, upper-multiplicity-infinite=true}, unresolved-reference-restriction=severity=ERROR
              5 x aggregation tailoring, all with in-scope=false:
                instantiationDataDefProps: multiplicity-restriction={severity=ERROR, lower-multiplicity=0, upper-multiplicity-infinite=true}, variation-restriction={severity=ERROR, variation=true, valid-binding-times=[BLUEPRINT-DERIVATION-TIME, SYSTEM-DESIGN-TIME, CODE-GENERATION-TIME, PRE-COMPILE-TIME, LINK-TIME, POST-BUILD]}
                nvBlockDataMapping: multiplicity-restriction={severity=ERROR, lower-multiplicity=0, upper-multiplicity-infinite=true}, variation-restriction={severity=ERROR, variation=true, valid-binding-times=[BLUEPRINT-DERIVATION-TIME, SYSTEM-DESIGN-TIME, CODE-GENERATION-TIME, PRE-COMPILE-TIME, LINK-TIME, POST-BUILD]}
                nvBlockNeeds: multiplicity-restriction={severity=ERROR, lower-multiplicity=0, upper-multiplicity=1}
                ramBlock: multiplicity-restriction={severity=ERROR, lower-multiplicity=0, upper-multiplicity=1}
                romBlock: multiplicity-restriction={severity=ERROR, lower-multiplicity=0, upper-multiplicity=1}
        NvBlockNeeds
          class content conditional Invariant
            13 x primitive attribute tailoring, all with in-scope=false, multiplicity-restriction={severity=ERROR, lower-multiplicity=0, upper-multiplicity=1}, default-value-handling=NO-DEFAULT:
              calcRamBlockCrc
              checkStaticBlockId
              nDataSets
              nRomBlocks
              readonly
              reliability
              resistantToChangedSw
              restoreAtStart
              storeAtShutdown
              writeOnlyOnce
              writeVerification
              writingFrequency
              writingPriority
        NvBlockSwComponentType
          class content conditional Invariant
            attribute-tailorings:
              aggregation tailoring nvBlockDescriptor: in-scope=false, multiplicity-restriction={severity=ERROR, lower-multiplicity=0, upper-multiplicity-infinite=true}, variation-restriction={severity=ERROR, variation=true, valid-binding-times=[BLUEPRINT-DERIVATION-TIME, SYSTEM-DESIGN-TIME, CODE-GENERATION-TIME, PRE-COMPILE-TIME, LINK-TIME, POST-BUILD]}
        NvDataInterface
          class content conditional Invariant
            attribute-tailorings:
              aggregation tailoring nvData: in-scope=false, multiplicity-restriction={severity=ERROR, lower-multiplicity=0, upper-multiplicity-infinite=true}
        NvDataPortAnnotation
          class content conditional Invariant
            attribute-tailorings:
              reference tailoring variable: in-scope=false, multiplicity-restriction={severity=ERROR, lower-multiplicity=0, upper-multiplicity=1}, unresolved-reference-restriction=severity=ERROR
        NvRequireComSpec
          class content conditional Invariant
            attribute-tailorings:
              aggregation tailoring initValue: in-scope=false, multiplicity-restriction={severity=ERROR, lower-multiplicity=0, upper-multiplicity=1}
              reference tailoring variable: in-scope=false, multiplicity-restriction={severity=ERROR, lower-multiplicity=0, upper-multiplicity=1}, unresolved-reference-restriction=severity=ERROR
        ObdControlServiceNeeds
          class content conditional Invariant
            primitive attribute tailoring testId: in-scope=false, multiplicity-restriction={severity=ERROR, lower-multiplicity=0, upper-multiplicity=1}, default-value-handling=NO-DEFAULT
        ObdInfoServiceNeeds
          class content conditional Invariant
            primitive attribute tailoring dataLength: in-scope=false, multiplicity-restriction={severity=ERROR, lower-multiplicity=0, upper-multiplicity=1}, default-value-handling=NO-DEFAULT
            primitive attribute tailoring infoType: in-scope=false, multiplicity-restriction={severity=ERROR, lower-multiplicity=0, upper-multiplicity=1}, default-value-handling=NO-DEFAULT
        ObdMonitorServiceNeeds
          class content conditional Invariant
            primitive attribute tailoring onBoardMonitorId: in-scope=false, multiplicity-restriction={severity=ERROR, lower-multiplicity=0, upper-multiplicity=1}, default-value-handling=NO-DEFAULT
            primitive attribute tailoring testId: in-scope=false, multiplicity-restriction={severity=ERROR, lower-multiplicity=0, upper-multiplicity=1}, default-value-handling=NO-DEFAULT
            primitive attribute tailoring unitAndScalingId: in-scope=false, multiplicity-restriction={severity=ERROR, lower-multiplicity=0, upper-multiplicity=1}, default-value-handling=NO-DEFAULT
        ObdPidServiceNeeds
          class content conditional Invariant
            primitive attribute tailoring dataLength: in-scope=false, multiplicity-restriction={severity=ERROR, lower-multiplicity=0, upper-multiplicity=1}, default-value-handling=NO-DEFAULT
            primitive attribute tailoring parameterId: in-scope=false, multiplicity-restriction={severity=ERROR, lower-multiplicity=0, upper-multiplicity=1}, default-value-handling=NO-DEFAULT
            primitive attribute tailoring standard: in-scope=false, multiplicity-restriction={severity=ERROR, lower-multiplicity=0, upper-multiplicity=1}, default-value-handling=NO-DEFAULT
        ObdRatioServiceNeeds
          class content conditional Invariant
            attribute-tailorings:
              primitive attribute tailoring connectionType: in-scope=false, multiplicity-restriction={severity=ERROR, lower-multiplicity=0, upper-multiplicity=1}, default-value-handling=NO-DEFAULT
              primitive attribute tailoring iumprGroup: in-scope=false, multiplicity-restriction={severity=ERROR, lower-multiplicity=0, upper-multiplicity=1}, default-value-handling=NO-DEFAULT
              reference tailoring rateBasedMonitoredEvent: in-scope=false, multiplicity-restriction={severity=ERROR, lower-multiplicity=0, upper-multiplicity=1}, unresolved-reference-restriction=severity=ERROR
              reference tailoring usedFid: in-scope=false, multiplicity-restriction={severity=ERROR, lower-multiplicity=0, upper-multiplicity=1}, unresolved-reference-restriction=severity=ERROR
        OffsetTimingConstraint
          class content conditional Invariant
            attribute-tailorings:
              aggregation tailoring maximum: in-scope=false, multiplicity-restriction={severity=ERROR, lower-multiplicity=0, upper-multiplicity=1}
              aggregation tailoring minimum: in-scope=false, multiplicity-restriction={severity=ERROR, lower-multiplicity=0, upper-multiplicity=1}
              reference tailoring source: in-scope=false, multiplicity-restriction={severity=ERROR, lower-multiplicity=0, upper-multiplicity=1}, unresolved-reference-restriction=severity=ERROR
              reference tailoring target: in-scope=false, multiplicity-restriction={severity=ERROR, lower-multiplicity=0, upper-multiplicity=1}, unresolved-reference-restriction=severity=ERROR
      abstract class tailoring OperationInAtomicSwcInstanceRef: multiplicity-restriction={severity=INFO, lower-multiplicity=0, upper-multiplicity-infinite=true}
        class content conditional Invariant
      5 x concrete class tailoring, all with in-scope=false, multiplicity-restriction={severity=INFO, lower-multiplicity=0, upper-multiplicity-infinite=true}, validation-root=false:
        OperationInSystemInstanceRef
          class content conditional Invariant
            attribute-tailorings:
              4 x reference tailoring, all with in-scope=false, unresolved-reference-restriction=severity=ERROR:
                contextComponent: multiplicity-restriction={severity=ERROR, lower-multiplicity=0, upper-multiplicity-infinite=true}
                contextComposition: multiplicity-restriction={severity=ERROR, lower-multiplicity=0, upper-multiplicity=1}
                contextPort: multiplicity-restriction={severity=ERROR, lower-multiplicity=0, upper-multiplicity=1}
                targetOperation: multiplicity-restriction={severity=ERROR, lower-multiplicity=0, upper-multiplicity=1}
        OperationInvokedEvent
          class content conditional Invariant
            attribute-tailorings:
              aggregation tailoring operation: in-scope=false, multiplicity-restriction={severity=ERROR, lower-multiplicity=0, upper-multiplicity=1}
        OverallProject
          class content conditional Invariant
            attribute-tailorings:
              aggregation tailoring desc: in-scope=false, multiplicity-restriction={severity=ERROR, lower-multiplicity=0, upper-multiplicity=1}
              aggregation tailoring label: in-scope=false, multiplicity-restriction={severity=ERROR, lower-multiplicity=0, upper-multiplicity=1}
        PModeGroupInAtomicSwcInstanceRef
          class content conditional Invariant
            attribute-tailorings:
              reference tailoring contextPPort: in-scope=false, multiplicity-restriction={severity=ERROR, lower-multiplicity=0, upper-multiplicity=1}, unresolved-reference-restriction=severity=ERROR
              reference tailoring targetModeGroup: in-scope=false, multiplicity-restriction={severity=ERROR, lower-multiplicity=0, upper-multiplicity=1}, unresolved-reference-restriction=severity=ERROR
        POperationInAtomicSwcInstanceRef
          class content conditional Invariant
            attribute-tailorings:
              reference tailoring contextPPort: in-scope=false, multiplicity-restriction={severity=ERROR, lower-multiplicity=0, upper-multiplicity=1}, unresolved-reference-restriction=severity=ERROR
              reference tailoring targetProvidedOperation: in-scope=false, multiplicity-restriction={severity=ERROR, lower-multiplicity=0, upper-multiplicity=1}, unresolved-reference-restriction=severity=ERROR
      abstract class tailoring PPortComSpec: multiplicity-restriction={severity=INFO, lower-multiplicity=0, upper-multiplicity-infinite=true}
        class content conditional Invariant
      4 x concrete class tailoring, all with in-scope=false, multiplicity-restriction={severity=INFO, lower-multiplicity=0, upper-multiplicity-infinite=true}, validation-root=false:
        PPortInCompositionInstanceRef
          class content conditional Invariant
            attribute-tailorings:
              reference tailoring contextComponent: in-scope=false, multiplicity-restriction={severity=ERROR, lower-multiplicity=0, upper-multiplicity=1}, unresolved-reference-restriction=severity=ERROR
              reference tailoring targetPPort: in-scope=false, multiplicity-restriction={severity=ERROR, lower-multiplicity=0, upper-multiplicity=1}, unresolved-reference-restriction=severity=ERROR
        PPortPrototype
          class content conditional Invariant
            attribute-tailorings:
              aggregation tailoring providedComSpec: in-scope=false, multiplicity-restriction={severity=ERROR, lower-multiplicity=0, upper-multiplicity-infinite=true}
              reference tailoring providedInterface: in-scope=false, multiplicity-restriction={severity=ERROR, lower-multiplicity=0, upper-multiplicity=1}, unresolved-reference-restriction=severity=ERROR
        PTriggerInAtomicSwcTypeInstanceRef
          class content conditional Invariant
            attribute-tailorings:
              reference tailoring contextPPort: in-scope=false, multiplicity-restriction={severity=ERROR, lower-multiplicity=0, upper-multiplicity=1}, unresolved-reference-restriction=severity=ERROR
              reference tailoring targetTrigger: in-scope=false, multiplicity-restriction={severity=ERROR, lower-multiplicity=0, upper-multiplicity=1}, unresolved-reference-restriction=severity=ERROR
        PVariableInAtomicSwcInstanceRef
          class content conditional Invariant
            attribute-tailorings:
              reference tailoring contextPPort: in-scope=false, multiplicity-restriction={severity=ERROR, lower-multiplicity=0, upper-multiplicity=1}, unresolved-reference-restriction=severity=ERROR
              reference tailoring targetDataElement: in-scope=false, multiplicity-restriction={severity=ERROR, lower-multiplicity=0, upper-multiplicity=1}, unresolved-reference-restriction=severity=ERROR
      abstract class tailoring PackageableElement: multiplicity-restriction={severity=INFO, lower-multiplicity=0, upper-multiplicity-infinite=true}
        class content conditional Invariant
      abstract class tailoring Paginateable: multiplicity-restriction={severity=INFO, lower-multiplicity=0, upper-multiplicity-infinite=true}
        class content conditional Invariant
          primitive attribute tailoring break: in-scope=false, multiplicity-restriction={severity=ERROR, lower-multiplicity=0, upper-multiplicity=1}, default-value-handling=NO-DEFAULT
          primitive attribute tailoring keepWithPrevious: in-scope=false, multiplicity-restriction={severity=ERROR, lower-multiplicity=0, upper-multiplicity=1}, default-value-handling=NO-DEFAULT
      8 x concrete class tailoring, all with in-scope=false, multiplicity-restriction={severity=INFO, lower-multiplicity=0, upper-multiplicity-infinite=true}, validation-root=false:
        ParameterAccess
          class content conditional Invariant
            attribute-tailorings:
              aggregation tailoring accessedParameter: in-scope=false, multiplicity-restriction={severity=ERROR, lower-multiplicity=0, upper-multiplicity=1}
              aggregation tailoring swDataDefProps: in-scope=false, multiplicity-restriction={severity=ERROR, lower-multiplicity=0, upper-multiplicity=1}
        ParameterDataPrototype
          class content conditional Invariant
            attribute-tailorings:
              aggregation tailoring initValue: in-scope=false, multiplicity-restriction={severity=ERROR, lower-multiplicity=0, upper-multiplicity=1}
        ParameterInAtomicSWCTypeInstanceRef
          class content conditional Invariant
            attribute-tailorings:
              4 x reference tailoring, all with in-scope=false, unresolved-reference-restriction=severity=ERROR:
                contextDataPrototype: multiplicity-restriction={severity=ERROR, lower-multiplicity=0, upper-multiplicity-infinite=true}
                portPrototype: multiplicity-restriction={severity=ERROR, lower-multiplicity=0, upper-multiplicity=1}
                rootParameterDataPrototype: multiplicity-restriction={severity=ERROR, lower-multiplicity=0, upper-multiplicity=1}
                targetDataPrototype: multiplicity-restriction={severity=ERROR, lower-multiplicity=0, upper-multiplicity=1}
        ParameterInterface
          class content conditional Invariant
            attribute-tailorings:
              aggregation tailoring parameter: in-scope=false, multiplicity-restriction={severity=ERROR, lower-multiplicity=0, upper-multiplicity-infinite=true}
        ParameterPortAnnotation
          class content conditional Invariant
            attribute-tailorings:
              reference tailoring parameter: in-scope=false, multiplicity-restriction={severity=ERROR, lower-multiplicity=0, upper-multiplicity=1}, unresolved-reference-restriction=severity=ERROR
        ParameterProvideComSpec
          class content conditional Invariant
            attribute-tailorings:
              aggregation tailoring initValue: in-scope=false, multiplicity-restriction={severity=ERROR, lower-multiplicity=0, upper-multiplicity=1}
              reference tailoring parameter: in-scope=false, multiplicity-restriction={severity=ERROR, lower-multiplicity=0, upper-multiplicity=1}, unresolved-reference-restriction=severity=ERROR
        ParameterRequireComSpec
          class content conditional Invariant
            attribute-tailorings:
              aggregation tailoring initValue: in-scope=false, multiplicity-restriction={severity=ERROR, lower-multiplicity=0, upper-multiplicity=1}
              reference tailoring parameter: in-scope=false, multiplicity-restriction={severity=ERROR, lower-multiplicity=0, upper-multiplicity=1}, unresolved-reference-restriction=severity=ERROR
        ParameterSwComponentType
          class content conditional Invariant
            attribute-tailorings:
              reference tailoring constantMapping: in-scope=false, multiplicity-restriction={severity=ERROR, lower-multiplicity=0, upper-multiplicity-infinite=true}, unresolved-reference-restriction=severity=ERROR
              reference tailoring dataTypeMapping: in-scope=false, multiplicity-restriction={severity=ERROR, lower-multiplicity=0, upper-multiplicity-infinite=true}, unresolved-reference-restriction=severity=ERROR
              aggregation tailoring instantiationDataDefProps: in-scope=false, multiplicity-restriction={severity=ERROR, lower-multiplicity=0, upper-multiplicity-infinite=true}, variation-restriction={severity=ERROR, variation=true, valid-binding-times=[BLUEPRINT-DERIVATION-TIME, SYSTEM-DESIGN-TIME, CODE-GENERATION-TIME, PRE-COMPILE-TIME, LINK-TIME, POST-BUILD]}
      abstract class tailoring Pdu: multiplicity-restriction={severity=INFO, lower-multiplicity=0, upper-multiplicity-infinite=true}
        class content conditional Invariant
          primitive attribute tailoring length: in-scope=false, multiplicity-restriction={severity=ERROR, lower-multiplicity=0, upper-multiplicity=1}, default-value-handling=NO-DEFAULT
      9 x concrete class tailoring, all with in-scope=false, multiplicity-restriction={severity=INFO, lower-multiplicity=0, upper-multiplicity-infinite=true}, validation-root=false:
        PduMappingDefaultValue
          class content conditional Invariant
            attribute-tailorings:
              aggregation tailoring defaultValueElement: in-scope=false, multiplicity-restriction={severity=ERROR, lower-multiplicity=0, upper-multiplicity-infinite=true}
        PduToFrameMapping
          class content conditional Invariant
            attribute-tailorings:
              primitive attribute tailoring packingByteOrder: in-scope=false, multiplicity-restriction={severity=ERROR, lower-multiplicity=0, upper-multiplicity=1}, default-value-handling=NO-DEFAULT
              reference tailoring pdu: in-scope=false, multiplicity-restriction={severity=ERROR, lower-multiplicity=0, upper-multiplicity=1}, unresolved-reference-restriction=severity=ERROR
              primitive attribute tailoring startPosition: in-scope=false, multiplicity-restriction={severity=ERROR, lower-multiplicity=0, upper-multiplicity=1}, default-value-handling=NO-DEFAULT
              primitive attribute tailoring updateIndicationBitPosition: in-scope=false, multiplicity-restriction={severity=ERROR, lower-multiplicity=0, upper-multiplicity=1}, default-value-handling=NO-DEFAULT
        PduTriggering
          class content conditional Invariant
            attribute-tailorings:
              reference tailoring iPdu: in-scope=false, multiplicity-restriction={severity=ERROR, lower-multiplicity=0, upper-multiplicity=1}, unresolved-reference-restriction=severity=ERROR
              reference tailoring iPduPort: in-scope=false, multiplicity-restriction={severity=ERROR, lower-multiplicity=0, upper-multiplicity-infinite=true}, unresolved-reference-restriction=severity=ERROR
              reference tailoring iSignalTriggering: in-scope=false, multiplicity-restriction={severity=ERROR, lower-multiplicity=0, upper-multiplicity-infinite=true}, variation-restriction={severity=ERROR, variation=true, valid-binding-times=[BLUEPRINT-DERIVATION-TIME, SYSTEM-DESIGN-TIME, CODE-GENERATION-TIME, PRE-COMPILE-TIME, LINK-TIME, POST-BUILD]}, unresolved-reference-restriction=severity=ERROR
        PdurIPduGroup
          class content conditional Invariant
            attribute-tailorings:
              primitive attribute tailoring communicationMode: in-scope=false, multiplicity-restriction={severity=ERROR, lower-multiplicity=0, upper-multiplicity=1}, default-value-handling=NO-DEFAULT
              reference tailoring iPdu: in-scope=false, multiplicity-restriction={severity=ERROR, lower-multiplicity=0, upper-multiplicity-infinite=true}, variation-restriction={severity=ERROR, variation=true, valid-binding-times=[BLUEPRINT-DERIVATION-TIME, SYSTEM-DESIGN-TIME, CODE-GENERATION-TIME, PRE-COMPILE-TIME, LINK-TIME, POST-BUILD]}, unresolved-reference-restriction=severity=ERROR
        PerInstanceMemory
          class content conditional Invariant
            primitive attribute tailoring initValue: in-scope=false, multiplicity-restriction={severity=ERROR, lower-multiplicity=0, upper-multiplicity=1}, default-value-handling=NO-DEFAULT
            primitive attribute tailoring type: in-scope=false, multiplicity-restriction={severity=ERROR, lower-multiplicity=0, upper-multiplicity=1}, default-value-handling=NO-DEFAULT
            primitive attribute tailoring typeDefinition: in-scope=false, multiplicity-restriction={severity=ERROR, lower-multiplicity=0, upper-multiplicity=1}, default-value-handling=NO-DEFAULT
        PerInstanceMemorySize
          class content conditional Invariant
            attribute-tailorings:
              primitive attribute tailoring alignment: in-scope=false, multiplicity-restriction={severity=ERROR, lower-multiplicity=0, upper-multiplicity=1}, default-value-handling=NO-DEFAULT
              reference tailoring perInstanceMemory: in-scope=false, multiplicity-restriction={severity=ERROR, lower-multiplicity=0, upper-multiplicity=1}, unresolved-reference-restriction=severity=ERROR
              primitive attribute tailoring size: in-scope=false, multiplicity-restriction={severity=ERROR, lower-multiplicity=0, upper-multiplicity=1}, variation-restriction={severity=ERROR, variation=true, valid-binding-times=[BLUEPRINT-DERIVATION-TIME, SYSTEM-DESIGN-TIME, CODE-GENERATION-TIME, PRE-COMPILE-TIME, LINK-TIME, POST-BUILD]}, default-value-handling=NO-DEFAULT
        PeriodicEventTriggering
          class content conditional Invariant
            attribute-tailorings:
              aggregation tailoring jitter: in-scope=false, multiplicity-restriction={severity=ERROR, lower-multiplicity=0, upper-multiplicity=1}
              aggregation tailoring minimumInterArrivalTime: in-scope=false, multiplicity-restriction={severity=ERROR, lower-multiplicity=0, upper-multiplicity=1}
              aggregation tailoring period: in-scope=false, multiplicity-restriction={severity=ERROR, lower-multiplicity=0, upper-multiplicity=1}
        PermissibleSignalPath
          class content conditional Invariant
            attribute-tailorings:
              aggregation tailoring operation: in-scope=false, multiplicity-restriction={severity=ERROR, lower-multiplicity=0, upper-multiplicity-infinite=true}
              reference tailoring physicalChannel: in-scope=false, multiplicity-restriction={severity=ERROR, lower-multiplicity=0, upper-multiplicity-infinite=true}, unresolved-reference-restriction=severity=ERROR
              aggregation tailoring signal: in-scope=false, multiplicity-restriction={severity=ERROR, lower-multiplicity=0, upper-multiplicity-infinite=true}
        PhysConstrs
          class content conditional Invariant
            attribute-tailorings:
              aggregation tailoring lowerLimit: in-scope=false, multiplicity-restriction={severity=ERROR, lower-multiplicity=0, upper-multiplicity=1}
              primitive attribute tailoring maxDiff: in-scope=false, multiplicity-restriction={severity=ERROR, lower-multiplicity=0, upper-multiplicity=1}, default-value-handling=NO-DEFAULT
              primitive attribute tailoring maxGradient: in-scope=false, multiplicity-restriction={severity=ERROR, lower-multiplicity=0, upper-multiplicity=1}, default-value-handling=NO-DEFAULT
              primitive attribute tailoring monotony: in-scope=false, multiplicity-restriction={severity=ERROR, lower-multiplicity=0, upper-multiplicity=1}, default-value-handling=NO-DEFAULT
              aggregation tailoring scaleConstr: in-scope=false, multiplicity-restriction={severity=ERROR, lower-multiplicity=0, upper-multiplicity-infinite=true}
              aggregation tailoring swRelatedConstrs: in-scope=false, multiplicity-restriction={severity=ERROR, lower-multiplicity=0, upper-multiplicity=1}
              reference tailoring unit: in-scope=false, multiplicity-restriction={severity=ERROR, lower-multiplicity=0, upper-multiplicity=1}, unresolved-reference-restriction=severity=ERROR
              aggregation tailoring upperLimit: in-scope=false, multiplicity-restriction={severity=ERROR, lower-multiplicity=0, upper-multiplicity=1}
      abstract class tailoring PhysicalChannel: multiplicity-restriction={severity=INFO, lower-multiplicity=0, upper-multiplicity-infinite=true}
        class content conditional Invariant
          attribute-tailorings:
            reference tailoring commConnector: in-scope=false, multiplicity-restriction={severity=ERROR, lower-multiplicity=0, upper-multiplicity-infinite=true}, variation-restriction={severity=ERROR, variation=true, valid-binding-times=[BLUEPRINT-DERIVATION-TIME, SYSTEM-DESIGN-TIME, CODE-GENERATION-TIME, PRE-COMPILE-TIME, LINK-TIME, POST-BUILD]}, unresolved-reference-restriction=severity=ERROR
            aggregation tailoring frameTriggering: in-scope=false, multiplicity-restriction={severity=ERROR, lower-multiplicity=0, upper-multiplicity-infinite=true}, variation-restriction={severity=ERROR, variation=true, valid-binding-times=[BLUEPRINT-DERIVATION-TIME, SYSTEM-DESIGN-TIME, CODE-GENERATION-TIME, PRE-COMPILE-TIME, LINK-TIME, POST-BUILD]}
            aggregation tailoring iSignalTriggering: in-scope=false, multiplicity-restriction={severity=ERROR, lower-multiplicity=0, upper-multiplicity-infinite=true}, variation-restriction={severity=ERROR, variation=true, valid-binding-times=[BLUEPRINT-DERIVATION-TIME, SYSTEM-DESIGN-TIME, CODE-GENERATION-TIME, PRE-COMPILE-TIME, LINK-TIME, POST-BUILD]}
            aggregation tailoring pduTriggering: in-scope=false, multiplicity-restriction={severity=ERROR, lower-multiplicity=0, upper-multiplicity-infinite=true}, variation-restriction={severity=ERROR, variation=true, valid-binding-times=[BLUEPRINT-DERIVATION-TIME, SYSTEM-DESIGN-TIME, CODE-GENERATION-TIME, PRE-COMPILE-TIME, LINK-TIME, POST-BUILD]}
      4 x concrete class tailoring, all with in-scope=false, multiplicity-restriction={severity=INFO, lower-multiplicity=0, upper-multiplicity-infinite=true}, validation-root=false:
        PhysicalDimension
          class content conditional Invariant
            7 x primitive attribute tailoring, all with in-scope=false, multiplicity-restriction={severity=ERROR, lower-multiplicity=0, upper-multiplicity=1}, default-value-handling=NO-DEFAULT:
              currentExp
              lengthExp
              luminousIntensityExp
              massExp
              molarAmountExp
              temperatureExp
              timeExp
        PortAPIOption
          class content conditional Invariant
            attribute-tailorings:
              primitive attribute tailoring enableTakeAddress: in-scope=false, multiplicity-restriction={severity=ERROR, lower-multiplicity=0, upper-multiplicity=1}, default-value-handling=NO-DEFAULT
              primitive attribute tailoring indirectAPI: in-scope=false, multiplicity-restriction={severity=ERROR, lower-multiplicity=0, upper-multiplicity=1}, default-value-handling=NO-DEFAULT
              reference tailoring port: in-scope=false, multiplicity-restriction={severity=ERROR, lower-multiplicity=0, upper-multiplicity=1}, unresolved-reference-restriction=severity=ERROR
              aggregation tailoring portArgValue: in-scope=false, multiplicity-restriction={severity=ERROR, lower-multiplicity=0, upper-multiplicity-infinite=true}
        PortDefinedArgumentValue
          class content conditional Invariant
            attribute-tailorings:
              aggregation tailoring value: in-scope=false, multiplicity-restriction={severity=ERROR, lower-multiplicity=0, upper-multiplicity=1}
              reference tailoring valueType: in-scope=false, multiplicity-restriction={severity=ERROR, lower-multiplicity=0, upper-multiplicity=1}, unresolved-reference-restriction=severity=ERROR
        PortGroup
          class content conditional Invariant
            attribute-tailorings:
              aggregation tailoring innerGroup: in-scope=false, multiplicity-restriction={severity=ERROR, lower-multiplicity=0, upper-multiplicity-infinite=true}
              reference tailoring outerPort: in-scope=false, multiplicity-restriction={severity=ERROR, lower-multiplicity=0, upper-multiplicity-infinite=true}, variation-restriction={severity=ERROR, variation=true, valid-binding-times=[BLUEPRINT-DERIVATION-TIME, SYSTEM-DESIGN-TIME, CODE-GENERATION-TIME, PRE-COMPILE-TIME, LINK-TIME, POST-BUILD]}, unresolved-reference-restriction=severity=ERROR
      abstract class tailoring PortInCompositionTypeInstanceRef: multiplicity-restriction={severity=INFO, lower-multiplicity=0, upper-multiplicity-infinite=true}
        class content conditional Invariant
      abstract class tailoring PortInterface: multiplicity-restriction={severity=INFO, lower-multiplicity=0, upper-multiplicity-infinite=true}
        class content conditional Invariant
          primitive attribute tailoring isService: in-scope=false, multiplicity-restriction={severity=ERROR, lower-multiplicity=0, upper-multiplicity=1}, default-value-handling=NO-DEFAULT
      concrete class tailoring PortInterfaceBlueprintMapping: in-scope=false, multiplicity-restriction={severity=INFO, lower-multiplicity=0, upper-multiplicity-infinite=true}, validation-root=false
        class content conditional Invariant
          attribute-tailorings:
            reference tailoring derivedPortInterface: in-scope=false, multiplicity-restriction={severity=ERROR, lower-multiplicity=0, upper-multiplicity=1}, unresolved-reference-restriction=severity=ERROR
            reference tailoring portInterfaceBlueprint: in-scope=false, multiplicity-restriction={severity=ERROR, lower-multiplicity=0, upper-multiplicity=1}, unresolved-reference-restriction=severity=ERROR
      abstract class tailoring PortInterfaceMapping: multiplicity-restriction={severity=INFO, lower-multiplicity=0, upper-multiplicity-infinite=true}
        class content conditional Invariant
      concrete class tailoring PortInterfaceMappingSet: in-scope=false, multiplicity-restriction={severity=INFO, lower-multiplicity=0, upper-multiplicity-infinite=true}, validation-root=false
        class content conditional Invariant
          attribute-tailorings:
            aggregation tailoring portInterfaceMapping: in-scope=false, multiplicity-restriction={severity=ERROR, lower-multiplicity=0, upper-multiplicity-infinite=true}
      abstract class tailoring PortPrototype: multiplicity-restriction={severity=INFO, lower-multiplicity=0, upper-multiplicity-infinite=true}
        class content conditional Invariant
          attribute-tailorings:
            8 x aggregation tailoring, all with in-scope=false:
              clientServerAnnotation: multiplicity-restriction={severity=ERROR, lower-multiplicity=0, upper-multiplicity-infinite=true}
              delegatedPortAnnotation: multiplicity-restriction={severity=ERROR, lower-multiplicity=0, upper-multiplicity=1}
              ioHwAbstractionServerAnnotation: multiplicity-restriction={severity=ERROR, lower-multiplicity=0, upper-multiplicity-infinite=true}
              modePortAnnotation: multiplicity-restriction={severity=ERROR, lower-multiplicity=0, upper-multiplicity-infinite=true}
              nvDataPortAnnotation: multiplicity-restriction={severity=ERROR, lower-multiplicity=0, upper-multiplicity-infinite=true}
              parameterPortAnnotation: multiplicity-restriction={severity=ERROR, lower-multiplicity=0, upper-multiplicity-infinite=true}
              senderReceiverAnnotation: multiplicity-restriction={severity=ERROR, lower-multiplicity=0, upper-multiplicity-infinite=true}
              triggerPortAnnotation: multiplicity-restriction={severity=ERROR, lower-multiplicity=0, upper-multiplicity-infinite=true}
      12 x concrete class tailoring, all with in-scope=false, multiplicity-restriction={severity=INFO, lower-multiplicity=0, upper-multiplicity-infinite=true}, validation-root=false:
        PortPrototypeBlueprint
          class content conditional Invariant
            attribute-tailorings:
              aggregation tailoring initValue: in-scope=false, multiplicity-restriction={severity=ERROR, lower-multiplicity=0, upper-multiplicity-infinite=true}
              reference tailoring interface: in-scope=false, multiplicity-restriction={severity=ERROR, lower-multiplicity=0, upper-multiplicity=1}, unresolved-reference-restriction=severity=ERROR
        PortPrototypeBlueprintInitValue
          class content conditional Invariant
            attribute-tailorings:
              reference tailoring dataPrototype: in-scope=false, multiplicity-restriction={severity=ERROR, lower-multiplicity=0, upper-multiplicity=1}, unresolved-reference-restriction=severity=ERROR
              aggregation tailoring value: in-scope=false, multiplicity-restriction={severity=ERROR, lower-multiplicity=0, upper-multiplicity=1}
        PortPrototypeBlueprintMapping
          class content conditional Invariant
            attribute-tailorings:
              reference tailoring derivedPortPrototype: in-scope=false, multiplicity-restriction={severity=ERROR, lower-multiplicity=0, upper-multiplicity=1}, unresolved-reference-restriction=severity=ERROR
              reference tailoring portPrototypeBlueprint: in-scope=false, multiplicity-restriction={severity=ERROR, lower-multiplicity=0, upper-multiplicity=1}, unresolved-reference-restriction=severity=ERROR
        PositiveIntegerValueVariationPoint
          class content conditional Invariant
        PostBuildVariantCondition
          class content conditional Invariant
            attribute-tailorings:
              reference tailoring matchingCriterion: in-scope=false, multiplicity-restriction={severity=ERROR, lower-multiplicity=0, upper-multiplicity=1}, unresolved-reference-restriction=severity=ERROR
              primitive attribute tailoring value: in-scope=false, multiplicity-restriction={severity=ERROR, lower-multiplicity=0, upper-multiplicity=1}, variation-restriction={severity=ERROR, variation=true, valid-binding-times=[BLUEPRINT-DERIVATION-TIME, SYSTEM-DESIGN-TIME, CODE-GENERATION-TIME, PRE-COMPILE-TIME, LINK-TIME, POST-BUILD]}, default-value-handling=NO-DEFAULT
        PostBuildVariantCriterion
          class content conditional Invariant
            attribute-tailorings:
              reference tailoring compuMethod: in-scope=false, multiplicity-restriction={severity=ERROR, lower-multiplicity=0, upper-multiplicity=1}, unresolved-reference-restriction=severity=ERROR
        PostBuildVariantCriterionValue
          class content conditional Invariant
            attribute-tailorings:
              aggregation tailoring annotation: in-scope=false, multiplicity-restriction={severity=ERROR, lower-multiplicity=0, upper-multiplicity-infinite=true}
              primitive attribute tailoring value: in-scope=false, multiplicity-restriction={severity=ERROR, lower-multiplicity=0, upper-multiplicity=1}, variation-restriction={severity=ERROR, variation=true, valid-binding-times=[BLUEPRINT-DERIVATION-TIME, SYSTEM-DESIGN-TIME, CODE-GENERATION-TIME, PRE-COMPILE-TIME, LINK-TIME, POST-BUILD]}, default-value-handling=NO-DEFAULT
              reference tailoring variantCriterion: in-scope=false, multiplicity-restriction={severity=ERROR, lower-multiplicity=0, upper-multiplicity=1}, unresolved-reference-restriction=severity=ERROR
        PostBuildVariantCriterionValueSet
          class content conditional Invariant
            attribute-tailorings:
              aggregation tailoring postBuildVariantCriterionValue: in-scope=false, multiplicity-restriction={severity=ERROR, lower-multiplicity=0, upper-multiplicity-infinite=true}
        PredefinedChapter
          class content conditional Invariant
            attribute-tailorings:
              aggregation tailoring chapterModel: in-scope=false, multiplicity-restriction={severity=ERROR, lower-multiplicity=0, upper-multiplicity=1}
        PredefinedVariant
          class content conditional Invariant
            attribute-tailorings:
              reference tailoring includedVariant: in-scope=false, multiplicity-restriction={severity=ERROR, lower-multiplicity=0, upper-multiplicity-infinite=true}, unresolved-reference-restriction=severity=ERROR
              reference tailoring postBuildVariantCriterionValueSet: in-scope=false, multiplicity-restriction={severity=ERROR, lower-multiplicity=0, upper-multiplicity-infinite=true}, unresolved-reference-restriction=severity=ERROR
              reference tailoring swSystemconstantValueSet: in-scope=false, multiplicity-restriction={severity=ERROR, lower-multiplicity=0, upper-multiplicity-infinite=true}, unresolved-reference-restriction=severity=ERROR
        PrmChar
          class content conditional Invariant
            attribute-tailorings:
              aggregation tailoring cond: in-scope=false, multiplicity-restriction={severity=ERROR, lower-multiplicity=0, upper-multiplicity=1}
              aggregation tailoring prmCharContents: in-scope=false, multiplicity-restriction={severity=ERROR, lower-multiplicity=0, upper-multiplicity=1}
              aggregation tailoring remark: in-scope=false, multiplicity-restriction={severity=ERROR, lower-multiplicity=0, upper-multiplicity=1}
        PrmCharAbsTol
          class content conditional Invariant
            primitive attribute tailoring abs: in-scope=false, multiplicity-restriction={severity=ERROR, lower-multiplicity=0, upper-multiplicity=1}, default-value-handling=NO-DEFAULT
            primitive attribute tailoring tol: in-scope=false, multiplicity-restriction={severity=ERROR, lower-multiplicity=0, upper-multiplicity=1}, default-value-handling=NO-DEFAULT
      abstract class tailoring PrmCharContents: multiplicity-restriction={severity=INFO, lower-multiplicity=0, upper-multiplicity-infinite=true}
        class content conditional Invariant
      concrete class tailoring PrmCharMinTypMax: in-scope=false, multiplicity-restriction={severity=INFO, lower-multiplicity=0, upper-multiplicity-infinite=true}, validation-root=false
        class content conditional Invariant
          primitive attribute tailoring max: in-scope=false, multiplicity-restriction={severity=ERROR, lower-multiplicity=0, upper-multiplicity=1}, default-value-handling=NO-DEFAULT
          primitive attribute tailoring min: in-scope=false, multiplicity-restriction={severity=ERROR, lower-multiplicity=0, upper-multiplicity=1}, default-value-handling=NO-DEFAULT
          primitive attribute tailoring typ: in-scope=false, multiplicity-restriction={severity=ERROR, lower-multiplicity=0, upper-multiplicity=1}, default-value-handling=NO-DEFAULT
      concrete class tailoring PrmCharNumericalContents: in-scope=false, multiplicity-restriction={severity=INFO, lower-multiplicity=0, upper-multiplicity-infinite=true}, validation-root=false
        class content conditional Invariant
          attribute-tailorings:
            aggregation tailoring prmCharNumericalValueType: in-scope=false, multiplicity-restriction={severity=ERROR, lower-multiplicity=0, upper-multiplicity=1}
            aggregation tailoring prmUnit: in-scope=false, multiplicity-restriction={severity=ERROR, lower-multiplicity=0, upper-multiplicity=1}
      abstract class tailoring PrmCharNumericalValue: multiplicity-restriction={severity=INFO, lower-multiplicity=0, upper-multiplicity-infinite=true}
        class content conditional Invariant
      10 x concrete class tailoring, all with in-scope=false, multiplicity-restriction={severity=INFO, lower-multiplicity=0, upper-multiplicity-infinite=true}, validation-root=false:
        PrmCharTextualContents
          class content conditional Invariant
            primitive attribute tailoring text: in-scope=false, multiplicity-restriction={severity=ERROR, lower-multiplicity=0, upper-multiplicity=1}, default-value-handling=NO-DEFAULT
        Prms
          class content conditional Invariant
            attribute-tailorings:
              aggregation tailoring label: in-scope=false, multiplicity-restriction={severity=ERROR, lower-multiplicity=0, upper-multiplicity=1}
              aggregation tailoring prm: in-scope=false, multiplicity-restriction={severity=ERROR, lower-multiplicity=0, upper-multiplicity-infinite=true}
        ProgCode
          class content conditional Invariant
            8 x primitive attribute tailoring, all with in-scope=false, multiplicity-restriction={severity=ERROR, lower-multiplicity=0, upper-multiplicity=1}, default-value-handling=NO-DEFAULT:
              codeFile
              encryption
              entrypoint
              langSubset
              programLang
              revision
              syntax
              usedLibs
        Project
          class content conditional Invariant
            attribute-tailorings:
              4 x aggregation tailoring, all with in-scope=false:
                companyData: multiplicity-restriction={severity=ERROR, lower-multiplicity=0, upper-multiplicity-infinite=true}
                desc: multiplicity-restriction={severity=ERROR, lower-multiplicity=0, upper-multiplicity=1}
                generalProjectData: multiplicity-restriction={severity=ERROR, lower-multiplicity=0, upper-multiplicity=1}
                label: multiplicity-restriction={severity=ERROR, lower-multiplicity=0, upper-multiplicity=1}
        ProjectData
          class content conditional Invariant
            attribute-tailorings:
              aggregation tailoring overallProject: in-scope=false, multiplicity-restriction={severity=ERROR, lower-multiplicity=0, upper-multiplicity=1}
              aggregation tailoring project: in-scope=false, multiplicity-restriction={severity=ERROR, lower-multiplicity=0, upper-multiplicity=1}
        QueuedReceiverComSpec
          class content conditional Invariant
            primitive attribute tailoring queueLength: in-scope=false, multiplicity-restriction={severity=ERROR, lower-multiplicity=0, upper-multiplicity=1}, default-value-handling=NO-DEFAULT
        QueuedSenderComSpec
          class content conditional Invariant
        RModeGroupInAtomicSWCInstanceRef
          class content conditional Invariant
            attribute-tailorings:
              reference tailoring contextRPort: in-scope=false, multiplicity-restriction={severity=ERROR, lower-multiplicity=0, upper-multiplicity=1}, unresolved-reference-restriction=severity=ERROR
              reference tailoring targetModeGroup: in-scope=false, multiplicity-restriction={severity=ERROR, lower-multiplicity=0, upper-multiplicity=1}, unresolved-reference-restriction=severity=ERROR
        RModeInAtomicSwcInstanceRef
          class content conditional Invariant
            attribute-tailorings:
              reference tailoring contextModeDeclarationGroupPrototype: in-scope=false, multiplicity-restriction={severity=ERROR, lower-multiplicity=0, upper-multiplicity=1}, unresolved-reference-restriction=severity=ERROR
              reference tailoring contextPort: in-scope=false, multiplicity-restriction={severity=ERROR, lower-multiplicity=0, upper-multiplicity=1}, unresolved-reference-restriction=severity=ERROR
              reference tailoring targetModeDeclaration: in-scope=false, multiplicity-restriction={severity=ERROR, lower-multiplicity=0, upper-multiplicity=1}, unresolved-reference-restriction=severity=ERROR
        ROperationInAtomicSwcInstanceRef
          class content conditional Invariant
            attribute-tailorings:
              reference tailoring contextRPort: in-scope=false, multiplicity-restriction={severity=ERROR, lower-multiplicity=0, upper-multiplicity=1}, unresolved-reference-restriction=severity=ERROR
              reference tailoring targetRequiredOperation: in-scope=false, multiplicity-restriction={severity=ERROR, lower-multiplicity=0, upper-multiplicity=1}, unresolved-reference-restriction=severity=ERROR
      abstract class tailoring RPortComSpec: multiplicity-restriction={severity=INFO, lower-multiplicity=0, upper-multiplicity-infinite=true}
        class content conditional Invariant
      concrete class tailoring RPortInCompositionInstanceRef: in-scope=false, multiplicity-restriction={severity=INFO, lower-multiplicity=0, upper-multiplicity-infinite=true}, validation-root=false
        class content conditional Invariant
          attribute-tailorings:
            reference tailoring contextComponent: in-scope=false, multiplicity-restriction={severity=ERROR, lower-multiplicity=0, upper-multiplicity=1}, unresolved-reference-restriction=severity=ERROR
            reference tailoring targetRPort: in-scope=false, multiplicity-restriction={severity=ERROR, lower-multiplicity=0, upper-multiplicity=1}, unresolved-reference-restriction=severity=ERROR
      concrete class tailoring RPortPrototype: in-scope=false, multiplicity-restriction={severity=INFO, lower-multiplicity=0, upper-multiplicity-infinite=true}, validation-root=false
        class content conditional Invariant
          attribute-tailorings:
            aggregation tailoring requiredComSpec: in-scope=false, multiplicity-restriction={severity=ERROR, lower-multiplicity=0, upper-multiplicity-infinite=true}
            reference tailoring requiredInterface: in-scope=false, multiplicity-restriction={severity=ERROR, lower-multiplicity=0, upper-multiplicity=1}, unresolved-reference-restriction=severity=ERROR
      abstract class tailoring RTEEvent: multiplicity-restriction={severity=INFO, lower-multiplicity=0, upper-multiplicity-infinite=true}
        class content conditional Invariant
          attribute-tailorings:
            aggregation tailoring disabledMode: in-scope=false, multiplicity-restriction={severity=ERROR, lower-multiplicity=0, upper-multiplicity-infinite=true}
            reference tailoring startOnEvent: in-scope=false, multiplicity-restriction={severity=ERROR, lower-multiplicity=0, upper-multiplicity=1}, unresolved-reference-restriction=severity=ERROR
      concrete class tailoring RTriggerInAtomicSwcInstanceRef: in-scope=false, multiplicity-restriction={severity=INFO, lower-multiplicity=0, upper-multiplicity-infinite=true}, validation-root=false
        class content conditional Invariant
          attribute-tailorings:
            reference tailoring contextRPort: in-scope=false, multiplicity-restriction={severity=ERROR, lower-multiplicity=0, upper-multiplicity=1}, unresolved-reference-restriction=severity=ERROR
            reference tailoring targetTrigger: in-scope=false, multiplicity-restriction={severity=ERROR, lower-multiplicity=0, upper-multiplicity=1}, unresolved-reference-restriction=severity=ERROR
      concrete class tailoring RVariableInAtomicSwcInstanceRef: in-scope=false, multiplicity-restriction={severity=INFO, lower-multiplicity=0, upper-multiplicity-infinite=true}, validation-root=false
        class content conditional Invariant
          attribute-tailorings:
            reference tailoring contextRPort: in-scope=false, multiplicity-restriction={severity=ERROR, lower-multiplicity=0, upper-multiplicity=1}, unresolved-reference-restriction=severity=ERROR
            reference tailoring targetDataElement: in-scope=false, multiplicity-restriction={severity=ERROR, lower-multiplicity=0, upper-multiplicity=1}, unresolved-reference-restriction=severity=ERROR
      concrete class tailoring ReceiverAnnotation: in-scope=false, multiplicity-restriction={severity=INFO, lower-multiplicity=0, upper-multiplicity-infinite=true}, validation-root=false
        class content conditional Invariant
          attribute-tailorings:
            aggregation tailoring signalAge: in-scope=false, multiplicity-restriction={severity=ERROR, lower-multiplicity=0, upper-multiplicity=1}
      abstract class tailoring ReceiverComSpec: multiplicity-restriction={severity=INFO, lower-multiplicity=0, upper-multiplicity-infinite=true}
        class content conditional Invariant
          attribute-tailorings:
            reference tailoring dataElement: in-scope=false, multiplicity-restriction={severity=ERROR, lower-multiplicity=0, upper-multiplicity=1}, unresolved-reference-restriction=severity=ERROR
            primitive attribute tailoring handleOutOfRange: in-scope=false, multiplicity-restriction={severity=ERROR, lower-multiplicity=0, upper-multiplicity=1}, default-value-handling=NO-DEFAULT
            aggregation tailoring networkRepresentation: in-scope=false, multiplicity-restriction={severity=ERROR, lower-multiplicity=0, upper-multiplicity=1}
            primitive attribute tailoring usesEndToEndProtection: in-scope=false, multiplicity-restriction={severity=ERROR, lower-multiplicity=0, upper-multiplicity=1}, variation-restriction={severity=ERROR, variation=true, valid-binding-times=[BLUEPRINT-DERIVATION-TIME, SYSTEM-DESIGN-TIME, CODE-GENERATION-TIME, PRE-COMPILE-TIME, LINK-TIME, POST-BUILD]}, default-value-handling=NO-DEFAULT
      concrete class tailoring RecordValueSpecification: in-scope=false, multiplicity-restriction={severity=INFO, lower-multiplicity=0, upper-multiplicity-infinite=true}, validation-root=false
        class content conditional Invariant
          attribute-tailorings:
            aggregation tailoring field: in-scope=false, multiplicity-restriction={severity=ERROR, lower-multiplicity=0, upper-multiplicity-infinite=true}, variation-restriction={severity=ERROR, variation=true, valid-binding-times=[BLUEPRINT-DERIVATION-TIME, SYSTEM-DESIGN-TIME, CODE-GENERATION-TIME, PRE-COMPILE-TIME, LINK-TIME, POST-BUILD]}
      concrete class tailoring ReferenceBase: in-scope=false, multiplicity-restriction={severity=INFO, lower-multiplicity=0, upper-multiplicity-infinite=true}, validation-root=false
        class content conditional Invariant
          attribute-tailorings:
            4 x primitive attribute tailoring, all with in-scope=false, default-value-handling=NO-DEFAULT:
              baseIsThisPackage: multiplicity-restriction={severity=ERROR, lower-multiplicity=0, upper-multiplicity=1}
              globalElement: multiplicity-restriction={severity=ERROR, lower-multiplicity=0, upper-multiplicity-infinite=true}
              isDefault: multiplicity-restriction={severity=ERROR, lower-multiplicity=0, upper-multiplicity=1}
              isGlobal: multiplicity-restriction={severity=ERROR, lower-multiplicity=0, upper-multiplicity=1}
            reference tailoring package: in-scope=false, multiplicity-restriction={severity=ERROR, lower-multiplicity=0, upper-multiplicity=1}, unresolved-reference-restriction=severity=ERROR
            primitive attribute tailoring shortLabel: in-scope=false, multiplicity-restriction={severity=ERROR, lower-multiplicity=0, upper-multiplicity=1}, default-value-handling=NO-DEFAULT
      concrete class tailoring ReferenceValueSpecification: in-scope=false, multiplicity-restriction={severity=INFO, lower-multiplicity=0, upper-multiplicity-infinite=true}, validation-root=false
        class content conditional Invariant
          attribute-tailorings:
            reference tailoring referenceValue: in-scope=false, multiplicity-restriction={severity=ERROR, lower-multiplicity=0, upper-multiplicity=1}, unresolved-reference-restriction=severity=ERROR
      abstract class tailoring Referrable: multiplicity-restriction={severity=INFO, lower-multiplicity=0, upper-multiplicity-infinite=true}
        class content conditional Invariant
          primitive attribute tailoring shortName: in-scope=false, multiplicity-restriction={severity=ERROR, lower-multiplicity=1, upper-multiplicity=1}, default-value-handling=NO-DEFAULT
      21 x concrete class tailoring, all with in-scope=false, multiplicity-restriction={severity=INFO, lower-multiplicity=0, upper-multiplicity-infinite=true}, validation-root=false:
        RelatedDoc
          class content conditional Invariant
            attribute-tailorings:
              aggregation tailoring desc: in-scope=false, multiplicity-restriction={severity=ERROR, lower-multiplicity=0, upper-multiplicity=1}
              aggregation tailoring xdoc: in-scope=false, multiplicity-restriction={severity=ERROR, lower-multiplicity=0, upper-multiplicity=1}
        RelativeTolerance
          class content conditional Invariant
            primitive attribute tailoring relative: in-scope=false, multiplicity-restriction={severity=ERROR, lower-multiplicity=0, upper-multiplicity=1}, default-value-handling=NO-DEFAULT
        Reliability
          class content conditional Invariant
            attribute-tailorings:
              aggregation tailoring introduction: in-scope=false, multiplicity-restriction={severity=ERROR, lower-multiplicity=0, upper-multiplicity=1}
              aggregation tailoring ncoi3: in-scope=false, multiplicity-restriction={severity=ERROR, lower-multiplicity=0, upper-multiplicity=1}
              aggregation tailoring reliabilityPrms: in-scope=false, multiplicity-restriction={severity=ERROR, lower-multiplicity=0, upper-multiplicity=1}
        ReliabilityPrms
          class content conditional Invariant
            attribute-tailorings:
              aggregation tailoring mtbf: in-scope=false, multiplicity-restriction={severity=ERROR, lower-multiplicity=0, upper-multiplicity-infinite=true}  # Multiplicity is 0..* since attribute is contained in mixed / mixedString class.
              aggregation tailoring ppm: in-scope=false, multiplicity-restriction={severity=ERROR, lower-multiplicity=0, upper-multiplicity-infinite=true}  # Multiplicity is 0..* since attribute is contained in mixed / mixedString class.
              aggregation tailoring prm: in-scope=false, multiplicity-restriction={severity=ERROR, lower-multiplicity=0, upper-multiplicity-infinite=true}  # Multiplicity is 0..* since attribute is contained in mixed / mixedString class.
        Remark
          class content conditional Invariant
            attribute-tailorings:
              aggregation tailoring p: in-scope=false, multiplicity-restriction={severity=ERROR, lower-multiplicity=0, upper-multiplicity-infinite=true}  # Multiplicity is 0..* since attribute is contained in mixed / mixedString class.
              aggregation tailoring verbatim: in-scope=false, multiplicity-restriction={severity=ERROR, lower-multiplicity=0, upper-multiplicity-infinite=true}  # Multiplicity is 0..* since attribute is contained in mixed / mixedString class.
        Requirement
          class content conditional Invariant
            attribute-tailorings:
              8 x aggregation tailoring, all with in-scope=false:
                addInfo: multiplicity-restriction={severity=ERROR, lower-multiplicity=0, upper-multiplicity=1}
                criticalAspects: multiplicity-restriction={severity=ERROR, lower-multiplicity=0, upper-multiplicity=1}
                realtimeRequirements: multiplicity-restriction={severity=ERROR, lower-multiplicity=0, upper-multiplicity=1}
                requirement: multiplicity-restriction={severity=ERROR, lower-multiplicity=0, upper-multiplicity-infinite=true}
                requirementBody: multiplicity-restriction={severity=ERROR, lower-multiplicity=0, upper-multiplicity=1}
                requirementsDependency: multiplicity-restriction={severity=ERROR, lower-multiplicity=0, upper-multiplicity=1}
                risks: multiplicity-restriction={severity=ERROR, lower-multiplicity=0, upper-multiplicity=1}
                technicalAspects: multiplicity-restriction={severity=ERROR, lower-multiplicity=0, upper-multiplicity=1}
        RequirementSpec
          class content conditional Invariant
            attribute-tailorings:
              aggregation tailoring adminData: in-scope=false, multiplicity-restriction={severity=ERROR, lower-multiplicity=0, upper-multiplicity=1}
              aggregation tailoring introduction: in-scope=false, multiplicity-restriction={severity=ERROR, lower-multiplicity=0, upper-multiplicity=1}
              aggregation tailoring requirement: in-scope=false, multiplicity-restriction={severity=ERROR, lower-multiplicity=0, upper-multiplicity-infinite=true}
        ResourceConsumption
          class content conditional Invariant
            attribute-tailorings:
              4 x aggregation tailoring, all with in-scope=false, multiplicity-restriction={severity=ERROR, lower-multiplicity=0, upper-multiplicity-infinite=true}, variation-restriction={severity=ERROR, variation=true, valid-binding-times=[BLUEPRINT-DERIVATION-TIME, SYSTEM-DESIGN-TIME, CODE-GENERATION-TIME, PRE-COMPILE-TIME, LINK-TIME, POST-BUILD]}:
                executionTime
                heapUsage
                memorySection
                stackUsage
        RoleBasedDataAssignment
          class content conditional Invariant
            attribute-tailorings:
              primitive attribute tailoring role: in-scope=false, multiplicity-restriction={severity=ERROR, lower-multiplicity=0, upper-multiplicity=1}, default-value-handling=NO-DEFAULT
              aggregation tailoring usedDataElement: in-scope=false, multiplicity-restriction={severity=ERROR, lower-multiplicity=0, upper-multiplicity=1}
              aggregation tailoring usedParameterElement: in-scope=false, multiplicity-restriction={severity=ERROR, lower-multiplicity=0, upper-multiplicity=1}
              reference tailoring usedPim: in-scope=false, multiplicity-restriction={severity=ERROR, lower-multiplicity=0, upper-multiplicity=1}, unresolved-reference-restriction=severity=ERROR
        RoleBasedPortAssignment
          class content conditional Invariant
            attribute-tailorings:
              reference tailoring portPrototype: in-scope=false, multiplicity-restriction={severity=ERROR, lower-multiplicity=0, upper-multiplicity=1}, unresolved-reference-restriction=severity=ERROR
              primitive attribute tailoring role: in-scope=false, multiplicity-restriction={severity=ERROR, lower-multiplicity=0, upper-multiplicity=1}, default-value-handling=NO-DEFAULT
        RootSwCompositionPrototype
          class content conditional Invariant
            attribute-tailorings:
              reference tailoring calibrationParameterValueSet: in-scope=false, multiplicity-restriction={severity=ERROR, lower-multiplicity=0, upper-multiplicity-infinite=true}, unresolved-reference-restriction=severity=ERROR
              reference tailoring flatMap: in-scope=false, multiplicity-restriction={severity=ERROR, lower-multiplicity=0, upper-multiplicity=1}, unresolved-reference-restriction=severity=ERROR
              reference tailoring softwareComposition: in-scope=false, multiplicity-restriction={severity=ERROR, lower-multiplicity=0, upper-multiplicity=1}, unresolved-reference-restriction=severity=ERROR
        RoughEstimateHeapUsage
          class content conditional Invariant
            primitive attribute tailoring memoryConsumption: in-scope=false, multiplicity-restriction={severity=ERROR, lower-multiplicity=0, upper-multiplicity=1}, default-value-handling=NO-DEFAULT
        RoughEstimateOfExecutionTime
          class content conditional Invariant
            attribute-tailorings:
              primitive attribute tailoring additionalInformation: in-scope=false, multiplicity-restriction={severity=ERROR, lower-multiplicity=0, upper-multiplicity=1}, default-value-handling=NO-DEFAULT
              aggregation tailoring estimatedExecutionTime: in-scope=false, multiplicity-restriction={severity=ERROR, lower-multiplicity=0, upper-multiplicity=1}
        RoughEstimateStackUsage
          class content conditional Invariant
            primitive attribute tailoring memoryConsumption: in-scope=false, multiplicity-restriction={severity=ERROR, lower-multiplicity=0, upper-multiplicity=1}, default-value-handling=NO-DEFAULT
        Row
          class content conditional Invariant
            attribute-tailorings:
              aggregation tailoring entry: in-scope=false, multiplicity-restriction={severity=ERROR, lower-multiplicity=0, upper-multiplicity-infinite=true}
              primitive attribute tailoring rowsep: in-scope=false, multiplicity-restriction={severity=ERROR, lower-multiplicity=0, upper-multiplicity=1}, default-value-handling=NO-DEFAULT
              primitive attribute tailoring valign: in-scope=false, multiplicity-restriction={severity=ERROR, lower-multiplicity=0, upper-multiplicity=1}, default-value-handling=NO-DEFAULT
        RunnableEntity
          class content conditional Invariant
            attribute-tailorings:
              aggregation tailoring asynchronousServerCallResultPoint: in-scope=false, multiplicity-restriction={severity=ERROR, lower-multiplicity=0, upper-multiplicity-infinite=true}, variation-restriction={severity=ERROR, variation=true, valid-binding-times=[BLUEPRINT-DERIVATION-TIME, SYSTEM-DESIGN-TIME, CODE-GENERATION-TIME, PRE-COMPILE-TIME, LINK-TIME, POST-BUILD]}
              primitive attribute tailoring canBeInvokedConcurrently: in-scope=false, multiplicity-restriction={severity=ERROR, lower-multiplicity=0, upper-multiplicity=1}, default-value-handling=NO-DEFAULT
              12 x aggregation tailoring, all with in-scope=false, multiplicity-restriction={severity=ERROR, lower-multiplicity=0, upper-multiplicity-infinite=true}, variation-restriction={severity=ERROR, variation=true, valid-binding-times=[BLUEPRINT-DERIVATION-TIME, SYSTEM-DESIGN-TIME, CODE-GENERATION-TIME, PRE-COMPILE-TIME, LINK-TIME, POST-BUILD]}:
                dataReadAccess
                dataReceivePointByArgument
                dataReceivePointByValue
                dataSendPoint
                dataWriteAccess
                externalTriggeringPoint
                internalTriggeringPoint
                modeAccessPoint
                modeSwitchPoint
                parameterAccess
                readLocalVariable
                serverCallPoint
              primitive attribute tailoring symbol: in-scope=false, multiplicity-restriction={severity=ERROR, lower-multiplicity=0, upper-multiplicity=1}, default-value-handling=NO-DEFAULT
              aggregation tailoring waitPoint: in-scope=false, multiplicity-restriction={severity=ERROR, lower-multiplicity=0, upper-multiplicity-infinite=true}
              aggregation tailoring writtenLocalVariable: in-scope=false, multiplicity-restriction={severity=ERROR, lower-multiplicity=0, upper-multiplicity-infinite=true}, variation-restriction={severity=ERROR, variation=true, valid-binding-times=[BLUEPRINT-DERIVATION-TIME, SYSTEM-DESIGN-TIME, CODE-GENERATION-TIME, PRE-COMPILE-TIME, LINK-TIME, POST-BUILD]}
        Sample
          class content conditional Invariant
            attribute-tailorings:
              aggregation tailoring ncoi1: in-scope=false, multiplicity-restriction={severity=ERROR, lower-multiplicity=0, upper-multiplicity=1}
        SampleSpec
          class content conditional Invariant
            attribute-tailorings:
              aggregation tailoring introduction: in-scope=false, multiplicity-restriction={severity=ERROR, lower-multiplicity=0, upper-multiplicity=1}
              aggregation tailoring sample: in-scope=false, multiplicity-restriction={severity=ERROR, lower-multiplicity=0, upper-multiplicity-infinite=true}
        SaveConfigurationEntry
          class content conditional Invariant
        ScaleConstr
          class content conditional Invariant
            attribute-tailorings:
              aggregation tailoring desc: in-scope=false, multiplicity-restriction={severity=ERROR, lower-multiplicity=0, upper-multiplicity=1}
              aggregation tailoring lowerLimit: in-scope=false, multiplicity-restriction={severity=ERROR, lower-multiplicity=0, upper-multiplicity=1}
              primitive attribute tailoring shortLabel: in-scope=false, multiplicity-restriction={severity=ERROR, lower-multiplicity=0, upper-multiplicity=1}, default-value-handling=NO-DEFAULT
              aggregation tailoring upperLimit: in-scope=false, multiplicity-restriction={severity=ERROR, lower-multiplicity=0, upper-multiplicity=1}
              primitive attribute tailoring validity: in-scope=false, multiplicity-restriction={severity=ERROR, lower-multiplicity=0, upper-multiplicity=1}, default-value-handling=NO-DEFAULT
        ScaleConstrs
          class content conditional Invariant
            attribute-tailorings:
              aggregation tailoring scaleConstr: in-scope=false, multiplicity-restriction={severity=ERROR, lower-multiplicity=0, upper-multiplicity-infinite=true}
      abstract class tailoring ScheduleTableEntry: multiplicity-restriction={severity=INFO, lower-multiplicity=0, upper-multiplicity-infinite=true}
        class content conditional Invariant
          attribute-tailorings:
            primitive attribute tailoring delay: in-scope=false, multiplicity-restriction={severity=ERROR, lower-multiplicity=0, upper-multiplicity=1}, default-value-handling=NO-DEFAULT
            aggregation tailoring introduction: in-scope=false, multiplicity-restriction={severity=ERROR, lower-multiplicity=0, upper-multiplicity=1}
            primitive attribute tailoring positionInTable: in-scope=false, multiplicity-restriction={severity=ERROR, lower-multiplicity=0, upper-multiplicity=1}, default-value-handling=NO-DEFAULT
      7 x concrete class tailoring, all with in-scope=false, multiplicity-restriction={severity=INFO, lower-multiplicity=0, upper-multiplicity-infinite=true}, validation-root=false:
        Sd
          class content conditional Invariant
            primitive attribute tailoring gid: in-scope=false, multiplicity-restriction={severity=ERROR, lower-multiplicity=0, upper-multiplicity=1}, default-value-handling=NO-DEFAULT
            primitive attribute tailoring value: in-scope=false, multiplicity-restriction={severity=ERROR, lower-multiplicity=0, upper-multiplicity=1}, default-value-handling=NO-DEFAULT
        Sdg
          class content conditional Invariant
            attribute-tailorings:
              primitive attribute tailoring gid: in-scope=false, multiplicity-restriction={severity=ERROR, lower-multiplicity=0, upper-multiplicity=1}, default-value-handling=NO-DEFAULT
              aggregation tailoring sdgCaption: in-scope=false, multiplicity-restriction={severity=ERROR, lower-multiplicity=0, upper-multiplicity=1}
              reference tailoring sdgCaptionRef: in-scope=false, multiplicity-restriction={severity=ERROR, lower-multiplicity=0, upper-multiplicity=1}, unresolved-reference-restriction=severity=ERROR
              aggregation tailoring sdgContentsType: in-scope=false, multiplicity-restriction={severity=ERROR, lower-multiplicity=0, upper-multiplicity=1}
        SdgCaption
          class content conditional Invariant
            attribute-tailorings:
              aggregation tailoring desc: in-scope=false, multiplicity-restriction={severity=ERROR, lower-multiplicity=0, upper-multiplicity=1}
        SdgContents
          class content conditional Invariant
            attribute-tailorings:
              aggregation tailoring sd: in-scope=false, multiplicity-restriction={severity=ERROR, lower-multiplicity=0, upper-multiplicity-infinite=true}  # Multiplicity is 0..* since attribute is contained in mixed / mixedString class.
              aggregation tailoring sdg: in-scope=false, multiplicity-restriction={severity=ERROR, lower-multiplicity=0, upper-multiplicity-infinite=true}  # Multiplicity is 0..* since attribute is contained in mixed / mixedString class.
              reference tailoring sdx: in-scope=false, multiplicity-restriction={severity=ERROR, lower-multiplicity=0, upper-multiplicity-infinite=true}, unresolved-reference-restriction=severity=ERROR  # Multiplicity is 0..* since attribute is contained in mixed / mixedString class.
        Sdx
          class content conditional Invariant
            primitive attribute tailoring gid: in-scope=false, multiplicity-restriction={severity=ERROR, lower-multiplicity=0, upper-multiplicity-infinite=true}, default-value-handling=NO-DEFAULT  # Multiplicity is 0..* since attribute is contained in mixed / mixedString class.
            primitive attribute tailoring idClass: in-scope=false, multiplicity-restriction={severity=ERROR, lower-multiplicity=0, upper-multiplicity-infinite=true}, default-value-handling=NO-DEFAULT  # Multiplicity is 0..* since attribute is contained in mixed / mixedString class.
        SegmentPosition
          class content conditional Invariant
            primitive attribute tailoring segmentByteOrder: in-scope=false, multiplicity-restriction={severity=ERROR, lower-multiplicity=0, upper-multiplicity=1}, default-value-handling=NO-DEFAULT
            primitive attribute tailoring segmentLength: in-scope=false, multiplicity-restriction={severity=ERROR, lower-multiplicity=0, upper-multiplicity=1}, default-value-handling=NO-DEFAULT
            primitive attribute tailoring segmentPosition: in-scope=false, multiplicity-restriction={severity=ERROR, lower-multiplicity=0, upper-multiplicity=1}, default-value-handling=NO-DEFAULT
        SenderAnnotation
          class content conditional Invariant
      abstract class tailoring SenderComSpec: multiplicity-restriction={severity=INFO, lower-multiplicity=0, upper-multiplicity-infinite=true}
        class content conditional Invariant
          attribute-tailorings:
            reference tailoring dataElement: in-scope=false, multiplicity-restriction={severity=ERROR, lower-multiplicity=0, upper-multiplicity=1}, unresolved-reference-restriction=severity=ERROR
            primitive attribute tailoring handleOutOfRange: in-scope=false, multiplicity-restriction={severity=ERROR, lower-multiplicity=0, upper-multiplicity=1}, default-value-handling=NO-DEFAULT
            aggregation tailoring networkRepresentation: in-scope=false, multiplicity-restriction={severity=ERROR, lower-multiplicity=0, upper-multiplicity=1}
            aggregation tailoring transmissionAcknowledge: in-scope=false, multiplicity-restriction={severity=ERROR, lower-multiplicity=0, upper-multiplicity=1}
            primitive attribute tailoring usesEndToEndProtection: in-scope=false, multiplicity-restriction={severity=ERROR, lower-multiplicity=0, upper-multiplicity=1}, variation-restriction={severity=ERROR, variation=true, valid-binding-times=[BLUEPRINT-DERIVATION-TIME, SYSTEM-DESIGN-TIME, CODE-GENERATION-TIME, PRE-COMPILE-TIME, LINK-TIME, POST-BUILD]}, default-value-handling=NO-DEFAULT
      concrete class tailoring SenderRecArrayElementMapping: in-scope=false, multiplicity-restriction={severity=INFO, lower-multiplicity=0, upper-multiplicity-infinite=true}, validation-root=false
        class content conditional Invariant
          attribute-tailorings:
            aggregation tailoring complexTypeMapping: in-scope=false, multiplicity-restriction={severity=ERROR, lower-multiplicity=0, upper-multiplicity=1}
            aggregation tailoring indexedArrayElement: in-scope=false, multiplicity-restriction={severity=ERROR, lower-multiplicity=0, upper-multiplicity=1}
            reference tailoring systemSignal: in-scope=false, multiplicity-restriction={severity=ERROR, lower-multiplicity=0, upper-multiplicity=1}, unresolved-reference-restriction=severity=ERROR
      concrete class tailoring SenderRecArrayTypeMapping: in-scope=false, multiplicity-restriction={severity=INFO, lower-multiplicity=0, upper-multiplicity-infinite=true}, validation-root=false
        class content conditional Invariant
          attribute-tailorings:
            aggregation tailoring arrayElementMapping: in-scope=false, multiplicity-restriction={severity=ERROR, lower-multiplicity=0, upper-multiplicity-infinite=true}
      abstract class tailoring SenderRecCompositeTypeMapping: multiplicity-restriction={severity=INFO, lower-multiplicity=0, upper-multiplicity-infinite=true}
        class content conditional Invariant
      concrete class tailoring SenderRecRecordElementMapping: in-scope=false, multiplicity-restriction={severity=INFO, lower-multiplicity=0, upper-multiplicity-infinite=true}, validation-root=false
        class content conditional Invariant
          attribute-tailorings:
            reference tailoring applicationRecordElement: in-scope=false, multiplicity-restriction={severity=ERROR, lower-multiplicity=0, upper-multiplicity=1}, unresolved-reference-restriction=severity=ERROR
            aggregation tailoring complexTypeMapping: in-scope=false, multiplicity-restriction={severity=ERROR, lower-multiplicity=0, upper-multiplicity=1}
            reference tailoring implementationRecordElement: in-scope=false, multiplicity-restriction={severity=ERROR, lower-multiplicity=0, upper-multiplicity=1}, unresolved-reference-restriction=severity=ERROR
            reference tailoring systemSignal: in-scope=false, multiplicity-restriction={severity=ERROR, lower-multiplicity=0, upper-multiplicity=1}, unresolved-reference-restriction=severity=ERROR
      concrete class tailoring SenderRecRecordTypeMapping: in-scope=false, multiplicity-restriction={severity=INFO, lower-multiplicity=0, upper-multiplicity-infinite=true}, validation-root=false
        class content conditional Invariant
          attribute-tailorings:
            aggregation tailoring recordElementMapping: in-scope=false, multiplicity-restriction={severity=ERROR, lower-multiplicity=0, upper-multiplicity-infinite=true}
      abstract class tailoring SenderReceiverAnnotation: multiplicity-restriction={severity=INFO, lower-multiplicity=0, upper-multiplicity-infinite=true}
        class content conditional Invariant
          attribute-tailorings:
            primitive attribute tailoring computed: in-scope=false, multiplicity-restriction={severity=ERROR, lower-multiplicity=0, upper-multiplicity=1}, default-value-handling=NO-DEFAULT
            reference tailoring dataElement: in-scope=false, multiplicity-restriction={severity=ERROR, lower-multiplicity=0, upper-multiplicity=1}, unresolved-reference-restriction=severity=ERROR
            primitive attribute tailoring limitKind: in-scope=false, multiplicity-restriction={severity=ERROR, lower-multiplicity=0, upper-multiplicity=1}, default-value-handling=NO-DEFAULT
            primitive attribute tailoring processingKind: in-scope=false, multiplicity-restriction={severity=ERROR, lower-multiplicity=0, upper-multiplicity=1}, default-value-handling=NO-DEFAULT
      6 x concrete class tailoring, all with in-scope=false, multiplicity-restriction={severity=INFO, lower-multiplicity=0, upper-multiplicity-infinite=true}, validation-root=false:
        SenderReceiverInterface
          class content conditional Invariant
            attribute-tailorings:
              aggregation tailoring dataElement: in-scope=false, multiplicity-restriction={severity=ERROR, lower-multiplicity=0, upper-multiplicity-infinite=true}
              aggregation tailoring invalidationPolicy: in-scope=false, multiplicity-restriction={severity=ERROR, lower-multiplicity=0, upper-multiplicity-infinite=true}
        SenderReceiverToSignalGroupMapping
          class content conditional Invariant
            attribute-tailorings:
              aggregation tailoring dataElement: in-scope=false, multiplicity-restriction={severity=ERROR, lower-multiplicity=0, upper-multiplicity=1}
              reference tailoring signalGroup: in-scope=false, multiplicity-restriction={severity=ERROR, lower-multiplicity=0, upper-multiplicity=1}, unresolved-reference-restriction=severity=ERROR
              aggregation tailoring typeMapping: in-scope=false, multiplicity-restriction={severity=ERROR, lower-multiplicity=0, upper-multiplicity=1}
        SenderReceiverToSignalMapping
          class content conditional Invariant
            attribute-tailorings:
              aggregation tailoring dataElement: in-scope=false, multiplicity-restriction={severity=ERROR, lower-multiplicity=0, upper-multiplicity=1}
              reference tailoring systemSignal: in-scope=false, multiplicity-restriction={severity=ERROR, lower-multiplicity=0, upper-multiplicity=1}, unresolved-reference-restriction=severity=ERROR
        SensorActuatorSwComponentType
          class content conditional Invariant
            attribute-tailorings:
              reference tailoring sensorActuator: in-scope=false, multiplicity-restriction={severity=ERROR, lower-multiplicity=0, upper-multiplicity=1}, unresolved-reference-restriction=severity=ERROR
        SeparateSignalPath
          class content conditional Invariant
            attribute-tailorings:
              aggregation tailoring operation: in-scope=false, multiplicity-restriction={severity=ERROR, lower-multiplicity=0, upper-multiplicity-infinite=true}
              aggregation tailoring signal: in-scope=false, multiplicity-restriction={severity=ERROR, lower-multiplicity=0, upper-multiplicity-infinite=true}
        SequenceCounterMapping
          class content conditional Invariant
            attribute-tailorings:
              reference tailoring systemSignal: in-scope=false, multiplicity-restriction={severity=ERROR, lower-multiplicity=0, upper-multiplicity=1}, unresolved-reference-restriction=severity=ERROR
      abstract class tailoring ServerCallPoint: multiplicity-restriction={severity=INFO, lower-multiplicity=0, upper-multiplicity-infinite=true}
        class content conditional Invariant
          attribute-tailorings:
            aggregation tailoring operation: in-scope=false, multiplicity-restriction={severity=ERROR, lower-multiplicity=0, upper-multiplicity=1}
            primitive attribute tailoring timeout: in-scope=false, multiplicity-restriction={severity=ERROR, lower-multiplicity=0, upper-multiplicity=1}, default-value-handling=NO-DEFAULT
      concrete class tailoring ServerComSpec: in-scope=false, multiplicity-restriction={severity=INFO, lower-multiplicity=0, upper-multiplicity-infinite=true}, validation-root=false
        class content conditional Invariant
          attribute-tailorings:
            reference tailoring operation: in-scope=false, multiplicity-restriction={severity=ERROR, lower-multiplicity=0, upper-multiplicity=1}, unresolved-reference-restriction=severity=ERROR
            primitive attribute tailoring queueLength: in-scope=false, multiplicity-restriction={severity=ERROR, lower-multiplicity=0, upper-multiplicity=1}, default-value-handling=NO-DEFAULT
      abstract class tailoring ServiceNeeds: multiplicity-restriction={severity=INFO, lower-multiplicity=0, upper-multiplicity-infinite=true}
        class content conditional Invariant
      4 x concrete class tailoring, all with in-scope=false, multiplicity-restriction={severity=INFO, lower-multiplicity=0, upper-multiplicity-infinite=true}, validation-root=false:
        ServiceProxySwComponentType
          class content conditional Invariant
        ServiceSwComponentType
          class content conditional Invariant
        SignalIPduCounter
          class content conditional Invariant
            primitive attribute tailoring pduCounterSize: in-scope=false, multiplicity-restriction={severity=ERROR, lower-multiplicity=0, upper-multiplicity=1}, default-value-handling=NO-DEFAULT
            primitive attribute tailoring pduCounterStartPosition: in-scope=false, multiplicity-restriction={severity=ERROR, lower-multiplicity=0, upper-multiplicity=1}, default-value-handling=NO-DEFAULT
            primitive attribute tailoring pduCounterThreshold: in-scope=false, multiplicity-restriction={severity=ERROR, lower-multiplicity=0, upper-multiplicity=1}, default-value-handling=NO-DEFAULT
        SignalIPduReplication
          class content conditional Invariant
            attribute-tailorings:
              primitive attribute tailoring pduReplicationVoting: in-scope=false, multiplicity-restriction={severity=ERROR, lower-multiplicity=0, upper-multiplicity=1}, default-value-handling=NO-DEFAULT
              reference tailoring replicaPdus: in-scope=false, multiplicity-restriction={severity=ERROR, lower-multiplicity=0, upper-multiplicity=2}, unresolved-reference-restriction=severity=ERROR
      abstract class tailoring SignalPathConstraint: multiplicity-restriction={severity=INFO, lower-multiplicity=0, upper-multiplicity-infinite=true}
        class content conditional Invariant
          attribute-tailorings:
            aggregation tailoring introduction: in-scope=false, multiplicity-restriction={severity=ERROR, lower-multiplicity=0, upper-multiplicity=1}
      4 x concrete class tailoring, all with in-scope=false, multiplicity-restriction={severity=INFO, lower-multiplicity=0, upper-multiplicity-infinite=true}, validation-root=false:
        SimulatedExecutionTime
          class content conditional Invariant
            attribute-tailorings:
              aggregation tailoring maximumExecutionTime: in-scope=false, multiplicity-restriction={severity=ERROR, lower-multiplicity=0, upper-multiplicity=1}
              aggregation tailoring minimumExecutionTime: in-scope=false, multiplicity-restriction={severity=ERROR, lower-multiplicity=0, upper-multiplicity=1}
              aggregation tailoring nominalExecutionTime: in-scope=false, multiplicity-restriction={severity=ERROR, lower-multiplicity=0, upper-multiplicity=1}
        SingleLanguageLongName
          class content conditional Invariant
        SingleLanguageOverviewParagraph
          class content conditional Invariant
        SingleLanguageParagraph
          class content conditional Invariant
      abstract class tailoring SingleLanguageReferrable: multiplicity-restriction={severity=INFO, lower-multiplicity=0, upper-multiplicity-infinite=true}
        class content conditional Invariant
          attribute-tailorings:
            aggregation tailoring longName1: in-scope=false, multiplicity-restriction={severity=ERROR, lower-multiplicity=0, upper-multiplicity=1}
