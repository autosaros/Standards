AUTOSAR XML (schema 00046)
package /AUTOSAR/DataExchangePoints
  data exchange point SafetyExtension: kind=CONSUMER, referenced-baseline={standard-revisions=CP R4.2.2, custom-sdg-def=SafetyExtensionSdgDef}  # AUTOSAR Safety Extension
    data-format-tailoring:
      concrete class tailoring StructuredReq: in-scope=true
        class content conditional SafetyRequirement: condition=primitive-attribute-condition={pattern=SAFETY_GOAL|SAFETY_FUNCTIONAL|SAFETY_TECHNICAL|SAFETY_SOFTWARE|SAFETY_HARDWARE|SAFETY_EXTERNAL, attribute=category}
          primitive attribute tailoring category: in-scope=true
          primitive attribute tailoring description: in-scope=true, multiplicity-restriction={severity=ERROR, lower-multiplicity=1}  # TPS_SAFEX_00101: Description of safety requirements.
          primitive attribute tailoring uuid: in-scope=false
          sdg tailoring SAFEX: in-scope=true, severity=ERROR, sdg-class=SafetyRequirement  # The Sdg that is represented by SdgClass SafetyExtension/SAFEX/Safex SHALL exist if the category starts with "SAFETY_.*"
      concrete class tailoring XFile: in-scope=true  # [TPS_SAFEX_00105] External Safety Requirements
        class content conditional ExternalSafetyRequirement: condition=primitive-attribute-condition={pattern=SAFETY_EXTERNAL, attribute=category}
          4 x primitive attribute tailoring, all with in-scope=true:
            category
            tool
            toolVersion
            url: multiplicity-restriction={severity=ERROR, lower-multiplicity=1}
  sdg def SafetyExtensionSdgDef  # Sdgs used for safety extensions
    sdg-classes:
      sdg class SafetyRequirement: gid=SAFEX, extends-meta-class=StructuredReq  # [TPS_SAFEX_00104] Status attribute
        sdg primitive attribute asil: gid=ASIL, pattern=QM|A|B|C|D|QM(A)|QM(B)|QM(C)|QM(D)|A(B)|A\(C\)|A(D)|B(B)|B(C)|B(D)|C(C)|C(D)|D(D)  # [TPS_SAFEX_00201] ASIL attribute of safety requirements
        sdg primitive attribute status: gid=STATUS  # [TPS_SAFEX_00104] Status attribute
