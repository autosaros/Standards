AUTOSAR XML (schema 00046)
package /AUTOSAR/DataExchangePoints
  documentation CustomConstraints
    documentation-content:
      trace CustomConstraint1: category=CONSTAINT_ITEM, p=l-1=Each Pdu that is transmitted or received by the EcuInstance shall be assigned to an IPduGroup referenced either direcly by the EcuInstance via associatedPdurIPduGroup or indirectly via any subgroup that is reachable by recursively by following the ISignalIPduGroup.containedIPduGroup reference.
  data exchange point ECU_System_Description: kind=CONSUMER, referenced-baseline=standard-revisions=CP R4.2.2  # ECU System Description for Configuration of ComStack for Unsegmented Unmultiplexed Signal-Based Communication on CAN | This profile describes the data that is exchanged in the deliverable “ECU System Description” and focuses on data that is required for configuring the behavior of the ECU on the CAN network with respect to unsegmented signal-based communication. The profile shows the supported input of FancyCanStackConfigurator version 1.2.2 | Consumer, Tool: FancyCanStackConfigurator version 1.2.2, invoked using 'fancy -buildCar'
    specification-scope:
      8 x specification document scope, all with in-scope=true:
        Methodology
          15 x document element scope:
            ECU_System_Description: alternative-name=ECU System Description, in-scope=true
            Configure_Com: alternative-name=Configure Com, in-scope=true  # "Configure Com" refers to the configuration of the full com stack.
            Configure_Debug: alternative-name=Configure Debug, in-scope=false
            Configure_Diagnostics: alternative-name=Configure Diagnostics, in-scope=false
            Configure_IO_Hardware_Abstraction: alternative-name=Configure IO Hardware Abstraction, in-scope=false
            Configure_MCAL: alternative-name=Configure MCAL, in-scope=true
            Configure_Memmap_Allocation: alternative-name=Configure Memmap Allocation, in-scope=false
            Configure_Mode_Management: alternative-name=Configure Mode Management, in-scope=false
            Configure_NvM: alternative-name=Configure NvM, in-scope=false
            Configure_OS: alternative-name=Configure OS, in-scope=false
            Configure_RTE: alternative-name=Configure RTE, in-scope=false
            Configure_Transformer: alternative-name=Configure Transformer, in-scope=false
            Configure_Watchdog_Manager: alternative-name=Configure Watchdog Manager, in-scope=false
            Connect_Service_Component: alternative-name=Connect Service Component, in-scope=false
            Create_Service_Component: alternative-name=Create Service Component, in-scope=false
        Specification_of_Basic_Software_Mode_Manager: alternative-name=Specification of Basic Software Mode Manager  # BswM is required if ModeDrivenTransmissionModeCondition or TriggerIPduSendCondition evaluation are used
        Specification_of_CAN_Driver: alternative-name=Specification of CAN Driver
        Specification_of_CAN_Interface: alternative-name=Specification of CAN Interface
        Specification_of_CAN_State_Manager: alternative-name=Specification of CAN State Manager
        Specification_of_CAN_Transceiver_Driver: alternative-name=Specification of CAN Transceiver Driver
        Specification_of_Communication: alternative-name=Specification of Communication
        Specification_of_PDU_Router: alternative-name=Specification of PDU Router
    data-format-tailoring:
      concrete class tailoring ARPackage: in-scope=true
        class content conditional Invariant
          attribute-tailorings:
            4 x aggregation tailoring, all with in-scope=true:
              arPackage: variation-restriction={severity=ERROR, variation=false}
              blueprintPolicy: multiplicity-restriction={severity=ERROR, upper-multiplicity=0}
              element
              referenceBase
            primitive attribute tailoring shortName: in-scope=false, multiplicity-restriction={severity=ERROR, lower-multiplicity=1, upper-multiplicity=1}, default-value-handling=NO-DEFAULT
      concrete class tailoring AUTOSAR: in-scope=true
        class content conditional Invariant
          attribute-tailorings:
            aggregation tailoring arPackage: in-scope=false, multiplicity-restriction={severity=ERROR, lower-multiplicity=1}, variation-restriction={severity=ERROR, variation=false}
      abstract class tailoring AbstractCanCommunicationControllerAttributes
        class content conditional Invariant
          attribute-tailorings:
            aggregation tailoring canControllerFdAttributes: in-scope=false, multiplicity-restriction={severity=ERROR, lower-multiplicity=0, upper-multiplicity=1}
            aggregation tailoring canControllerFdRequirements: in-scope=false, multiplicity-restriction={severity=ERROR, lower-multiplicity=0, upper-multiplicity=1}
      9 x concrete class tailoring, all with in-scope=true:
        CanControllerConfiguration
          class content conditional Invariant
            4 x primitive attribute tailoring, all with in-scope=true, multiplicity-restriction={severity=ERROR, lower-multiplicity=1}:
              propSeg
              syncJumpWidth
              timeSeg1
              timeSeg2
        CanControllerConfigurationRequirements
          class content conditional Invariant
            6 x primitive attribute tailoring, all with in-scope=true, multiplicity-restriction={severity=ERROR, lower-multiplicity=1}:
              maxNumberOfTimeQuantaPerBit
              maxSamplePoint
              maxSyncJumpWidth
              minNumberOfTimeQuantaPerBit
              minSamplePoint
              minSyncJumpWidth
        FlexrayCluster: multiplicity-restriction={severity=ERROR, upper-multiplicity=0}  # The reachable part of the model SHALL NOT contain any FlexayClusters
        IPduTiming
          class content conditional Invariant
            constraint tailoring constr_3045: in-scope=true, severity=ERROR
            constraint tailoring constr_3046: in-scope=true, severity=ERROR
        FramePort: multiplicity-restriction={severity=ERROR, lower-multiplicity=1}
          class content conditional Invariant
            primitive attribute tailoring communicationDirection: in-scope=true, multiplicity-restriction={severity=ERROR, lower-multiplicity=1, upper-multiplicity=1}, default-value-handling=NO-DEFAULT
        IPduPort: multiplicity-restriction={severity=ERROR, lower-multiplicity=1, upper-multiplicity-infinite=true}
          class content conditional Invariant
            primitive attribute tailoring communicationDirection: in-scope=true, multiplicity-restriction={severity=ERROR, lower-multiplicity=0, upper-multiplicity=1}, default-value-handling=NO-DEFAULT
            primitive attribute tailoring iPduSignalProcessing: in-scope=true, multiplicity-restriction={severity=ERROR, lower-multiplicity=0, upper-multiplicity=1}, default-value-handling=NO-DEFAULT
        PduTriggering
          class content conditional Invariant
            constraint tailoring constr_3211: in-scope=true, severity=ERROR
        ISignalPort  # existence in the model is conditional
          class content conditional Invariant
            primitive attribute tailoring timeout: in-scope=true
            constraint tailoring constr_3094: in-scope=true, severity=ERROR
        ISignalToIPduMapping
          class content conditional Invariant
            constraint tailoring constr_3024: in-scope=true, severity=ERROR
            constraint tailoring constr_3514: in-scope=true, severity=ERROR
      abstract class tailoring Referrable
        class content conditional Invariant
          primitive attribute tailoring shortName: in-scope=true, multiplicity-restriction={severity=ERROR, lower-multiplicity=1}, value-restriction=max-length=63  # max shortname length is set to 63 in order to allow interoperability with some restricted tools
      concrete class tailoring System: in-scope=true, multiplicity-restriction={severity=ERROR, lower-multiplicity=1, upper-multiplicity=1}, validation-root=true  # The model must contain exactly one instance.
        class content conditional Invariant  # The category shall be set to ECU_SYSTEM_DESCRIPTION
          attribute-tailorings:
            primitive attribute tailoring category: in-scope=true, multiplicity-restriction={severity=ERROR, lower-multiplicity=1}, value-restriction={severity=ERROR, pattern=ECU_SYSTEM_DESCRIPTION}
            reference tailoring fibexElement: in-scope=true, multiplicity-restriction={severity=ERROR, lower-multiplicity=1}, unresolved-reference-restriction=severity=ERROR  # This reference is a collection of all elements that belong to the System.
              type-tailorings:
                6 x concrete class tailoring, all with in-scope=true:
                  CanCluster: multiplicity-restriction={severity=ERROR, lower-multiplicity=1}  # at least one CanCluster is required
                    class content conditional Invariant
                      attribute-tailorings:
                        primitive attribute tailoring baudrate: in-scope=true, multiplicity-restriction={severity=ERROR, lower-multiplicity=1}
                        aggregation tailoring busOffRecovery: in-scope=false, multiplicity-restriction={severity=ERROR, lower-multiplicity=0, upper-multiplicity=1}
                        aggregation tailoring physicalChannel: in-scope=false, multiplicity-restriction={severity=ERROR, lower-multiplicity=1, upper-multiplicity=1}  # constr_3003: exactly one CanPhysicalChannel per CanCluster
                          type-tailorings:
                            concrete class tailoring CanPhysicalChannel: in-scope=true, multiplicity-restriction={severity=ERROR, lower-multiplicity=1, upper-multiplicity=1}
                              class content conditional Invariant
                                attribute-tailorings:
                                  reference tailoring commConnector: in-scope=false, multiplicity-restriction={severity=ERROR, lower-multiplicity=0, upper-multiplicity-infinite=true}, unresolved-reference-restriction=severity=ERROR
                                  aggregation tailoring frameTriggering: in-scope=true, multiplicity-restriction={severity=ERROR, lower-multiplicity=0}
                                  aggregation tailoring iSignalTriggering: in-scope=true, multiplicity-restriction={severity=ERROR, lower-multiplicity=1}
                                  aggregation tailoring pduTriggering: in-scope=true, multiplicity-restriction={severity=ERROR, lower-multiplicity=1}
                        primitive attribute tailoring protocolName: in-scope=false  # Protocol Name is ignored. There are no different protocols executed on a CAN cluster, as of now CAN 2.0 is used. CAN-FD communication can be integrated into CAN 2.0 networks. The object type "CanCluster" sufficiently specifies the protocol. Moreover, the field is a freely configurable since its description says "The name of the protocol used.", you could possibly fill in "Fred".
                      constraint tailoring constr_3003: in-scope=true, severity=ERROR
                  CanFrame: multiplicity-restriction={severity=ERROR, lower-multiplicity=1, upper-multiplicity-infinite=true}
                    class content conditional Invariant
                      5 x constraint tailoring, all with in-scope=true, severity=ERROR:
                        constr_{3012..3014}
                        constr_3036
                        constr_3037
                  ECUInstance: multiplicity-restriction={severity=ERROR, lower-multiplicity=1, upper-multiplicity=1}  # exactly one ECU instance is required since it is a profile od an ECU System Description.
                    class content conditional Invariant
                      attribute-tailorings:
                        reference tailoring associatedComIPduGroup: in-scope=true, multiplicity-restriction={severity=ERROR, lower-multiplicity=1}
                        reference tailoring associatedPdurIPduGroup: in-scope=false, multiplicity-restriction={severity=ERROR, lower-multiplicity=0, upper-multiplicity-infinite=true}, unresolved-reference-restriction=severity=ERROR
                        primitive attribute tailoring comEnableMDTForCyclicTransmission: in-scope=true
                        aggregation tailoring commController: in-scope=true, multiplicity-restriction={severity=ERROR, lower-multiplicity=1, upper-multiplicity=1}
                          type-tailorings:
                            concrete class tailoring CanCommunicationController: in-scope=true, multiplicity-restriction={severity=ERROR, lower-multiplicity=1}
                              class content conditional Invariant
                                attribute-tailorings:
                                  aggregation tailoring canControllerAttributes: in-scope=true, multiplicity-restriction={severity=ERROR, lower-multiplicity=1, upper-multiplicity=1}
                        aggregation tailoring connector: in-scope=true
                          type-tailorings:
                            concrete class tailoring CanCommunicationConnector: in-scope=true, multiplicity-restriction={severity=ERROR, lower-multiplicity=1}
                              class content conditional Invariant
                      constraint tailoring constr_3008: in-scope=true, severity=ERROR
                      constraint tailoring CustomConstraint1: in-scope=true, severity=ERROR, constraint=CustomConstraint1
                  ISignal: multiplicity-restriction={severity=ERROR, lower-multiplicity=1, upper-multiplicity-infinite=true}
                    class content conditional Invariant
                      attribute-tailorings:
                        primitive attribute tailoring dataTypePolicy: in-scope=true, multiplicity-restriction={severity=ERROR, lower-multiplicity=1}, value-restriction={severity=ERROR, pattern=legacy|override}  # The datatype policy is mandatory and restricted to legacy or override.
                        primitive attribute tailoring length: in-scope=true, multiplicity-restriction={severity=ERROR, lower-multiplicity=1}
                        aggregation tailoring networkRepresentationProps: in-scope=true, multiplicity-restriction={severity=ERROR, lower-multiplicity=1}  # TPS_SYST_02001: Since dataTypePolicy is set to legacy or override networkRepresentationProps are mandatory.
                      constraint tailoring constr_3060: in-scope=true, severity=ERROR
                      constraint tailoring constr_3067: in-scope=true, severity=ERROR
                  ISignalIPdu: multiplicity-restriction={severity=ERROR, lower-multiplicity=1, upper-multiplicity-infinite=true}
                    class content conditional Invariant
                      4 x constraint tailoring, all with in-scope=true, severity=ERROR:
                        constr_{3009..3011}
                        constr_3516
                  ISignalIPduGroup: multiplicity-restriction={severity=ERROR, lower-multiplicity=1, upper-multiplicity-infinite=true}
                    class content conditional Invariant
                      constraint tailoring constr_3020: in-scope=true, severity=ERROR
