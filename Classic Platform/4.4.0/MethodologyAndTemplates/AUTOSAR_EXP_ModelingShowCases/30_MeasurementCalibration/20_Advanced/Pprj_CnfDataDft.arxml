AUTOSAR XML (schema 00046)
package /Tier1/ARPlatform1/ConfigData/SwSystemConstantValueSets
  sw systemconstant value set DefaultSwSystemconstantValueSet: sw-systemconst-value{sw-systemconst=ScNoOfWheels, value=1}
