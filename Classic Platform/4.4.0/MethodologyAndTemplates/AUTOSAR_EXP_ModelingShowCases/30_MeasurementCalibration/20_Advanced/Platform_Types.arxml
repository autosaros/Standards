AUTOSAR XML (schema 00046)
standard types defined: sint64, uint64, boolean, uint8, uint16, uint32, sint8, sint16, sint32, float32, float64, uint8_least, uint16_least, uint32_least, sint8_least, sint16_least, sint32_least
