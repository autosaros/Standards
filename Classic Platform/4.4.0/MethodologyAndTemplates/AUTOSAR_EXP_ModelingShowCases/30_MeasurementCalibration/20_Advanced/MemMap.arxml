AUTOSAR XML (schema 00046)
package /Tier1/ARPlatform1/MemMap/SwAddrMethods
  5 x sw addr method:
    CAL: memory-allocation-keyword-policy=ADDR-METHOD-SHORT-NAME-AND-ALIGNMENT, options=safetyQM, section-type=CALPRM  # Calibratable constants; safety level QM. Constants will be located in different memory sections depending on the alignment of the constant.
    CODE_10MS: memory-allocation-keyword-policy=ADDR-METHOD-SHORT-NAME, options=safetyQM, section-type=CODE  # Code of ECU-functions called every 10 ms; safety level QM.
    CONST_SLOW: memory-allocation-keyword-policy=ADDR-METHOD-SHORT-NAME, options=safetyQM, section-type=CONST  # Non calibratable constants of ECU-functions called seldom; safety level QM.
    DATA: memory-allocation-keyword-policy=ADDR-METHOD-SHORT-NAME-AND-ALIGNMENT, options=safetyQM, section-initialization-policy=INIT, section-type=VAR  # Variables of ECU-functions; safety level QM. Variables will be located in different memory sections depending on the alignment of the variable.
    DATA_NVDAT: memory-allocation-keyword-policy=ADDR-METHOD-SHORT-NAME, options=[nvData, safetyQM], section-initialization-policy=NO-INIT, section-type=VAR  # Variables stored in non-volatile memory; safety level QM.
