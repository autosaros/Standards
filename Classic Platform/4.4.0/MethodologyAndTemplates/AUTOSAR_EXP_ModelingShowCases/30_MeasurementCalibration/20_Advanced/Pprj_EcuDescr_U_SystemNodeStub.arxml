AUTOSAR XML (schema 00046)
package /Tier1/ARPlatform1/System
  system SystemU_EcuDescr: category=ECU_SYSTEM_DESCRIPTION
    root-software-compositions:
      root sw composition prototype SystemU: software-composition=SystemURootComposition_EcuDescr
