AUTOSAR XML (schema 00046)
package /McInt/System
  system EcuExtract: category=ECU_EXTRACT, ecu-extract-version=1.0.0
    system mapping SystemMapping
      sw-mappings:
        swc to ecu mapping SwcToEcuMapping: ecu-instance=EcuInstance
          component:
            RootSwCompositionPrototype.CPT_Controller
            RootSwCompositionPrototype.CPT_Parameters
            RootSwCompositionPrototype.CPT_Plant
            RootSwCompositionPrototype.CPT_Environment
    root-software-compositions:
      root sw composition prototype RootSwCompositionPrototype: flat-map=FlatMap, software-composition=Composition
  ecu instance EcuInstance
