AUTOSAR XML (schema 00046)
package /McInt/SwAddrMethods
  sw addr method VAR: options=safetyQM  # Memory section for variables
  sw addr method CALIB: options=safetyQM  # Memory section for calibration parameters
  sw addr method CODE: options=safetyQM  # Memory section for code
