AUTOSAR XML (schema 00046)
package /McInt/SwComponents
  composition sw component type Composition
    4 x component:
      CPT_Controller: type=Controller
      CPT_Parameters: type=Parameters
      CPT_Plant: type=Plant
      CPT_Environment: type=Environment
    connect CPT_Controller.CurrentPPP -> CPT_Plant.CurrentRPP
    connect CPT_Plant.PlantTemperaturePPP -> CPT_Controller.TemperatureRPP
    connect CPT_Parameters.ControllerPPP -> CPT_Controller.ControllerParamsRPP
    connect CPT_Parameters.PlantPPP -> CPT_Plant.PlantParamsRPP
    connect CPT_Environment.EnvTemperaturePPP -> CPT_Plant.EnvTemperatureRPP
    connect CPT_Parameters.EnvironmentPPP -> CPT_Environment.EnvParamsRPP
    connect CPT_Parameters.DtPPP -> CPT_Environment.DtRPP
    connect CPT_Parameters.DtPPP -> CPT_Plant.DtRPP
    connect CPT_Parameters.DtPPP -> CPT_Controller.DtRPP
