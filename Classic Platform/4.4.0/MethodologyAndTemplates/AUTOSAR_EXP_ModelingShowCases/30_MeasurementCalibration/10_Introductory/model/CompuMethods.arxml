AUTOSAR XML (schema 00046)
package /McInt/CompuMethods
  compu method Temperature_C: phys=raw-273.15; unit DegreeCelsius  # Conversion from [°C] to [K]
  compu method Current_mA: phys=raw*1000; unit MilliAmpere  # Conversion to illustrate proportional scaling between interface and internal computations
  compu method Identical: identical  # Identical conversion (Physical == Internal). Used for most data types here.
