AUTOSAR XML (schema 00046)
package /McInt/ApplicationDataTypes
  9 x app type, all with category=VALUE, sw-calibration-access=READ-ONLY:
    Temperature_C: compu-method=Temperature_C, display-format=%.1f, unit=DegreeCelsius  # Type for a temperature in [°C]
    Current: compu-method=Current_mA, display-format=%.1f, unit=MilliAmpere  # Type for the current in [mA]
    EnvFactor: compu-method=Identical, display-format=%.1f, unit=JoulePerKelvinSecond  # Type for the environt factor in [J/Ks]
    Temperature_K: compu-method=Identical, display-format=%.1f, unit=Kelvin  # Type for a temperature in [K]
    Amplification: compu-method=Identical, display-format=%.1f, unit=MilliAmperePerKelvinSecond  # Type for an amplification factor in a controller in [mA/Ks]
    Energy: compu-method=Identical, display-format=%.1f, unit=Joule  # Type for energy [J]
    ESum: compu-method=Identical, display-format=%.1f, unit=KelvinSecond  # Type for the sum of control errors of an I controller in [Ks]
    HeaterFactor: compu-method=Identical, display-format=%.1f, unit=JoulePerMilliAmpereSecond  # Type of a proportionality factor for the heat flow from an electrical heater to a thermal energy storage in [J/mAs]
    Time: compu-method=Identical, display-format=%.3f, unit=Second  # Type for time in [s]
