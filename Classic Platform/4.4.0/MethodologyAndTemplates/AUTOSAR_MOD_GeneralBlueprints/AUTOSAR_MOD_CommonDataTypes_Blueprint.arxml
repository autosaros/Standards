AUTOSAR XML (schema 00046)
standard types defined: sint64, uint64, boolean, uint8, uint16, uint32, sint8, sint16, sint32, float32, float64, uint8_least, uint16_least, uint32_least, sint8_least, sint16_least, sint32_least, Std_ReturnType, void
package /AUTOSAR/Std/ImplementationDataTypes_Blueprint
  impl type Std_VersionInfoType: category=STRUCTURE, type-emitter=Std_Types.h  # Standard Version Info Type | This type shall be used to request the version of a BSW module using the <Module name>_GetVersionInfo() function.
    5 x element, all with category=TYPE_REFERENCE:
      vendorID: implementation-data-type=uint16
      moduleID: implementation-data-type=uint16
      sw_major_version: implementation-data-type=uint8
      sw_minor_version: implementation-data-type=uint8
      sw_patch_version: implementation-data-type=uint8
package /AUTOSAR/GenDef/ImplementationDataTypes_Blueprint
  impl type ConstVoidPtr: category=DATA_REFERENCE, sw-pointer-target-props={target-category=VALUE, base-type=void, sw-impl-policy=CONST}
  impl type VoidPtr: category=DATA_REFERENCE, sw-pointer-target-props={target-category=VALUE, base-type=void}
