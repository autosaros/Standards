AUTOSAR XML (schema 00046)
package /AUTOSAR/Ifl/InterpolationRoutineMappingSets_Blueprint
  interpolation routine mapping set Ifl_Mappings
    interpolation-routine-mappings:
      {interpolation-routine{short-label=DPSearch_f32, interpolation-routine=Ifl_DPSearch_f32}, sw-record-layout=Distr_f32}
      {interpolation-routine{short-label=IntIpoCur_f32_f32, interpolation-routine=Ifl_IntIpoCur_f32_f32}, sw-record-layout=IntCurve_f32_f32}
      {interpolation-routine{short-label=IntIpoMap_f32f32_f32, interpolation-routine=Ifl_IntIpoMap_f32f32_f32}, sw-record-layout=IntMap_f32f32_f32}
      {interpolation-routine{short-label=IpoCur_f32, interpolation-routine=Ifl_IpoCur_f32}, sw-record-layout=Curve_f32}
      {interpolation-routine{short-label=IpoMap_f32, interpolation-routine=Ifl_IpoMap_f32}, sw-record-layout=Map_f32}
package /AUTOSAR/Ifl/SwRecordLayouts_Blueprint
  5 x sw record layout:
    Distr_f32: sw-record-layout-group={sw-record-layout-v={short-label=N, base-type=uint32, sw-record-layout-v-axis=1, sw-record-layout-v-prop=COUNT}, sw-record-layout-group={short-label=X, category=INDEX_INCR, sw-record-layout-group-axis=1, sw-record-layout-group-from=1, sw-record-layout-group-to=-1, sw-record-layout-v={base-type=float32, sw-record-layout-v-axis=1, sw-record-layout-v-prop=VALUE}}}
    IntCurve_f32_f32: sw-record-layout-group={sw-record-layout-v={short-label=N, base-type=uint32, sw-record-layout-v-axis=1, sw-record-layout-v-prop=COUNT}, sw-record-layout-group={short-label=X, category=INDEX_INCR, sw-record-layout-group-axis=1, sw-record-layout-group-index=X, sw-record-layout-group-from=1, sw-record-layout-group-to=-1, sw-record-layout-v={base-type=float32, sw-record-layout-v-axis=1, sw-record-layout-v-prop=VALUE}}, sw-record-layout-group={short-label=Val, category=COLUMN_DIR, sw-record-layout-group-axis=0, sw-record-layout-group-from=1, sw-record-layout-group-to=-1, sw-record-layout-v={base-type=float32, sw-record-layout-v-axis=0, sw-record-layout-v-prop=VALUE, sw-record-layout-v-index=X}}}
    IntMap_f32f32_f32: sw-record-layout-group={sw-record-layout-v={short-label=Nx, base-type=uint32, sw-record-layout-v-axis=1, sw-record-layout-v-prop=COUNT}, sw-record-layout-v={short-label=Ny, base-type=uint32, sw-record-layout-v-axis=2, sw-record-layout-v-prop=COUNT}, sw-record-layout-group={short-label=X, category=INDEX_INCR, sw-record-layout-group-axis=1, sw-record-layout-group-index=X, sw-record-layout-group-from=1, sw-record-layout-group-to=-1, sw-record-layout-v={base-type=float32, sw-record-layout-v-axis=1, sw-record-layout-v-prop=VALUE}}, sw-record-layout-group={short-label=Y, category=INDEX_INCR, sw-record-layout-group-axis=2, sw-record-layout-group-index=Y, sw-record-layout-group-from=1, sw-record-layout-group-to=-1, sw-record-layout-v={base-type=float32, sw-record-layout-v-axis=2, sw-record-layout-v-prop=VALUE}}, sw-record-layout-group={short-label=Val, category=COLUMN_DIR, sw-record-layout-group-axis=1, sw-record-layout-group-index=X, sw-record-layout-group-from=1, sw-record-layout-group-to=-1, sw-record-layout-group={sw-record-layout-group-axis=2, sw-record-layout-group-index=Y, sw-record-layout-group-from=1, sw-record-layout-group-to=-1, sw-record-layout-v={base-type=float32, sw-record-layout-v-axis=0, sw-record-layout-v-prop=VALUE, sw-record-layout-v-index=X Y}}}}
    Curve_f32: sw-record-layout-group={short-label=Val, category=COLUMN_DIR, sw-record-layout-group-axis=1, sw-record-layout-group-index=X, sw-record-layout-group-from=1, sw-record-layout-group-to=-1, sw-record-layout-v={base-type=float32, sw-record-layout-v-axis=0, sw-record-layout-v-prop=VALUE, sw-record-layout-v-index=X}}
    Map_f32: sw-record-layout-group={short-label=Val, category=COLUMN_DIR, sw-record-layout-group-axis=1, sw-record-layout-group-index=X, sw-record-layout-group-from=1, sw-record-layout-group-to=-1, sw-record-layout-group={sw-record-layout-group-axis=2, sw-record-layout-group-index=Y, sw-record-layout-group-from=1, sw-record-layout-group-to=-1, sw-record-layout-v={base-type=float32, sw-record-layout-v-axis=0, sw-record-layout-v-prop=VALUE, sw-record-layout-v-index=X Y}}}
