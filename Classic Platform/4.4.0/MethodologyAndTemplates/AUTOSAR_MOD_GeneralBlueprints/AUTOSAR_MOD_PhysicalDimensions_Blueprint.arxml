AUTOSAR XML (schema 00046)
package /AUTOSAR/AUTOSAR_PhysicalUnits/PhysicalDimensions_Blueprints
  76 x physical dimension:
    Amnt1: length-exp=0, mass-exp=0, time-exp=0, current-exp=0, temperature-exp=0, molar-amount-exp=1, luminous-intensity-exp=0  # Quantity of substance
    I1: length-exp=0, mass-exp=0, time-exp=0, current-exp=1, temperature-exp=0, molar-amount-exp=0, luminous-intensity-exp=0  # Electric Current
    Illmn1: length-exp=0, mass-exp=0, time-exp=0, current-exp=0, temperature-exp=0, molar-amount-exp=0, luminous-intensity-exp=1  # Luminous intensity
    Len1: length-exp=1, mass-exp=0, time-exp=0, current-exp=0, temperature-exp=0, molar-amount-exp=0, luminous-intensity-exp=0  # Length
    Len1M1TiNeg2: length-exp=1, mass-exp=1, time-exp=-2, current-exp=0, temperature-exp=0, molar-amount-exp=0, luminous-intensity-exp=0  # Force
    Len1M1TiNeg2INeg2: length-exp=1, mass-exp=1, time-exp=-2, current-exp=-2, temperature-exp=0, molar-amount-exp=0, luminous-intensity-exp=0  # Permeability
    Len1M1TiNeg2_1: length-exp=1, mass-exp=1, time-exp=-2, current-exp=0, temperature-exp=0, molar-amount-exp=0, luminous-intensity-exp=0  # Electrical Energy Consumption
    Len1M1TiNeg3INeg1: length-exp=1, mass-exp=1, time-exp=-3, current-exp=-1, temperature-exp=0, molar-amount-exp=0, luminous-intensity-exp=0  # Electric Field Strength / Electric intensity
    Len1M1TiNeg3TNeg1: length-exp=1, mass-exp=1, time-exp=-3, current-exp=0, temperature-exp=-1, molar-amount-exp=0, luminous-intensity-exp=0  # Thermal Conductivity
    Len1TiNeg1: length-exp=1, mass-exp=0, time-exp=-1, current-exp=0, temperature-exp=0, molar-amount-exp=0, luminous-intensity-exp=0  # Velocity
    Len1TiNeg2: length-exp=1, mass-exp=0, time-exp=-2, current-exp=0, temperature-exp=0, molar-amount-exp=0, luminous-intensity-exp=0  # Acceleration
    Len1TiNeg3: length-exp=1, mass-exp=0, time-exp=-3, current-exp=0, temperature-exp=0, molar-amount-exp=0, luminous-intensity-exp=0  # Acceleration Time Gradient
    Len2: length-exp=2, mass-exp=0, time-exp=0, current-exp=0, temperature-exp=0, molar-amount-exp=0, luminous-intensity-exp=0  # Area
    Len2M1: length-exp=2, mass-exp=1, time-exp=0, current-exp=0, temperature-exp=0, molar-amount-exp=0, luminous-intensity-exp=0  # Moment of Inertia
    Len2M1TiNeg1: length-exp=2, mass-exp=1, time-exp=-1, current-exp=0, temperature-exp=0, molar-amount-exp=0, luminous-intensity-exp=0  # Angular Momentum
    Len2M1TiNeg2: length-exp=2, mass-exp=1, time-exp=-2, current-exp=0, temperature-exp=0, molar-amount-exp=0, luminous-intensity-exp=0  # Torque
    Len2M1TiNeg2AmntNeg1: length-exp=2, mass-exp=1, time-exp=-2, current-exp=0, temperature-exp=0, molar-amount-exp=-1, luminous-intensity-exp=0  # Molar Energy
    Len2M1TiNeg2INeg1: length-exp=2, mass-exp=1, time-exp=-2, current-exp=-1, temperature-exp=0, molar-amount-exp=0, luminous-intensity-exp=0  # Magnetic Flux
    Len2M1TiNeg2INeg2: length-exp=2, mass-exp=1, time-exp=-2, current-exp=-2, temperature-exp=0, molar-amount-exp=0, luminous-intensity-exp=0  # Inductance
    Len2M1TiNeg2TNeg1: length-exp=2, mass-exp=1, time-exp=-2, current-exp=0, temperature-exp=-1, molar-amount-exp=0, luminous-intensity-exp=0  # Heat Capacity
    Len2M1TiNeg2TNeg1AmntNeg1: length-exp=2, mass-exp=1, time-exp=-2, current-exp=0, temperature-exp=-1, molar-amount-exp=-1, luminous-intensity-exp=0  # Molar Heat Capacity
    Len2M1TiNeg2_1: length-exp=2, mass-exp=1, time-exp=-2, current-exp=0, temperature-exp=0, molar-amount-exp=0, luminous-intensity-exp=0  # Energy
    Len2M1TiNeg3: length-exp=2, mass-exp=1, time-exp=-3, current-exp=0, temperature-exp=0, molar-amount-exp=0, luminous-intensity-exp=0  # Torque Time Gradient
    Len2M1TiNeg3INeg1: length-exp=2, mass-exp=1, time-exp=-3, current-exp=-1, temperature-exp=0, molar-amount-exp=0, luminous-intensity-exp=0  # Voltage
    Len2M1TiNeg3INeg2: length-exp=2, mass-exp=1, time-exp=-3, current-exp=-2, temperature-exp=0, molar-amount-exp=0, luminous-intensity-exp=0  # Electric Resistance
    Len2M1TiNeg3_1: length-exp=2, mass-exp=1, time-exp=-3, current-exp=0, temperature-exp=0, molar-amount-exp=0, luminous-intensity-exp=0  # Power
    Len2M1TiNeg4: length-exp=2, mass-exp=1, time-exp=-4, current-exp=0, temperature-exp=0, molar-amount-exp=0, luminous-intensity-exp=0  # Power Time Gradient
    Len2M1TiNeg4INeg1: length-exp=2, mass-exp=1, time-exp=-4, current-exp=-1, temperature-exp=0, molar-amount-exp=0, luminous-intensity-exp=0  # Voltage Time Gradient
    Len2Ti1: length-exp=2, mass-exp=0, time-exp=-1, current-exp=0, temperature-exp=0, molar-amount-exp=0, luminous-intensity-exp=0  # Kinematic Viscosity
    Len2TiNeg2: length-exp=2, mass-exp=0, time-exp=-2, current-exp=0, temperature-exp=0, molar-amount-exp=0, luminous-intensity-exp=0  # Specific Heat
    Len2TiNeg2TNeg1: length-exp=2, mass-exp=0, time-exp=-2, current-exp=0, temperature-exp=-1, molar-amount-exp=0, luminous-intensity-exp=0  # Specific Heat Capacity
    Len2_1: length-exp=2, mass-exp=0, time-exp=0, current-exp=0, temperature-exp=0, molar-amount-exp=0, luminous-intensity-exp=0  # Volume Per Distance / Fuel Consumption
    Len3: length-exp=3, mass-exp=0, time-exp=0, current-exp=0, temperature-exp=0, molar-amount-exp=0, luminous-intensity-exp=0  # Volume
    Len3MNeg1: length-exp=3, mass-exp=-1, time-exp=0, current-exp=0, temperature-exp=0, molar-amount-exp=0, luminous-intensity-exp=0  # Specific Volume
    Len3TiNeg1: length-exp=3, mass-exp=0, time-exp=-1, current-exp=0, temperature-exp=0, molar-amount-exp=0, luminous-intensity-exp=0  # Volumetric Flow
    Len3TiNeg2: length-exp=3, mass-exp=0, time-exp=-2, current-exp=0, temperature-exp=0, molar-amount-exp=0, luminous-intensity-exp=0  # Volumetric Flow Gradient
    LenNeg1: length-exp=-1, mass-exp=0, time-exp=0, current-exp=0, temperature-exp=0, molar-amount-exp=0, luminous-intensity-exp=0  # Inverse Length
    LenNeg1M1TiNeg1: length-exp=-1, mass-exp=1, time-exp=-1, current-exp=0, temperature-exp=0, molar-amount-exp=0, luminous-intensity-exp=0  # Dynamic Viscosity
    LenNeg1M1TiNeg2: length-exp=-1, mass-exp=1, time-exp=-2, current-exp=0, temperature-exp=0, molar-amount-exp=0, luminous-intensity-exp=0  # Pressure
    LenNeg1M1TiNeg2_1: length-exp=-1, mass-exp=1, time-exp=-2, current-exp=0, temperature-exp=0, molar-amount-exp=0, luminous-intensity-exp=0  # Pressure by Angle
    LenNeg1M1TiNeg3: length-exp=-1, mass-exp=1, time-exp=-3, current-exp=0, temperature-exp=0, molar-amount-exp=0, luminous-intensity-exp=0  # Pressure Gradient
    LenNeg2Illmn1: length-exp=-2, mass-exp=0, time-exp=0, current-exp=0, temperature-exp=0, molar-amount-exp=0, luminous-intensity-exp=1  # Illuminance
    LenNeg2MNeg1Ti3I2: length-exp=-2, mass-exp=-1, time-exp=3, current-exp=2, temperature-exp=0, molar-amount-exp=0, luminous-intensity-exp=0  # Electrical Conductance
    LenNeg2MNeg1Ti4I2: length-exp=-2, mass-exp=-1, time-exp=4, current-exp=2, temperature-exp=0, molar-amount-exp=0, luminous-intensity-exp=0  # Capacitance
    LenNeg3Amnt1: length-exp=-3, mass-exp=0, time-exp=0, current-exp=0, temperature-exp=0, molar-amount-exp=1, luminous-intensity-exp=0  # Concentration
    LenNeg3M1: length-exp=-3, mass-exp=1, time-exp=0, current-exp=0, temperature-exp=0, molar-amount-exp=0, luminous-intensity-exp=0  # Mass Density
    LenNeg3MNeg1Ti2I2: length-exp=-3, mass-exp=-1, time-exp=2, current-exp=2, temperature-exp=0, molar-amount-exp=0, luminous-intensity-exp=0  # Electrical Conductivity Gradient
    LenNeg3MNeg1Ti3I2: length-exp=-3, mass-exp=-1, time-exp=3, current-exp=2, temperature-exp=0, molar-amount-exp=0, luminous-intensity-exp=0  # Electrical Conductivity
    LenNeg3Ti1I1: length-exp=-3, mass-exp=0, time-exp=1, current-exp=1, temperature-exp=0, molar-amount-exp=0, luminous-intensity-exp=0  # Electric Charge Density
    LenNeg3Ti1I1_1: length-exp=-3, mass-exp=0, time-exp=1, current-exp=1, temperature-exp=0, molar-amount-exp=0, luminous-intensity-exp=0  # Pressure per Voltage
    LenNeg3TiNeg1Amnt1: length-exp=-3, mass-exp=0, time-exp=-1, current-exp=0, temperature-exp=0, molar-amount-exp=1, luminous-intensity-exp=0  # Reaction Rate
    LenNeg4M1TiNeg1: length-exp=-4, mass-exp=1, time-exp=-1, current-exp=0, temperature-exp=0, molar-amount-exp=0, luminous-intensity-exp=0  # Pressure per Volumetric Flow / Flow Resistance
    M1: length-exp=0, mass-exp=1, time-exp=0, current-exp=0, temperature-exp=0, molar-amount-exp=0, luminous-intensity-exp=0  # Mass
    M1AmntNeg1: length-exp=0, mass-exp=1, time-exp=0, current-exp=0, temperature-exp=0, molar-amount-exp=-1, luminous-intensity-exp=0  # Molar Mass
    M1TiNeg1: length-exp=0, mass-exp=1, time-exp=-1, current-exp=0, temperature-exp=0, molar-amount-exp=0, luminous-intensity-exp=0  # Mass Flow
    M1TiNeg1_1: length-exp=0, mass-exp=1, time-exp=-1, current-exp=0, temperature-exp=0, molar-amount-exp=0, luminous-intensity-exp=0  # Translational Dumping
    M1TiNeg2: length-exp=0, mass-exp=1, time-exp=-2, current-exp=0, temperature-exp=0, molar-amount-exp=0, luminous-intensity-exp=0  # Surface Tension
    M1TiNeg2INeg1: length-exp=0, mass-exp=1, time-exp=-2, current-exp=-1, temperature-exp=0, molar-amount-exp=0, luminous-intensity-exp=0  # Magnetic Flux Density, Magnetic Induction
    M1TiNeg3TNeg1: length-exp=0, mass-exp=1, time-exp=-3, current-exp=0, temperature-exp=-1, molar-amount-exp=0, luminous-intensity-exp=0  # Heat Transfer Coefficient
    NoDimension: length-exp=0, mass-exp=0, time-exp=0, current-exp=0, temperature-exp=0, molar-amount-exp=0, luminous-intensity-exp=0  # Dimensionless
    NoDimension_1: length-exp=0, mass-exp=0, time-exp=0, current-exp=0, temperature-exp=0, molar-amount-exp=0, luminous-intensity-exp=0  # Ratio
    NoDimension_2: length-exp=0, mass-exp=0, time-exp=0, current-exp=0, temperature-exp=0, molar-amount-exp=0, luminous-intensity-exp=0  # Angle
    NoDimension_5: length-exp=0, mass-exp=0, time-exp=0, current-exp=0, temperature-exp=0, molar-amount-exp=0, luminous-intensity-exp=0  # Logarithmic Ratio
    NoDimension_6: length-exp=0, mass-exp=0, time-exp=0, current-exp=0, temperature-exp=0, molar-amount-exp=0, luminous-intensity-exp=0  # Amount of Data
    T1: length-exp=0, mass-exp=0, time-exp=0, current-exp=0, temperature-exp=1, molar-amount-exp=0, luminous-intensity-exp=0  # Absolute Temperature
    T1I1: length-exp=0, mass-exp=0, time-exp=1, current-exp=1, temperature-exp=0, molar-amount-exp=0, luminous-intensity-exp=0  # Electric Charge
    T1_1: length-exp=0, mass-exp=0, time-exp=0, current-exp=0, temperature-exp=1, molar-amount-exp=0, luminous-intensity-exp=0  # Relative Temperature, Temperature Difference
    Ti1: length-exp=0, mass-exp=0, time-exp=1, current-exp=0, temperature-exp=0, molar-amount-exp=0, luminous-intensity-exp=0  # Time
    TiNeg1: length-exp=0, mass-exp=0, time-exp=-1, current-exp=0, temperature-exp=0, molar-amount-exp=0, luminous-intensity-exp=0  # Frequency
    TiNeg1Amnt1: length-exp=0, mass-exp=0, time-exp=-1, current-exp=0, temperature-exp=0, molar-amount-exp=1, luminous-intensity-exp=0  # Catalytic Activity
    TiNeg1I1: length-exp=0, mass-exp=0, time-exp=-1, current-exp=1, temperature-exp=0, molar-amount-exp=0, luminous-intensity-exp=0  # Electric Current Gradient
    TiNeg1T1: length-exp=0, mass-exp=0, time-exp=-1, current-exp=0, temperature-exp=1, molar-amount-exp=0, luminous-intensity-exp=0  # Temperature Gradient
    TiNeg1_1: length-exp=0, mass-exp=0, time-exp=-1, current-exp=0, temperature-exp=0, molar-amount-exp=0, luminous-intensity-exp=0  # Ratio Gradient
    TiNeg1_2: length-exp=0, mass-exp=0, time-exp=-1, current-exp=0, temperature-exp=0, molar-amount-exp=0, luminous-intensity-exp=0  # Rotational Speed
    TiNeg1_3: length-exp=0, mass-exp=0, time-exp=-1, current-exp=0, temperature-exp=0, molar-amount-exp=0, luminous-intensity-exp=0  # Transfer Rate
    TiNeg2: length-exp=0, mass-exp=0, time-exp=-2, current-exp=0, temperature-exp=0, molar-amount-exp=0, luminous-intensity-exp=0  # Rotational Speed Gradient
