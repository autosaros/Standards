AUTOSAR XML (schema 00046)
package /AUTOSAR/GST/SwSystemconsts_Blueprint
  9 x sw systemconst:
    X
    Y
    MyX
    MyX_half
    Sy_test
    Sy_noTest
    test1
    test2
    undefined  # This system constant is to be undefined
package /AUTOSAR/GST/SwSytemconstantValueSets
  sw systemconstant value set TestValues
    sw-systemconstant-values:
      sw-systemconst=X, value=1
      sw-systemconst=Y, value=2.0
      sw-systemconst=MyX, value=12
      sw-systemconst=MyX_half, value=MyX
      sw-systemconst=Sy_test, value=100
      sw-systemconst=test1, value=true
      sw-systemconst=test2, value=true
package /AUTOSAR/GST/GeneralTests
  238 x constant specification:
    TP_GST_00000: value-spec=fields=[Expression:34.**44, ExpectedResult:2.4270143818756646e+067, ExpectedMessages:0]
    TP_GST_00001: value-spec=fields=[Expression:-X+Y+10, ExpectedResult:11.0, ExpectedMessages:0]
    TP_GST_00002: value-spec=fields=[Expression:-X/Y+10, ExpectedResult:9.5, ExpectedMessages:0]
    TP_GST_00003: value-spec=fields=[Expression:-X+Y+10, ExpectedResult:11.0, ExpectedMessages:0]
    TP_GST_00004: value-spec=fields=[Expression:-X-Y+10, ExpectedResult:7.0, ExpectedMessages:0]
    TP_GST_00005: value-spec=fields=[Expression:(2<7) == (8<3), ExpectedResult:0, ExpectedMessages:0]
    TP_GST_00006: value-spec=fields=[Expression:true!=false, ExpectedResult:1, ExpectedMessages:0]
    TP_GST_00007: value-spec=fields=[Expression:true==false, ExpectedResult:0, ExpectedMessages:0]
    TP_GST_00008: value-spec=fields=[Expression:!(3>2)^^(4==4), ExpectedResult:1, ExpectedMessages:0]
    TP_GST_00009: value-spec=fields=[Expression:!false^^true, ExpectedResult:0, ExpectedMessages:0]
    TP_GST_00029: value-spec=fields=[Expression:-1**(-4), ExpectedResult:1, ExpectedMessages:0]
    TP_GST_00030: value-spec=fields=[Expression:-4**3, ExpectedResult:-64, ExpectedMessages:0]
    TP_GST_00031: value-spec=fields=[Expression:-3**-2, ExpectedResult:0, ExpectedMessages:0]
    TP_GST_00032: value-spec=fields=[Expression:-2**2, ExpectedResult:4, ExpectedMessages:0]
    TP_GST_00033: value-spec=fields=[Expression:-2**5, ExpectedResult:-32, ExpectedMessages:0]
    TP_GST_00034: value-spec=fields=[Expression:-3**5, ExpectedResult:-243, ExpectedMessages:0]
    TP_GST_00035: value-spec=fields=[Expression:-2**4, ExpectedResult:16, ExpectedMessages:0]
    TP_GST_00036: value-spec=fields=[Expression:-3.1**-2.2, ExpectedResult:, ExpectedMessages:2]
    TP_GST_00037: value-spec=fields=[Expression:-2>(-3), ExpectedResult:1, ExpectedMessages:0]
    TP_GST_00038: value-spec=fields=[Expression:-2>-3, ExpectedResult:1, ExpectedMessages:0]
    TP_GST_00039: value-spec=fields=[Expression:-3>-2, ExpectedResult:0, ExpectedMessages:0]
    TP_GST_00040: value-spec=fields=[Expression:-2<-3, ExpectedResult:0, ExpectedMessages:0]
    TP_GST_00041: value-spec=fields=[Expression:-2**3, ExpectedResult:-8, ExpectedMessages:0]
    TP_GST_00042: value-spec=fields=[Expression:-4**(-1), ExpectedResult:0, ExpectedMessages:0]
    TP_GST_00043: value-spec=fields=[Expression:-4**(-2), ExpectedResult:0, ExpectedMessages:0]
    TP_GST_00044: value-spec=fields=[Expression:-1**(-2), ExpectedResult:1, ExpectedMessages:0]
    TP_GST_00045: value-spec=fields=[Expression:-1**(-3), ExpectedResult:-1, ExpectedMessages:0]
    TP_GST_00046: value-spec=fields=[Expression:-1**3, ExpectedResult:-1, ExpectedMessages:0]
    TP_GST_00047: value-spec=fields=[Expression:-1**4, ExpectedResult:1, ExpectedMessages:0]
    TP_GST_00048: value-spec=fields=[Expression:0.9999999534339, ExpectedResult:1.0, ExpectedMessages:0]
    TP_GST_00049: value-spec=fields=[Expression:(0.9999999534339), ExpectedResult:1.0, ExpectedMessages:0]
    TP_GST_00050: value-spec=fields=[Expression:(7&8)>0, ExpectedResult:0, ExpectedMessages:0]
    TP_GST_00051: value-spec=fields=[Expression:5, ExpectedResult:5, ExpectedMessages:0]
    TP_GST_00052: value-spec=fields=[Expression:(5), ExpectedResult:5, ExpectedMessages:0]
    TP_GST_00053: value-spec=fields=[Expression:-3, ExpectedResult:-3, ExpectedMessages:0]
    TP_GST_00054: value-spec=fields=[Expression:+3, ExpectedResult:3, ExpectedMessages:0]
    TP_GST_00055: value-spec=fields=[Expression:7-8, ExpectedResult:-1, ExpectedMessages:0]
    TP_GST_00056: value-spec=fields=[Expression:0x2c, ExpectedResult:44, ExpectedMessages:0]
    TP_GST_00057: value-spec=fields=[Expression:0b00101100, ExpectedResult:44, ExpectedMessages:0]
    TP_GST_00058: value-spec=fields=[Expression:0b00101100+0x10, ExpectedResult:60, ExpectedMessages:0]
    TP_GST_00059: value-spec=fields=[Expression:7+8-9, ExpectedResult:6, ExpectedMessages:0]
    TP_GST_00060: value-spec=fields=[Expression:-(7+8-9), ExpectedResult:-6, ExpectedMessages:0]
    TP_GST_00061: value-spec=fields=[Expression:-1**0, ExpectedResult:1, ExpectedMessages:0]
    TP_GST_00062: value-spec=fields=[Expression:-1**3, ExpectedResult:-1, ExpectedMessages:0]
    TP_GST_00063: value-spec=fields=[Expression:-1**-3, ExpectedResult:-1, ExpectedMessages:0]
    TP_GST_00064: value-spec=fields=[Expression:-1**2, ExpectedResult:1, ExpectedMessages:0]
    TP_GST_00065: value-spec=fields=[Expression:-1**-2, ExpectedResult:1, ExpectedMessages:0]
    TP_GST_00066: value-spec=fields=[Expression:0**2, ExpectedResult:0, ExpectedMessages:0]
    TP_GST_00067: value-spec=fields=[Expression:0**3, ExpectedResult:0, ExpectedMessages:0]
    TP_GST_00068: value-spec=fields=[Expression:0**3/-1, ExpectedResult:0, ExpectedMessages:0]
    TP_GST_00069: value-spec=fields=[Expression:0**-3, ExpectedResult:, ExpectedMessages:1]
    TP_GST_00070: value-spec=fields=[Expression:0**0, ExpectedResult:1, ExpectedMessages:0]
    TP_GST_00071: value-spec=fields=[Expression:7+(-8+9), ExpectedResult:8, ExpectedMessages:0]
    TP_GST_00072: value-spec=fields=[Expression:7+(8-(5+9)), ExpectedResult:1, ExpectedMessages:0]
    TP_GST_00073: value-spec=fields=[Expression:3.5, ExpectedResult:3.5, ExpectedMessages:0]
    TP_GST_00074: value-spec=fields=[Expression:.5, ExpectedResult:0.5, ExpectedMessages:0]
    TP_GST_00075: value-spec=fields=[Expression:-4.99999, ExpectedResult:-4.99999, ExpectedMessages:0]
    TP_GST_00076: value-spec=fields=[Expression:3.5-4.9, ExpectedResult:-1.4, ExpectedMessages:0]
    TP_GST_00077: value-spec=fields=[Expression:1E2, ExpectedResult:100, ExpectedMessages:0]
    TP_GST_00078: value-spec=fields=[Expression:1E-2, ExpectedResult:0.01, ExpectedMessages:0]
    TP_GST_00079: value-spec=fields=[Expression:7+(3-2), ExpectedResult:8, ExpectedMessages:0]
    TP_GST_00080: value-spec=fields=[Expression:7+(2-3), ExpectedResult:6, ExpectedMessages:0]
    TP_GST_00081: value-spec=fields=[Expression:7+(2-3.3), ExpectedResult:5.7, ExpectedMessages:0]
    TP_GST_00082: value-spec=fields=[Expression:7/2, ExpectedResult:3, ExpectedMessages:0]
    TP_GST_00083: value-spec=fields=[Expression:7.0/2, ExpectedResult:3.5, ExpectedMessages:0]
    TP_GST_00084: value-spec=fields=[Expression:7/2.0, ExpectedResult:3.5, ExpectedMessages:0]
    TP_GST_00085: value-spec=fields=[Expression:7.0/2.0, ExpectedResult:3.5, ExpectedMessages:0]
    TP_GST_00086: value-spec=fields=[Expression:2**10, ExpectedResult:1024, ExpectedMessages:0]
    TP_GST_00087: value-spec=fields=[Expression:-1.5**2, ExpectedResult:2.25, ExpectedMessages:0]
    TP_GST_00088: value-spec=fields=[Expression:-1.5**-2, ExpectedResult:0.444444444444444444444, ExpectedMessages:0]
    TP_GST_00089: value-spec=fields=[Expression:2<2, ExpectedResult:0, ExpectedMessages:0]
    TP_GST_00090: value-spec=fields=[Expression:2<3, ExpectedResult:1, ExpectedMessages:0]
    TP_GST_00091: value-spec=fields=[Expression:2.<3, ExpectedResult:1, ExpectedMessages:0]
    TP_GST_00092: value-spec=fields=[Expression:2.<3., ExpectedResult:1, ExpectedMessages:0]
    TP_GST_00093: value-spec=fields=[Expression:2<3., ExpectedResult:1, ExpectedMessages:0]
    TP_GST_00094: value-spec=fields=[Expression:2<=2, ExpectedResult:1, ExpectedMessages:0]
    TP_GST_00095: value-spec=fields=[Expression:2.<=3, ExpectedResult:1, ExpectedMessages:0]
    TP_GST_00096: value-spec=fields=[Expression:2.<=3., ExpectedResult:1, ExpectedMessages:0]
    TP_GST_00097: value-spec=fields=[Expression:2<=3., ExpectedResult:1, ExpectedMessages:0]
    TP_GST_00098: value-spec=fields=[Expression:(2<=3.)*4, ExpectedResult:4, ExpectedMessages:0]
    TP_GST_00099: value-spec=fields=[Expression:-2.1>-2.1, ExpectedResult:0, ExpectedMessages:0]
    TP_GST_00100: value-spec=fields=[Expression:3.1>2.1, ExpectedResult:1, ExpectedMessages:0]
    TP_GST_00101: value-spec=fields=[Expression:-3.1>-2.1, ExpectedResult:0, ExpectedMessages:0]
    TP_GST_00102: value-spec=fields=[Expression:-3.1>-2.1, ExpectedResult:0, ExpectedMessages:0]
    TP_GST_00103: value-spec=fields=[Expression:2.1>=2.1, ExpectedResult:1, ExpectedMessages:0]
    TP_GST_00104: value-spec=fields=[Expression:2.1>= 2.1, ExpectedResult:1, ExpectedMessages:0]
    TP_GST_00105: value-spec=fields=[Expression:2<2&&2<=2, ExpectedResult:0, ExpectedMessages:0]
    TP_GST_00106: value-spec=fields=[Expression:2<=2&&2<2, ExpectedResult:0, ExpectedMessages:0]
    TP_GST_00107: value-spec=fields=[Expression:2<2&&3<2, ExpectedResult:0, ExpectedMessages:0]
    TP_GST_00108: value-spec=fields=[Expression:2<2+1&&3-2<2, ExpectedResult:1, ExpectedMessages:0]
    TP_GST_00109: value-spec=fields=[Expression:2<=2&&3<=3, ExpectedResult:1, ExpectedMessages:0]
    TP_GST_00110: value-spec=fields=[Expression:2<2 || 2<=2, ExpectedResult:1, ExpectedMessages:0]
    TP_GST_00111: value-spec=fields=[Expression:(2<2) || (2<=2), ExpectedResult:1, ExpectedMessages:0]
    TP_GST_00112: value-spec=fields=[Expression:2<=2 || 2<2, ExpectedResult:1, ExpectedMessages:0]
    TP_GST_00113: value-spec=fields=[Expression:2<2 || 3<2, ExpectedResult:0, ExpectedMessages:0]
    TP_GST_00114: value-spec=fields=[Expression:2<=2 || 3<=3, ExpectedResult:1, ExpectedMessages:0]
    TP_GST_00115: value-spec=fields=[Expression:1E2 == 100, ExpectedResult:1, ExpectedMessages:0]
    TP_GST_00116: value-spec=fields=[Expression:99 == 100, ExpectedResult:0, ExpectedMessages:0]
    TP_GST_00117: value-spec=fields=[Expression:1E2 != 100, ExpectedResult:0, ExpectedMessages:0]
    TP_GST_00118: value-spec=fields=[Expression:1E2 != 100.0, ExpectedResult:0, ExpectedMessages:0]
    TP_GST_00119: value-spec=fields=[Expression:99 != 100, ExpectedResult:1, ExpectedMessages:0]
    TP_GST_00120: value-spec=fields=[Expression:99 != -100, ExpectedResult:1, ExpectedMessages:0]
    TP_GST_00121: value-spec=fields=[Expression:!(1E2 == 100), ExpectedResult:0, ExpectedMessages:0]
    TP_GST_00122: value-spec=fields=[Expression:!(99 == 100), ExpectedResult:1, ExpectedMessages:0]
    TP_GST_00123: value-spec=fields=[Expression:0x2c&0x6a, ExpectedResult:40, ExpectedMessages:0]
    TP_GST_00124: value-spec=fields=[Expression:0x2c | 0x1a, ExpectedResult:62, ExpectedMessages:0]
    TP_GST_00125: value-spec=fields=[Expression:0x2c ^ 0x1a, ExpectedResult:54, ExpectedMessages:0]
    TP_GST_00126: value-spec=fields=[Expression:~0xffffffca, ExpectedResult:53, ExpectedMessages:0]
    TP_GST_00127: value-spec=fields=[Expression:0x8a>>2, ExpectedResult:34, ExpectedMessages:0]
    TP_GST_00128: value-spec=fields=[Expression:0x8a>>3, ExpectedResult:17, ExpectedMessages:0]
    TP_GST_00129: value-spec=fields=[Expression:0x8a<<2, ExpectedResult:552, ExpectedMessages:0]
    TP_GST_00130: value-spec=fields=[Expression:MyX, ExpectedResult:12, ExpectedMessages:0]
    TP_GST_00131: value-spec=fields=[Expression:MyX_half, ExpectedResult:6, ExpectedMessages:0]
    TP_GST_00132: value-spec=fields=[Expression:Sy_test+(2-3), ExpectedResult:99, ExpectedMessages:0]
    TP_GST_00133: value-spec=fields=[Expression:Sy_test+MyX, ExpectedResult:112, ExpectedMessages:0]
    TP_GST_00134: value-spec=fields=[Expression:1/Sy_test, ExpectedResult:0, ExpectedMessages:0]
    TP_GST_00135: value-spec=fields=[Expression:defined(Sy_test), ExpectedResult:1, ExpectedMessages:0]
    TP_GST_00136: value-spec=fields=[Expression:Sy_noTest, ExpectedResult:0, ExpectedMessages:1]
    TP_GST_00137: value-spec=fields=[Expression:defined(Sy_noTest)&&Sy_noTest==0, ExpectedResult:0, ExpectedMessages:0]
    TP_GST_00138: value-spec=fields=[Expression:defined(Sy_noTest)&&Sy_noTest==4, ExpectedResult:0, ExpectedMessages:0]
    TP_GST_00139: value-spec=fields=[Expression:defined(Sy_no), ExpectedResult:0, ExpectedMessages:0]
    TP_GST_00140: value-spec=fields=[Expression:defined(MyX), ExpectedResult:1, ExpectedMessages:0]
    TP_GST_00143: value-spec=fields=[Expression:exp (1.0), ExpectedResult:2.71828, ExpectedMessages:0]
    TP_GST_00144: value-spec=fields=[Expression:exp (2), ExpectedResult:7.38906, ExpectedMessages:0]
    TP_GST_00145: value-spec=fields=[Expression:abs (4.5), ExpectedResult:4.5, ExpectedMessages:0]
    TP_GST_00146: value-spec=fields=[Expression:abs(-3.4), ExpectedResult:3.4, ExpectedMessages:0]
    TP_GST_00147: value-spec=fields=[Expression:abs(-3), ExpectedResult:3, ExpectedMessages:0]
    TP_GST_00148: value-spec=fields=[Expression:abs(-15)/7, ExpectedResult:2, ExpectedMessages:0]
    TP_GST_00149: value-spec=fields=[Expression:min(-3.4, -4.5), ExpectedResult:-4.5, ExpectedMessages:0]
    TP_GST_00150: value-spec=fields=[Expression:min(3.4, 4.5), ExpectedResult:3.4, ExpectedMessages:0]
    TP_GST_00151: value-spec=fields=[Expression:min(17,34.5)/4, ExpectedResult:4.25, ExpectedMessages:0]
    TP_GST_00152: value-spec=fields=[Expression:min(17,34)/4, ExpectedResult:4, ExpectedMessages:0]
    TP_GST_00153: value-spec=fields=[Expression:max(-3.4, -4.5), ExpectedResult:-3.4, ExpectedMessages:0]
    TP_GST_00154: value-spec=fields=[Expression:max(3.4, 4.5), ExpectedResult:4.5, ExpectedMessages:0]
    TP_GST_00155: value-spec=fields=[Expression:max(3.4, 3), ExpectedResult:3.4, ExpectedMessages:0]
    TP_GST_00163: value-spec=fields=[Expression:ceil(3.5), ExpectedResult:4, ExpectedMessages:0]
    TP_GST_00164: value-spec=fields=[Expression:ceil(-3.4), ExpectedResult:-3, ExpectedMessages:0]
    TP_GST_00165: value-spec=fields=[Expression:ceil(-3.9), ExpectedResult:-3, ExpectedMessages:0]
    TP_GST_00166: value-spec=fields=[Expression:floor(3.4), ExpectedResult:3, ExpectedMessages:0]
    TP_GST_00167: value-spec=fields=[Expression:floor(3.5), ExpectedResult:3, ExpectedMessages:0]
    TP_GST_00168: value-spec=fields=[Expression:floor(4.9), ExpectedResult:4, ExpectedMessages:0]
    TP_GST_00169: value-spec=fields=[Expression:floor(9.5)/2, ExpectedResult:4, ExpectedMessages:0]
    TP_GST_00170: value-spec=fields=[Expression:floor(-3.5), ExpectedResult:-4, ExpectedMessages:0]
    TP_GST_00171: value-spec=fields=[Expression:streqcs("case","sensitive"), ExpectedResult:0, ExpectedMessages:0]
    TP_GST_00172: value-spec=fields=[Expression:streqcs("sensitive","sensitive"), ExpectedResult:1, ExpectedMessages:0]
    TP_GST_00173: value-spec=fields=[Expression:streqcs("Sensitive","sensitive"), ExpectedResult:0, ExpectedMessages:0]
    TP_GST_00174: value-spec=fields=[Expression:streqci("case","insensitive"), ExpectedResult:0, ExpectedMessages:0]
    TP_GST_00175: value-spec=fields=[Expression:streqci("insensitive","insensitive"), ExpectedResult:1, ExpectedMessages:0]
    TP_GST_00176: value-spec=fields=[Expression:streqci("insensitive","inSensitive"), ExpectedResult:1, ExpectedMessages:0]
    TP_GST_00177: value-spec=fields=[Expression:log(2.71828), ExpectedResult:1, ExpectedMessages:0]
    TP_GST_00179: value-spec=fields=[Expression:log10(10), ExpectedResult:1, ExpectedMessages:0]
    TP_GST_00180: value-spec=fields=[Expression:sqrt(81), ExpectedResult:9, ExpectedMessages:0]
    TP_GST_00181: value-spec=fields=[Expression:sin(3.1415926535897932384626433832795/2), ExpectedResult:1, ExpectedMessages:0]
    TP_GST_00182: value-spec=fields=[Expression:cos(3.1415926535897932384626433832795/4)-sqrt(2)/2, ExpectedResult:0, ExpectedMessages:0]
    TP_GST_00183: value-spec=fields=[Expression:asin(sin(0.5)), ExpectedResult:0.5, ExpectedMessages:0]
    TP_GST_00184: value-spec=fields=[Expression:acos(cos(1.7)), ExpectedResult:1.7, ExpectedMessages:0]
    TP_GST_00185: value-spec=fields=[Expression:sin(2.3)**2+cos(2.3)**2, ExpectedResult:1, ExpectedMessages:0]
    TP_GST_00186: value-spec=fields=[Expression:sinh(17), ExpectedResult:12077476.37678762840769912366436, ExpectedMessages:0]
    TP_GST_00187: value-spec=fields=[Expression:cosh(1), ExpectedResult:1.54308063, ExpectedMessages:0]
    TP_GST_00188: value-spec=fields=[Expression:cosh(2.5)+sinh(2.5) - exp(2.5), ExpectedResult:0, ExpectedMessages:0]
    TP_GST_00189: value-spec=fields=[Expression:cosh(1.7)**2-sinh(1.7)**2, ExpectedResult:1, ExpectedMessages:0]
    TP_GST_00190: value-spec=fields=[Expression:sinh(4)-2*sinh(2)*cosh(2), ExpectedResult:0, ExpectedMessages:0]
    TP_GST_00191: value-spec=fields=[Expression:tan(3.1415926535897932384626433832795/4), ExpectedResult:1, ExpectedMessages:0]
    TP_GST_00192: value-spec=fields=[Expression:atan(0), ExpectedResult:0, ExpectedMessages:0]
    TP_GST_00193: value-spec=fields=[Expression:sgn( 3), ExpectedResult:1, ExpectedMessages:0]
    TP_GST_00194: value-spec=fields=[Expression:sgn(3.4), ExpectedResult:1, ExpectedMessages:0]
    TP_GST_00195: value-spec=fields=[Expression:sgn(+2.3), ExpectedResult:1, ExpectedMessages:0]
    TP_GST_00196: value-spec=fields=[Expression:sgn(+17), ExpectedResult:1, ExpectedMessages:0]
    TP_GST_00197: value-spec=fields=[Expression:sgn(-1), ExpectedResult:-1, ExpectedMessages:0]
    TP_GST_00198: value-spec=fields=[Expression:sgn(-2.5), ExpectedResult:-1, ExpectedMessages:0]
    TP_GST_00199: value-spec=fields=[Expression:sgn(+0), ExpectedResult:0, ExpectedMessages:0]
    TP_GST_00200: value-spec=fields=[Expression:sgn(-0), ExpectedResult:0, ExpectedMessages:0]
    TP_GST_00201: value-spec=fields=[Expression:pow(2,3), ExpectedResult:8, ExpectedMessages:0]
    TP_GST_00202: value-spec=fields=[Expression:pow(0,3), ExpectedResult:0, ExpectedMessages:0]
    TP_GST_00203: value-spec=fields=[Expression:pow(1,0), ExpectedResult:1, ExpectedMessages:0]
    TP_GST_00204: value-spec=fields=[Expression:pow(13.4,1), ExpectedResult:13.4, ExpectedMessages:0]
    TP_GST_00205: value-spec=fields=[Expression:pow(+2.3,1), ExpectedResult:2.3, ExpectedMessages:0]
    TP_GST_00206: value-spec=fields=[Expression:pow(-3.2,1), ExpectedResult:-3.2, ExpectedMessages:0]
    TP_GST_00207: value-spec=fields=[Expression:pow(0.25,-2), ExpectedResult:16, ExpectedMessages:0]
    TP_GST_00208: value-spec=fields=[Expression:pow(81,0.5), ExpectedResult:9, ExpectedMessages:0]
    TP_GST_00209: value-spec=fields=[Expression:pow(12.3,1.2)-12.3**1.2, ExpectedResult:0, ExpectedMessages:0]
    TP_GST_00210: value-spec=fields=[Expression:log(pow(exp(1),3)), ExpectedResult:3, ExpectedMessages:0]
    TP_GST_00211: value-spec=fields=[Expression:-2147483648/1, ExpectedResult:-2147483648, ExpectedMessages:0]
    TP_GST_00212: value-spec=fields=[Expression:2147483648/-1, ExpectedResult:-2147483648, ExpectedMessages:0]
    TP_GST_00213: value-spec=fields=[Expression:4294967294+1, ExpectedResult:4294967295, ExpectedMessages:0]
    TP_GST_00215: value-spec=fields=[Expression:true&&undefined, ExpectedResult:0, ExpectedMessages:1]
    TP_GST_00216: value-spec=fields=[Expression:false&&undefined, ExpectedResult:false, ExpectedMessages:0]
    TP_GST_00217: value-spec=fields=[Expression:undefined, ExpectedResult:0, ExpectedMessages:1]
    TP_GST_00218: value-spec=fields=[Expression:true||undefined, ExpectedResult:true, ExpectedMessages:0]
    TP_GST_00219: value-spec=fields=[Expression:false||undefined, ExpectedResult:0, ExpectedMessages:1]
    TP_GST_00220: value-spec=fields=[Expression:3<4?-4:-5, ExpectedResult:-4, ExpectedMessages:0]
    TP_GST_00221: value-spec=fields=[Expression:-4<-5?-3:-2, ExpectedResult:-2, ExpectedMessages:0]
    TP_GST_00222: value-spec=fields=[Expression:3.5>2.5?2:4, ExpectedResult:2, ExpectedMessages:0]
    TP_GST_00223: value-spec=fields=[Expression:(4.3>5.4?30:16)/7, ExpectedResult:2, ExpectedMessages:0]
    TP_GST_00224: value-spec=fields=[Expression:(4.3>5.4?-30:-16)/7, ExpectedResult:-2, ExpectedMessages:0]
    TP_GST_00225: value-spec=fields=[Expression:(4.3>5.4?(-30):-16)/7, ExpectedResult:-2, ExpectedMessages:0]
    TP_GST_00226: value-spec=fields=[Expression:(4.3>5.4?(-30):(-16))/7, ExpectedResult:-2, ExpectedMessages:0]
    TP_GST_00227: value-spec=fields=[Expression:(4.3>5.4?(+30):(-16))/7, ExpectedResult:-2, ExpectedMessages:0]
    TP_GST_00228: value-spec=fields=[Expression:(4.3>5.4?(+30):(+16))/7, ExpectedResult:2, ExpectedMessages:0]
    TP_GST_00229: value-spec=fields=[Expression:(4.3>5.4?(+30):+16)/7, ExpectedResult:2, ExpectedMessages:0]
    TP_GST_00230: value-spec=fields=[Expression:(4.3>5.4?+30:+16)/7, ExpectedResult:2, ExpectedMessages:0]
    TP_GST_00231: value-spec=fields=[Expression:(4.3>5.4?+31.0:15)/2, ExpectedResult:7, ExpectedMessages:0]
    TP_GST_00232: value-spec=fields=[Expression:(4.3>5.4?31:15)/2, ExpectedResult:7, ExpectedMessages:0]
    TP_GST_00233: value-spec=fields=[Expression:(4>5.4?31:15)/2, ExpectedResult:7, ExpectedMessages:0]
    TP_GST_00234: value-spec=fields=[Expression:NaN, ExpectedResult:0, ExpectedMessages:0]
    TP_GST_00235: value-spec=fields=[Expression:INF, ExpectedResult:0, ExpectedMessages:0]
    TP_GST_00236: value-spec=fields=[Expression:-INF, ExpectedResult:0, ExpectedMessages:0]
    TP_GST_00237: value-spec=fields=[Expression:-NaN, ExpectedResult:0, ExpectedMessages:1]
    TP_GST_00238: value-spec=fields=[Expression:INF==-INF, ExpectedResult:0, ExpectedMessages:0]
    TP_GST_00239: value-spec=fields=[Expression:INF==8.3, ExpectedResult:0, ExpectedMessages:0]
    TP_GST_00240: value-spec=fields=[Expression:0==INF, ExpectedResult:0, ExpectedMessages:0]
    TP_GST_00241: value-spec=fields=[Expression:INF==INF, ExpectedResult:1, ExpectedMessages:0]
    TP_GST_00242: value-spec=fields=[Expression:INF!=-INF, ExpectedResult:1, ExpectedMessages:0]
    TP_GST_00243: value-spec=fields=[Expression:1?7:INF, ExpectedResult:7, ExpectedMessages:0]
    TP_GST_00244: value-spec=fields=[Expression:-epsilon<0, ExpectedResult:1, ExpectedMessages:0]
    TP_GST_00245: value-spec=fields=[Expression:epsilon<0.1, ExpectedResult:1, ExpectedMessages:0]
    TP_GST_00246: value-spec=fields=[Expression:epsilon>0, ExpectedResult:1, ExpectedMessages:0]
    TP_GST_00247: value-spec=fields=[Expression:-epsilon+epsilon==0, ExpectedResult:1, ExpectedMessages:0]
    TP_GST_00248: value-spec=fields=[Expression:epsilon+epsilon>epsilon, ExpectedResult:1, ExpectedMessages:0]
    TP_GST_00249: value-spec=fields=[Expression:epsilon>epsilon+epsilon, ExpectedResult:0, ExpectedMessages:0]
    TP_GST_01001: value-spec=fields=[Expression:true&&false, ExpectedResult:false]
    TP_GST_01002: value-spec=fields=[Expression:false || true, ExpectedResult:true]
    TP_GST_01003: value-spec=fields=[Expression:1+10&&3 || 2, ExpectedResult:true]
    TP_GST_01004: value-spec=fields=[Expression:1+10*40-(-20)+10/11*(10+55+33.3-2)*(-10-9+5.1785), ExpectedResult:421]  # Note that according to TPS_GST_01034, TPS_GST_01010, TPS_GST_01011 yields an integer result. So the final result is 421.00000 instead of -789.0095000000001
    TP_GST_01005: value-spec=fields=[Expression:10<10, ExpectedResult:false]
    TP_GST_01006: value-spec=fields=[Expression:10<= 10, ExpectedResult:true]
    TP_GST_01007: value-spec=fields=[Expression:10>10, ExpectedResult:false]
    TP_GST_01008: value-spec=fields=[Expression:10<10.0000001, ExpectedResult:true]
    TP_GST_01009: value-spec=fields=[Expression:10<10.0000001&&11>9, ExpectedResult:true]
    TP_GST_01010: value-spec=fields=[Expression:10<10.0000001&&11<9, ExpectedResult:false]
    TP_GST_01011: value-spec=fields=[Expression:10<10.0000001&&11 != 9, ExpectedResult:true]
    TP_GST_01012: value-spec=fields=[Expression:5 ^^ 0, ExpectedResult:true]
    TP_GST_01013: value-spec=fields=[Expression:5 ^^ 1, ExpectedResult:false]
    TP_GST_01014: value-spec=fields=[Expression:(1 || (1&&0)) == 0, ExpectedResult:false]
    TP_GST_01015: value-spec=fields=[Expression:1 || (1&&0) == 0, ExpectedResult:true]
    TP_GST_01016: value-spec=fields=[Expression:true ^^ (true&&0) == 0, ExpectedResult:false]
    TP_GST_01017: value-spec=fields=[Expression:10 + 11.5 == 21.5 ? 5 : 4, ExpectedResult:5]
    TP_GST_01018: value-spec=fields=[Expression:10+11.5<21.5 ? 5 : 4, ExpectedResult:4]
package /AUTOSAR/GST/BinaryTests
  4 x constant specification:
    TP_GST_01019: value-spec=fields=[Expression:0b0001<<1, ExpectedResult:0b10]
    TP_GST_01020: value-spec=fields=[Expression:0b1111>>1, ExpectedResult:0b111]
    TP_GST_01021: value-spec=fields=[Expression:0b1111<<1, ExpectedResult:0b11110]
    TP_GST_01022: value-spec=fields=[Expression:0b1111<<2, ExpectedResult:0b111100]
package /AUTOSAR/GST/RoundTests
  25 x constant specification:
    TP_GST_00156: value-spec=fields=[Expression:round(3.4), ExpectedResult:3, ExpectedMessages:0]
    TP_GST_00157: value-spec=fields=[Expression:round(3.5), ExpectedResult:4, ExpectedMessages:0]
    TP_GST_00158: value-spec=fields=[Expression:round(4.5), ExpectedResult:5, ExpectedMessages:0]
    TP_GST_00159: value-spec=fields=[Expression:round(9.5)/2, ExpectedResult:5, ExpectedMessages:0]
    TP_GST_00160: value-spec=fields=[Expression:round(-3.5), ExpectedResult:-4, ExpectedMessages:0]
    TP_GST_00161: value-spec=fields=[Expression:round(-3.4), ExpectedResult:-3, ExpectedMessages:0]
    TP_GST_00162: value-spec=fields=[Expression:ceil(3.4), ExpectedResult:4, ExpectedMessages:0]
    TP_GST_01023: value-spec=fields=[Expression:round(4.4), ExpectedResult:4]
    TP_GST_01024: value-spec=fields=[Expression:round(4.7), ExpectedResult:5]
    TP_GST_01025: value-spec=fields=[Expression:round(4.5), ExpectedResult:5]
    TP_GST_01026: value-spec=fields=[Expression:round(-4.4), ExpectedResult:-4]
    TP_GST_01027: value-spec=fields=[Expression:round(-4.7), ExpectedResult:-5]
    TP_GST_01028: value-spec=fields=[Expression:round(-4.5), ExpectedResult:-5]
    TP_GST_01029: value-spec=fields=[Expression:floor(4.4), ExpectedResult:4]
    TP_GST_01030: value-spec=fields=[Expression:floor(4.7), ExpectedResult:4]
    TP_GST_01031: value-spec=fields=[Expression:floor(4.0), ExpectedResult:4]
    TP_GST_01032: value-spec=fields=[Expression:floor(-4.4), ExpectedResult:-5]
    TP_GST_01033: value-spec=fields=[Expression:floor(-4.7), ExpectedResult:-5]
    TP_GST_01034: value-spec=fields=[Expression:floor(-4.0), ExpectedResult:-4]
    TP_GST_01035: value-spec=fields=[Expression:ceil(4.4), ExpectedResult:5]
    TP_GST_01036: value-spec=fields=[Expression:ceil(4.7), ExpectedResult:5]
    TP_GST_01037: value-spec=fields=[Expression:ceil(4.0), ExpectedResult:4]
    TP_GST_01038: value-spec=fields=[Expression:ceil(-4.4), ExpectedResult:-4]
    TP_GST_01039: value-spec=fields=[Expression:ceil(-4.7), ExpectedResult:-4]
    TP_GST_01040: value-spec=fields=[Expression:ceil(-4.0), ExpectedResult:-4]
package /AUTOSAR/GST/LogcialTests
  8 x constant specification:
    TP_GST_01041: value-spec=fields=[Expression:true || undefined, ExpectedResult:true]
    TP_GST_01042: value-spec=fields=[Expression:false&&undefined, ExpectedResult:false]
    TP_GST_01043: value-spec=fields=[Expression:! (!true&&false), ExpectedResult:true]
    TP_GST_01044: value-spec=fields=[Expression:false&&test, ExpectedResult:false]
    TP_GST_01045: value-spec=fields=[Expression:true ||test, ExpectedResult:true]
    TP_GST_01046: value-spec=fields=[Expression:false ||test1, ExpectedResult:true]
    TP_GST_01047: value-spec=fields=[Expression:true&&defined(test2), ExpectedResult:true]
    TP_GST_01048: value-spec=fields=[Expression:true&&defined(undefined), ExpectedResult:false]
package /AUTOSAR/GST/StringRefTests
  constant specification TP_GST_00010: value-spec=fields=Expression:defined(Sy_test)
