[part 2 of 3: package /AUTOSAR/V2xFac/ImplementationDataTypes_Blueprint]
AUTOSAR XML (schema 00046)
package /AUTOSAR/V2xFac/ImplementationDataTypes_Blueprint
  543 x impl type:
    V2xFac_AbsolutePositionType: category=STRUCTURE
      element latitude: implementation-data-type=V2xFac_LatitudeType
      element longitude: implementation-data-type=V2xFac_LongitudeType
    V2xFac_AbsolutePositionWAltitudeType: category=STRUCTURE
      element latitude: implementation-data-type=V2xFac_LatitudeType
      element longitude: implementation-data-type=V2xFac_LongitudeType
      element altitude: implementation-data-type=V2xFac_AltitudeType
    V2xFac_AccelerationConfidenceType: compu {1=pointOneMeterPerSecSquared, 101=outOfRange, 102=unavailable}, range raw undefined, implementation-data-type=uint8
    V2xFac_AccelerationControlType:
      compu {mask 0x40: 0=FALSE (brakePedalEngaged__FALSE) (Bit 6: Driver is stepping on the brake pedal), mask 0x40: 64=TRUE (brakePedalEngaged) (Bit 6: Driver is stepping on the brake pedal), mask 0x20: 0=FALSE (gasPedalEngaged__FALSE) (Bit 5: Driver is stepping on the gas pedal), mask 0x20: 32=TRUE (gasPedalEngaged) (Bit 5: Driver is stepping on the gas pedal), mask 0x10: 0=FALSE (emergencyBrakeEngaged__FALSE) (Bit 4: Emergency brake system is engaged), mask 0x10: 16=TRUE (emergencyBrakeEngaged) (Bit 4: Emergency brake system is engaged), mask 0x08: 0=FALSE (collisionWarningEngaged__FALSE) (Bit 3: Collision warning system is engaged), mask 0x08: 8=TRUE (collisionWarningEngaged) (Bit 3: Collision warning system is engaged), mask 0x04: 0=FALSE (accEngaged__FALSE) (Bit 2: ACC is engaged), mask 0x04: 4=TRUE (accEngaged) (Bit 2: ACC is engaged), mask 0x02: 0=FALSE (cruiseControlEngaged__FALSE) (Bit 1: Cruise control is engaged), mask 0x02: 2=TRUE (cruiseControlEngaged) (Bit 1: Cruise control is engaged), mask 0x01: 0=FALSE (speedLimiterEngaged__FALSE) (Bit 0 (LSB): Speed limiter is engaged), mask 0x01: 1=TRUE (speedLimiterEngaged) (Bit 0 (LSB): Speed limiter is engaged)}
      range raw 0x00..0x7F
      implementation-data-type=uint8
    V2xFac_AccidentSubCauseCodeType: compu {0=unavailable, 1=multiVehicleAccident, 2=heavyAccident, 3=accidentInvolvingLorry, 4=accidentInvolvingBus, 5=accidentInvolvingHazardousMaterials, 6=accidentOnOppositeLane, 7=unsecuredAccident, 8=assistanceRequested}, range raw undefined, implementation-data-type=uint8
    V2xFac_ActionIDType: category=STRUCTURE
      element originatingStationID: implementation-data-type=V2xFac_StationIDType
      element sequenceNumber: implementation-data-type=V2xFac_SequenceNumberType
    V2xFac_ActionIdType: category=STRUCTURE
      element originatingStationID: implementation-data-type=uint32
      element sequenceNumber: implementation-data-type=uint16
    V2xFac_AdverseWeatherCondition_AdhesionSubCauseCodeType: compu {0=unavailable, 1=heavyFrostOnRoad, 2=fuelOnRoad, 3=mudOnRoad, 4=snowOnRoad, 5=iceOnRoad, 6=blackIceOnRoad, 7=oilOnRoad, 8=looseChippings, 9=instantBlackIce, 10=roadsSalted}, range raw undefined, implementation-data-type=uint8
    V2xFac_AdverseWeatherCondition_ExtremeWeatherConditionSubCauseCodeType: compu {0=unavailable, 1=strongWinds, 2=damagingHail, 3=hurricane, 4=thunderstorm, 5=tornado, 6=blizzard}, range raw undefined, implementation-data-type=uint8
    V2xFac_AdverseWeatherCondition_PrecipitationSubCauseCodeType: compu {0=unavailable, 1=heavyRain, 2=heavySnowfall, 3=softHail}, range raw undefined, implementation-data-type=uint8
    V2xFac_AdverseWeatherCondition_VisibilitySubCauseCodeType: compu {0=unavailable, 1=fog, 2=smoke, 3=heavySnowfall, 4=heavyRain, 5=heavyHail, 6=lowSunGlare, 7=sandstorms, 8=swarmsOfInsects}, range raw undefined, implementation-data-type=uint8
    V2xFac_AdvisorySpeedListType: category=STRUCTURE
      element count: implementation-data-type=uint8
      element values: category=ARRAY, array-size-semantics=FIXED-SIZE
        element values: array-size=undefined, array-size-semantics=FIXED-SIZE, implementation-data-type=V2xFac_AdvisorySpeedType
    V2xFac_AdvisorySpeedPresenceType:
      compu {mask 0x01: 0=FALSE (speed__FALSE) (Bit 0 (LSB): Optional child present), mask 0x01: 1=TRUE (speed) (Bit 0 (LSB): Optional child present), mask 0x02: 0=FALSE (confidence__FALSE) (Bit 1: Optional child present), mask 0x02: 2=TRUE (confidence) (Bit 1: Optional child present), mask 0x04: 0=FALSE (distance__FALSE) (Bit 2: Optional child present), mask 0x04: 4=TRUE (distance) (Bit 2: Optional child present), mask 0x08: 0=FALSE (class__FALSE) (Bit 3: Optional child present), mask 0x08: 8=TRUE (class) (Bit 3: Optional child present)}
      data-constr=V2xFac_AdvisorySpeedPresenceType
      implementation-data-type=uint8
    V2xFac_AdvisorySpeedType: category=STRUCTURE
      6 x element, all with category=TYPE_REFERENCE:
        type: implementation-data-type=V2xFac_AdvisorySpeedTypeType
        speed: implementation-data-type=V2xFac_SpeedAdviceType
        confidence: implementation-data-type=V2xFac_SpeedConfidenceType
        distance: implementation-data-type=V2xFac_ZoneLengthType
        class: implementation-data-type=V2xFac_RestrictionClassIDType
        presence: implementation-data-type=V2xFac_AdvisorySpeedPresenceType
    V2xFac_AdvisorySpeedTypeType: compu {0=none, 1=greenwave, 2=ecoDrive, 3=transit}, range raw 0..3
    V2xFac_AlacarteContainerPresenceType:
      compu {mask 0x20: 0=FALSE (lanePosition__FALSE) (Bit 5: Optional child present), mask 0x20: 32=TRUE (lanePosition) (Bit 5: Optional child present), mask 0x10: 0=FALSE (impactReduction__FALSE) (Bit 4: Optional child present), mask 0x10: 16=TRUE (impactReduction) (Bit 4: Optional child present), mask 0x08: 0=FALSE (externalTemperature__FALSE) (Bit 3: Optional child present), mask 0x08: 8=TRUE (externalTemperature) (Bit 3: Optional child present), mask 0x04: 0=FALSE (roadWorks__FALSE) (Bit 2: Optional child present), mask 0x04: 4=TRUE (roadWorks) (Bit 2: Optional child present), mask 0x02: 0=FALSE (positioningSolution__FALSE) (Bit 1: Optional child present), mask 0x02: 2=TRUE (positioningSolution) (Bit 1: Optional child present), mask 0x01: 0=FALSE (stationaryVehicle__FALSE) (Bit 0 (LSB): Optional child present), mask 0x01: 1=TRUE (stationaryVehicle) (Bit 0 (LSB): Optional child present)}
      range raw 0x00..0x3F
      implementation-data-type=uint8
    V2xFac_AlacarteContainerType: category=STRUCTURE
      7 x element, all with category=TYPE_REFERENCE:
        presence: implementation-data-type=V2xFac_AlacarteContainerPresenceType
        lanePosition: implementation-data-type=sint8
        impactReduction: implementation-data-type=V2xFac_ImpactReductionContainerType
        externalTemperature: implementation-data-type=sint8
        roadWorks: implementation-data-type=V2xFac_RoadWorksContainerExtendedType
        positioningSolution: implementation-data-type=V2xFac_PositioningSolutionTypeType
        stationaryVehicle: implementation-data-type=V2xFac_StationaryVehicleContainerType
    V2xFac_AllowedManeuversType:
      compu {mask 0x01: 0=FALSE (maneuverStraightAllowed__FALSE) (--), mask 0x01: 1=TRUE (maneuverStraightAllowed) (--), mask 0x02: 0=FALSE (maneuverLeftAllowed__FALSE) (--), mask 0x02: 2=TRUE (maneuverLeftAllowed) (--), mask 0x04: 0=FALSE (maneuverRightAllowed__FALSE) (--), mask 0x04: 4=TRUE (maneuverRightAllowed) (--), mask 0x08: 0=FALSE (maneuverUTurnAllowed__FALSE) (--), mask 0x08: 8=TRUE (maneuverUTurnAllowed) (--), mask 0x10: 0=FALSE (maneuverLeftTurnOnRedAllowed__FALSE) (--), mask 0x10: 16=TRUE (maneuverLeftTurnOnRedAllowed) (--), mask 0x20: 0=FALSE (maneuverRightTurnOnRedAllowed__FALSE) (--), mask 0x20: 32=TRUE (maneuverRightTurnOnRedAllowed) (--), mask 0x40: 0=FALSE (maneuverLaneChangeAllowed__FALSE) (--), mask 0x40: 64=TRUE (maneuverLaneChangeAllowed) (--), mask 0x80: 0=FALSE (maneuverNoStoppingAllowed__FALSE) (--), mask 0x80: 128=TRUE (maneuverNoStoppingAllowed) (--), mask 0x100: 0=FALSE (yieldAllwaysRequired__FALSE) (--), mask 0x100: 256=TRUE (yieldAllwaysRequired) (--), mask 0x200: 0=FALSE (goWithHalt__FALSE) (--), mask 0x200: 512=TRUE (goWithHalt) (--), mask 0x400: 0=FALSE (caution__FALSE) (--), mask 0x400: 1024=TRUE (caution) (--), mask 0x800: 0=FALSE (reserved1__FALSE) (--), mask 0x800: 2048=TRUE (reserved1) (--)}
      data-constr=V2xFac_AllowedManeuversType
      implementation-data-type=uint8
    V2xFac_AltitudeConfidenceType:
      compu {0x00=V2XFAC_ALTITUDECONFIDENCE_ALT_000_01, 0x01=V2XFAC_ALTITUDECONFIDENCE_ALT_000_02, 0x02=V2XFAC_ALTITUDECONFIDENCE_ALT_000_05, 0x03=V2XFAC_ALTITUDECONFIDENCE_ALT_000_10, 0x04=V2XFAC_ALTITUDECONFIDENCE_ALT_000_20, 0x05=V2XFAC_ALTITUDECONFIDENCE_ALT_000_50, 0x06=V2XFAC_ALTITUDECONFIDENCE_ALT_001_00, 0x07=V2XFAC_ALTITUDECONFIDENCE_ALT_002_00, 0x08=V2XFAC_ALTITUDECONFIDENCE_ALT_005_00, 0x09=V2XFAC_ALTITUDECONFIDENCE_ALT_010_00, 0x0a=V2XFAC_ALTITUDECONFIDENCE_ALT_020_00, 0x0b=V2XFAC_ALTITUDECONFIDENCE_ALT_050_00, 0x0c=V2XFAC_ALTITUDECONFIDENCE_ALT_100_00, 0x0d=V2XFAC_ALTITUDECONFIDENCE_ALT_200_00, 0x0e=V2XFAC_ALTITUDECONFIDENCE_ALT_OUTOFRANGE, 0x0f=V2XFAC_ALTITUDECONFIDENCE_ALT_UNAVAILABLE}
      range raw 0x00..0x0f
      implementation-data-type=uint8
    V2xFac_AltitudeType: category=STRUCTURE
      element altitudeValue: implementation-data-type=sint32
      element altitudeConfidence: implementation-data-type=V2xFac_AltitudeConfidenceType
    V2xFac_AltitudeValueType: compu {0=referenceEllipsoidSurface, 1=oneCentimeter, 800001=unavailable}, range raw undefined, implementation-data-type=sint32
    V2xFac_AngleType: range raw undefined, implementation-data-type=uint16
    V2xFac_AnyCataloguePresenceType:
      compu {mask 0x01: 0=FALSE (value__FALSE) (Bit 0 (LSB): Optional child present), mask 0x01: 1=TRUE (value) (Bit 0 (LSB): Optional child present), mask 0x02: 0=FALSE (unit__FALSE) (Bit 1: Optional child present), mask 0x02: 2=TRUE (unit) (Bit 1: Optional child present), mask 0x04: 0=FALSE (attributes__FALSE) (Bit 2: Optional child present), mask 0x04: 4=TRUE (attributes) (Bit 2: Optional child present)}
      data-constr=V2xFac_AnyCataloguePresenceType
      implementation-data-type=uint8
    V2xFac_AnyCatalogueType: category=STRUCTURE
      7 x element, all with category=TYPE_REFERENCE:
        owner: implementation-data-type=V2xFac_ProviderType
        version: implementation-data-type=uint8
        pictogramCode: implementation-data-type=uint16
        value: implementation-data-type=uint16
        unit: implementation-data-type=V2xFac_RSCUnitType
        attributes: implementation-data-type=V2xFac_ISO14823AttributesType
        presence: implementation-data-type=V2xFac_AnyCataloguePresenceType
    V2xFac_ApproachIDType: range raw undefined, implementation-data-type=uint8
    V2xFac_AxleWeightLimitsType: category=STRUCTURE
      5 x element, all with category=TYPE_REFERENCE, implementation-data-type=V2xFac_Int2Type:
        maxLadenweightOnAxle{1..5}
    V2xFac_BasicContainerType: category=STRUCTURE
      element stationType: implementation-data-type=uint8
      element referencePosition: implementation-data-type=V2xFac_ReferencePositionType
    V2xFac_BasicVehicleContainerHighFrequencyPresenceType:
      compu {mask 0x40: 0=FALSE (accelerationControl__FALSE) (Bit 6: Optional child present), mask 0x40: 64=TRUE (accelerationControl) (Bit 6: Optional child present), mask 0x20: 0=FALSE (lanePosition__FALSE) (Bit 5: Optional child present), mask 0x20: 32=TRUE (lanePosition) (Bit 5: Optional child present), mask 0x10: 0=FALSE (steeringWheelAngle__FALSE) (Bit 4: Optional child present), mask 0x10: 16=TRUE (steeringWheelAngle) (Bit 4: Optional child present), mask 0x08: 0=FALSE (lateralAcceleration__FALSE) (Bit 3: Optional child present), mask 0x08: 8=TRUE (lateralAcceleration) (Bit 3: Optional child present), mask 0x04: 0=FALSE (verticalAcceleration__FALSE) (Bit 2: Optional child present), mask 0x04: 4=TRUE (verticalAcceleration) (Bit 2: Optional child present), mask 0x02: 0=FALSE (performanceClass__FALSE) (Bit 1: Optional child present), mask 0x02: 2=TRUE (performanceClass) (Bit 1: Optional child present), mask 0x01: 0=FALSE (cenDsrcTollingZone__FALSE) (Bit 0 (LSB): Optional child present), mask 0x01: 1=TRUE (cenDsrcTollingZone) (Bit 0 (LSB): Optional child present)}
      range raw 0x00..0x7F
      implementation-data-type=uint8
    V2xFac_BasicVehicleContainerHighFrequencyType: category=STRUCTURE
      17 x element, all with category=TYPE_REFERENCE:
        presence: implementation-data-type=V2xFac_BasicVehicleContainerHighFrequencyPresenceType
        heading: implementation-data-type=V2xFac_HeadingType
        speed: implementation-data-type=V2xFac_SpeedType
        driveDirection: implementation-data-type=V2xFac_DriveDirectionType
        vehicleLength: implementation-data-type=V2xFac_VehicleLengthType
        vehicleWidth: implementation-data-type=uint8
        longitudinalAcceleration: implementation-data-type=V2xFac_LongitudinalAccelerationType
        curvature: implementation-data-type=V2xFac_CurvatureType
        curvatureCalculationMode: implementation-data-type=V2xFac_CurvatureCalculationModeType
        yawRate: implementation-data-type=V2xFac_YawRateType
        accelerationControl: implementation-data-type=V2xFac_AccelerationControlType
        lanePosition: implementation-data-type=sint8
        steeringWheelAngle: implementation-data-type=V2xFac_SteeringWheelAngleType
        lateralAcceleration: implementation-data-type=V2xFac_LateralAccelerationType
        verticalAcceleration: implementation-data-type=V2xFac_VerticalAccelerationType
        performanceClass: implementation-data-type=uint8
        cenDsrcTollingZone: implementation-data-type=V2xFac_CenDsrcTollingZoneType
    V2xFac_BasicVehicleContainerLowFrequencyType: category=STRUCTURE
      element vehicleRole: implementation-data-type=V2xFac_VehicleRoleType
      element exteriorLights: implementation-data-type=V2xFac_ExteriorLightsType
      element pathHistory: implementation-data-type=V2xFac_PathHistoryType
    V2xFac_CS5Type: range raw undefined, implementation-data-type=V2xFac_StringType
    V2xFac_CamMessageRootType: category=STRUCTURE
      element itsPduHeader: implementation-data-type=V2xFac_ItsPduHeaderType
      element coopAwareness: implementation-data-type=V2xFac_CoopAwarenessType
      element transactionId: implementation-data-type=uint32
    V2xFac_CamParametersPresenceType: compu {mask 0x02: 0=FALSE (lowFrequencyContainer__FALSE) (Bit 1: Optional child present), mask 0x02: 2=TRUE (lowFrequencyContainer) (Bit 1: Optional child present), mask 0x01: 0=FALSE (specialVehicleContainer__FALSE) (Bit 0 (LSB): Optional child present), mask 0x01: 1=TRUE (specialVehicleContainer) (Bit 0 (LSB): Optional child present)}, range raw 0x00..0x03, implementation-data-type=uint8
    V2xFac_CamParametersType: category=STRUCTURE
      5 x element, all with category=TYPE_REFERENCE:
        presence: implementation-data-type=V2xFac_CamParametersPresenceType
        basicContainer: implementation-data-type=V2xFac_BasicContainerType
        highFrequencyContainer: implementation-data-type=V2xFac_HighFrequencyContainerType
        lowFrequencyContainer: implementation-data-type=V2xFac_LowFrequencyContainerType
        specialVehicleContainer: implementation-data-type=V2xFac_SpecialVehicleContainerType
    V2xFac_CauseCodeType: category=STRUCTURE
      element causeCode: implementation-data-type=uint8
      element subCauseCode: implementation-data-type=uint8
    V2xFac_CauseCodeTypeType:
      compu {0=reserved, 1=trafficCondition, 2=accident, 3=roadworks, 6=adverseWeatherCondition_Adhesion, 9=hazardousLocation_SurfaceCondition, 10=hazardousLocation_ObstacleOnTheRoad, 11=hazardousLocation_AnimalOnTheRoad, 12=humanPresenceOnTheRoad, 14=wrongWayDriving, 15=rescueAndRecoveryWorkInProgress, 17=adverseWeatherCondition_ExtremeWeatherCondition, 18=adverseWeatherCondition_Visibility, 19=adverseWeatherCondition_Precipitation, 26=slowVehicle, 27=dangerousEndOfQueue, 91=vehicleBreakdown, 92=postCrash, 93=humanProblem, 94=stationaryVehicle, 95=emergencyVehicleApproaching, 96=hazardousLocation_DangerousCurve, 97=collisionRisk, 98=signalViolation, 99=dangerousSituation}
      range raw undefined
      implementation-data-type=uint8
    V2xFac_CenDsrcTollingZoneIDType: range raw undefined, implementation-data-type=V2xFac_ProtectedZoneIDType
    V2xFac_CenDsrcTollingZonePresenceType: compu {mask 0x01: 0=FALSE (cenDsrcTollingZoneID__FALSE) (Bit 0 (LSB): Optional child present), mask 0x01: 1=TRUE (cenDsrcTollingZoneID) (Bit 0 (LSB): Optional child present)}, range raw 0x00..0x01, implementation-data-type=uint8
    V2xFac_CenDsrcTollingZoneType: category=STRUCTURE
      4 x element, all with category=TYPE_REFERENCE:
        presence: implementation-data-type=V2xFac_CenDsrcTollingZonePresenceType
        protectedZoneLatitude: implementation-data-type=sint32
        protectedZoneLongitude: implementation-data-type=sint32
        cenDsrcTollingZoneID: implementation-data-type=sint32
    V2xFac_ClosedLanesPresenceType: compu {mask 0x01: 0=FALSE (hardShoulderStatus__FALSE) (Bit 0 (LSB): Optional child present), mask 0x01: 1=TRUE (hardShoulderStatus) (Bit 0 (LSB): Optional child present)}, range raw 0x00..0x01, implementation-data-type=uint8
    V2xFac_ClosedLanesType: category=STRUCTURE
      element presence: implementation-data-type=V2xFac_ClosedLanesPresenceType
      element hardShoulderStatus: implementation-data-type=V2xFac_HardShoulderStatusType
      element drivingLaneStatus: implementation-data-type=V2xFac_DrivingLaneStatusType
    V2xFac_CollisionRiskSubCauseCodeType: compu {0=unavailable, 1=longitudinalCollisionRisk, 2=crossingCollisionRisk, 3=lateralCollisionRisk, 4=vulnerableRoadUser}, range raw undefined, implementation-data-type=uint8
    V2xFac_CompanyNameType: category=STRUCTURE
      element count: implementation-data-type=uint8
      element values: category=ARRAY, array-size-semantics=FIXED-SIZE
        element values: array-size=undefined, array-size-semantics=FIXED-SIZE, implementation-data-type=uint8
    V2xFac_ComparisonOperatorType: compu {0=greaterThan, 1=greaterThanOrEqualTo, 2=lessThan, 3=lessThanOrEqualTo}, range raw undefined, implementation-data-type=uint8
    V2xFac_CompleteVehicleCharacteristicsPresenceType:
      compu {mask 0x01: 0=FALSE (tractor__FALSE) (Bit 0 (LSB): Optional child present), mask 0x01: 1=TRUE (tractor) (Bit 0 (LSB): Optional child present), mask 0x02: 0=FALSE (trailer__FALSE) (Bit 1: Optional child present), mask 0x02: 2=TRUE (trailer) (Bit 1: Optional child present), mask 0x04: 0=FALSE (train__FALSE) (Bit 2: Optional child present), mask 0x04: 4=TRUE (train) (Bit 2: Optional child present)}
      data-constr=V2xFac_CompleteVehicleCharacteristicsPresenceType
      implementation-data-type=uint8
    V2xFac_CompleteVehicleCharacteristicsType: category=STRUCTURE
      4 x element, all with category=TYPE_REFERENCE:
        tractor: implementation-data-type=V2xFac_TractorCharacteristicsType
        trailer: implementation-data-type=V2xFac_trailer34Type
        train: implementation-data-type=V2xFac_TrainCharacteristicsType
        presence: implementation-data-type=V2xFac_CompleteVehicleCharacteristicsPresenceType
    V2xFac_ComputedLanePresenceType:
      compu {mask 0x01: 0=FALSE (rotateXY__FALSE) (Bit 0 (LSB): Optional child present), mask 0x01: 1=TRUE (rotateXY) (Bit 0 (LSB): Optional child present), mask 0x02: 0=FALSE (scaleXaxis__FALSE) (Bit 1: Optional child present), mask 0x02: 2=TRUE (scaleXaxis) (Bit 1: Optional child present), mask 0x04: 0=FALSE (scaleYaxis__FALSE) (Bit 2: Optional child present), mask 0x04: 4=TRUE (scaleYaxis) (Bit 2: Optional child present)}
      data-constr=V2xFac_ComputedLanePresenceType
      implementation-data-type=uint8
    V2xFac_ComputedLaneType: category=STRUCTURE
      7 x element, all with category=TYPE_REFERENCE:
        referenceLaneId: implementation-data-type=V2xFac_LaneIDType
        offsetXaxis: implementation-data-type=V2xFac_offsetXaxis106Type
        offsetYaxis: implementation-data-type=V2xFac_offsetYaxis107Type
        rotateXY: implementation-data-type=V2xFac_AngleType
        scaleXaxis: implementation-data-type=V2xFac_Scale_B12Type
        scaleYaxis: implementation-data-type=V2xFac_Scale_B12Type
        presence: implementation-data-type=V2xFac_ComputedLanePresenceType
    V2xFac_ComputedSegmentPresenceType: compu {mask 0x01: 0=FALSE (offsetDistance__FALSE) (Bit 0 (LSB): Optional child present), mask 0x01: 1=TRUE (offsetDistance) (Bit 0 (LSB): Optional child present)}, data-constr=V2xFac_ComputedSegmentPresenceType, implementation-data-type=uint8
    V2xFac_ComputedSegmentType: category=STRUCTURE
      6 x element, all with category=TYPE_REFERENCE:
        zoneId: implementation-data-type=V2xFac_ZidType
        laneNumber: implementation-data-type=V2xFac_LanePositionType
        laneWidth: implementation-data-type=V2xFac_LaneWidthType
        offsetDistance: implementation-data-type=sint16
        offsetPosition: implementation-data-type=V2xFac_DeltaReferencePositionType
        presence: implementation-data-type=V2xFac_ComputedSegmentPresenceType
    V2xFac_ConnectingLanePresenceType: compu {mask 0x01: 0=FALSE (maneuver__FALSE) (Bit 0 (LSB): Optional child present), mask 0x01: 1=TRUE (maneuver) (Bit 0 (LSB): Optional child present)}, data-constr=V2xFac_ConnectingLanePresenceType, implementation-data-type=uint8
    V2xFac_ConnectingLaneType: category=STRUCTURE
      element lane: implementation-data-type=V2xFac_LaneIDType
      element maneuver: implementation-data-type=V2xFac_AllowedManeuversType
      element presence: implementation-data-type=V2xFac_ConnectingLanePresenceType
    V2xFac_ConnectionManeuverAssistPresenceType:
      compu {mask 0x01: 0=FALSE (queueLength__FALSE) (Bit 0 (LSB): Optional child present), mask 0x01: 1=TRUE (queueLength) (Bit 0 (LSB): Optional child present), mask 0x02: 0=FALSE (availableStorageLength__FALSE) (Bit 1: Optional child present), mask 0x02: 2=TRUE (availableStorageLength) (Bit 1: Optional child present), mask 0x04: 0=FALSE (waitOnStop__FALSE) (Bit 2: Optional child present), mask 0x04: 4=TRUE (waitOnStop) (Bit 2: Optional child present), mask 0x08: 0=FALSE (pedBicycleDetect__FALSE) (Bit 3: Optional child present), mask 0x08: 8=TRUE (pedBicycleDetect) (Bit 3: Optional child present)}
      data-constr=V2xFac_ConnectionManeuverAssistPresenceType
      implementation-data-type=uint8
    V2xFac_ConnectionManeuverAssistType: category=STRUCTURE
      6 x element, all with category=TYPE_REFERENCE:
        connectionID: implementation-data-type=V2xFac_LaneConnectionIDType
        queueLength: implementation-data-type=V2xFac_ZoneLengthType
        availableStorageLength: implementation-data-type=V2xFac_ZoneLengthType
        waitOnStop: implementation-data-type=V2xFac_WaitOnStoplineType
        pedBicycleDetect: implementation-data-type=V2xFac_PedestrianBicycleDetectType
        presence: implementation-data-type=V2xFac_ConnectionManeuverAssistPresenceType
    V2xFac_ConnectionPresenceType:
      compu {mask 0x01: 0=FALSE (remoteIntersection__FALSE) (Bit 0 (LSB): Optional child present), mask 0x01: 1=TRUE (remoteIntersection) (Bit 0 (LSB): Optional child present), mask 0x02: 0=FALSE (signalGroup__FALSE) (Bit 1: Optional child present), mask 0x02: 2=TRUE (signalGroup) (Bit 1: Optional child present), mask 0x04: 0=FALSE (userClass__FALSE) (Bit 2: Optional child present), mask 0x04: 4=TRUE (userClass) (Bit 2: Optional child present), mask 0x08: 0=FALSE (connectionID__FALSE) (Bit 3: Optional child present), mask 0x08: 8=TRUE (connectionID) (Bit 3: Optional child present)}
      data-constr=V2xFac_ConnectionPresenceType
      implementation-data-type=uint8
    V2xFac_ConnectionType: category=STRUCTURE
      6 x element, all with category=TYPE_REFERENCE:
        connectingLane: implementation-data-type=V2xFac_ConnectingLaneType
        remoteIntersection: implementation-data-type=V2xFac_IntersectionReferenceIDType
        signalGroup: implementation-data-type=V2xFac_SignalGroupIDType
        userClass: implementation-data-type=V2xFac_RestrictionClassIDType
        connectionID: implementation-data-type=V2xFac_LaneConnectionIDType
        presence: implementation-data-type=V2xFac_ConnectionPresenceType
    V2xFac_ConnectsToListType: category=STRUCTURE
      element count: implementation-data-type=uint8
      element values: category=ARRAY, array-size-semantics=FIXED-SIZE
        element values: array-size=undefined, array-size-semantics=FIXED-SIZE, implementation-data-type=V2xFac_ConnectionType
    V2xFac_CoopAwarenessType: category=STRUCTURE
      element generationDeltaTime: implementation-data-type=uint16
      element camParameters: implementation-data-type=V2xFac_CamParametersType
    V2xFac_CopValueType: compu {0=noEntry, 1..7=co2class1..co2class7, 8=reservedforUse}, range raw 0..8
    V2xFac_CountryCodeType: compu {bitfield_texttable}, data-constr=V2xFac_CountryCodeType, implementation-data-type=uint8
    V2xFac_CurvartureConfidenceType:
      compu {0x00=V2XFAC_CURVATURECONFIDENCE_ONE_PER_METER_0_00002, 0x01=V2XFAC_CURVATURECONFIDENCE_ONE_PER_METER_0_0001, 0x02=V2XFAC_CURVATURECONFIDENCE_ONE_PER_METER_0_0005, 0x03=V2XFAC_CURVATURECONFIDENCE_ONE_PER_METER_0_002, 0x04=V2XFAC_CURVATURECONFIDENCE_ONE_PER_METER_0_01, 0x05=V2XFAC_CURVATURECONFIDENCE_ONE_PER_METER_0_1, 0x06=V2XFAC_CURVATURECONFIDENCE_OUT_OF_RANGE, 0x07=V2XFAC_CURVATURECONFIDENCE_UNAVAILABLE}
      range raw 0x00..0x07
      implementation-data-type=uint8
    V2xFac_CurvatureCalculationModeType: compu {0x00=V2XFAC_CURVATURECALCMODE_YAWRATE_USED, 0x01=V2XFAC_CURVATURECALCMODE_YAWRATE_NOT_USED, 0x02=V2XFAC_CURVATURECALCMODE_UNAVAILABLE}, range raw 0x00..0x02, implementation-data-type=uint8
    V2xFac_CurvatureConfidenceType: compu {0=onePerMeter_0_00002, 1=onePerMeter_0_0001, 2=onePerMeter_0_0005, 3=onePerMeter_0_002, 4=onePerMeter_0_01, 5=onePerMeter_0_1, 6=outOfRange, 7=unavailable}, range raw 0..7
    V2xFac_CurvatureType: category=STRUCTURE
      element curvatureValue: implementation-data-type=sint16
      element curvatureConfidence: implementation-data-type=V2xFac_CurvartureConfidenceType
    V2xFac_CurvatureValueType: compu {0=straight, -30000=reciprocalOf1MeterRadiusToRight, 30000=reciprocalOf1MeterRadiusToLeft, 30001=unavailable}, range raw undefined, implementation-data-type=sint16
    V2xFac_DBVType: category=STRUCTURE
      element value: implementation-data-type=uint16
      element unit: implementation-data-type=V2xFac_RSCUnitType
    V2xFac_DDDPresenceType:
      compu {mask 0x01: 0=FALSE (dcj__FALSE) (Bit 0 (LSB): Optional child present), mask 0x01: 1=TRUE (dcj) (Bit 0 (LSB): Optional child present), mask 0x02: 0=FALSE (der__FALSE) (Bit 1: Optional child present), mask 0x02: 2=TRUE (der) (Bit 1: Optional child present), mask 0x04: 0=FALSE (tpl__FALSE) (Bit 2: Optional child present), mask 0x04: 4=TRUE (tpl) (Bit 2: Optional child present)}
      data-constr=V2xFac_DDDPresenceType
      implementation-data-type=uint8
    V2xFac_DDDType: category=STRUCTURE
      5 x element, all with category=TYPE_REFERENCE:
        dcj: implementation-data-type=uint8
        der: implementation-data-type=uint8
        tpl: implementation-data-type=uint8
        ioList: implementation-data-type=V2xFac_ioList94Type
        presence: implementation-data-type=V2xFac_DDDPresenceType
    V2xFac_DDD_DEPType: compu {0=none, 1=importantArea, 2=principalArea, 3=generalArea, 4=wellKnownPoint, 5=country, 6=city, 7=street, 8=industrialArea, 9=historicArea, 10=touristicArea, 11=culturalArea, 12=touristicRoute, 13=recommendedRoute, 14=touristicAttraction, 15=geographicArea}, range raw undefined, implementation-data-type=uint8
    V2xFac_DDD_DERType: compu {0=none, 1=nationalHighway, 2=localHighway, 3=tollExpresswayMotorway, 4=internationalHighway, 5=highway, 6=expressway, 7=nationalRoad, 8=regionalProvincialRoad, 9=localRoad, 10=motorwayJunction, 11=diversion, 12..15=rfu1..rfu4}, range raw undefined, implementation-data-type=uint8
    V2xFac_DDD_IOPresenceType:
      compu {mask 0x01: 0=FALSE (dp__FALSE) (Bit 0 (LSB): Optional child present), mask 0x01: 1=TRUE (dp) (Bit 0 (LSB): Optional child present), mask 0x02: 0=FALSE (dr__FALSE) (Bit 1: Optional child present), mask 0x02: 2=TRUE (dr) (Bit 1: Optional child present), mask 0x04: 0=FALSE (rne__FALSE) (Bit 2: Optional child present), mask 0x04: 4=TRUE (rne) (Bit 2: Optional child present), mask 0x08: 0=FALSE (stnId__FALSE) (Bit 3: Optional child present), mask 0x08: 8=TRUE (stnId) (Bit 3: Optional child present), mask 0x10: 0=FALSE (stnText__FALSE) (Bit 4: Optional child present), mask 0x10: 16=TRUE (stnText) (Bit 4: Optional child present), mask 0x20: 0=FALSE (dcp__FALSE) (Bit 5: Optional child present), mask 0x20: 32=TRUE (dcp) (Bit 5: Optional child present), mask 0x40: 0=FALSE (ddp__FALSE) (Bit 6: Optional child present), mask 0x40: 64=TRUE (ddp) (Bit 6: Optional child present)}
      data-constr=V2xFac_DDD_IOPresenceType
      implementation-data-type=uint8
    V2xFac_DDD_IOType: category=STRUCTURE
      9 x element, all with category=TYPE_REFERENCE:
        drn: implementation-data-type=uint8
        dp: implementation-data-type=V2xFac_dp96Type
        dr: implementation-data-type=V2xFac_dr97Type
        rne: implementation-data-type=uint16
        stnId: implementation-data-type=uint16
        stnText: implementation-data-type=V2xFac_StringType
        dcp: implementation-data-type=V2xFac_DistanceOrDurationType
        ddp: implementation-data-type=V2xFac_DistanceOrDurationType
        presence: implementation-data-type=V2xFac_DDD_IOPresenceType
    V2xFac_DFLType: compu {1=sDL, 2=sLT, 3=sRT, 4=lTO, 5=rTO, 6=cLL, 7=eRI, 8=oVL}, range raw undefined, implementation-data-type=uint8
    V2xFac_DSecondType: range raw undefined, implementation-data-type=uint16
    V2xFac_DTMPresenceType:
      compu {mask 0x01: 0=FALSE (hourMinutes__FALSE) (Bit 0 (LSB): Optional child present), mask 0x01: 1=TRUE (hourMinutes) (Bit 0 (LSB): Optional child present), mask 0x02: 0=FALSE (dayOfWeek__FALSE) (Bit 1: Optional child present), mask 0x02: 2=TRUE (dayOfWeek) (Bit 1: Optional child present), mask 0x04: 0=FALSE (period__FALSE) (Bit 2: Optional child present), mask 0x04: 4=TRUE (period) (Bit 2: Optional child present)}
      data-constr=V2xFac_DTMPresenceType
      implementation-data-type=uint8
    V2xFac_DTMType: category=STRUCTURE
      7 x element, all with category=TYPE_REFERENCE:
        year: implementation-data-type=V2xFac_year80Type
        month_day: implementation-data-type=V2xFac_month_day83Type
        pmd: implementation-data-type=V2xFac_PMDType
        hourMinutes: implementation-data-type=V2xFac_hourMinutes84Type
        dayOfWeek: implementation-data-type=V2xFac_DayOfWeekType
        period: implementation-data-type=V2xFac_HoursMinutesType
        presence: implementation-data-type=V2xFac_DTMPresenceType
    V2xFac_DangerousEndOfQueueSubCauseCodeType: compu {0=unavailable, 1=suddenEndOfQueue, 2=queueOverHill, 3=queueAroundBend, 4=queueInTunnel}, range raw undefined, implementation-data-type=uint8
    V2xFac_DangerousGoodsBasicType:
      compu {0x00=V2XFAC_DANGEROUSGOODSBASIC_EXPLOSIVES_1, 0x01=V2XFAC_DANGEROUSGOODSBASIC_EXPLOSIVES_2, 0x02=V2XFAC_DANGEROUSGOODSBASIC_EXPLOSIVES_3, 0x03=V2XFAC_DANGEROUSGOODSBASIC_EXPLOSIVES_4, 0x04=V2XFAC_DANGEROUSGOODSBASIC_EXPLOSIVES_5, 0x05=V2XFAC_DANGEROUSGOODSBASIC_EXPLOSIVES_6, 0x06=V2XFAC_DANGEROUSGOODSBASIC_FLAMMABLE_GASES, 0x07=V2XFAC_DANGEROUSGOODSBASIC_NON_FLAMMABLE_GASES, 0x08=V2XFAC_DANGEROUSGOODSBASIC_TOXIC_GASES, 0x09=V2XFAC_DANGEROUSGOODSBASIC_FLAMMABLE_LIQUIDS, 0x0a=V2XFAC_DANGEROUSGOODSBASIC_FLAMMABLE_SOLIDS, 0x0b=V2XFAC_DANGEROUSGOODSBASIC_SUBSTANCES_LIBLE_TO_SPONTANEOUS_COMBUSTION, 0x0c=V2XFAC_DANGEROUSGOODSBASIC_SUBSTANCES_EMITTING_FLAMMABLE_GASES_UPON_CONTACT_WITH_WATER, 0x0d=V2XFAC_DANGEROUSGOODSBASIC_OXIDIZING_SUBSTANCES, 0x0e=V2XFAC_DANGEROUSGOODSBASIC_ORGANIC_PEROXIDES, 0x0f=V2XFAC_DANGEROUSGOODSBASIC_TOXIC_SUBSTANCES, 0x10=V2XFAC_DANGEROUSGOODSBASIC_INFECTIOUS_SUBSTANCES, 0x11=V2XFAC_DANGEROUSGOODSBASIC_RADIOACTIVE_MATERIAL, 0x12=V2XFAC_DANGEROUSGOODSBASIC_CORROSIVE_SUBSTANCES, 0x13=V2XFAC_DANGEROUSGOODSBASIC_MISCELLANEOUS_DANGEROUS_SUBSTANCES}
      range raw 0x00..0x13
      implementation-data-type=uint8
    V2xFac_DangerousGoodsContainerType: category=STRUCTURE
      element dangerousGoodsBasic: implementation-data-type=V2xFac_DangerousGoodsBasicType
    V2xFac_DangerousGoodsExtendedPresenceType:
      compu {mask 0x04: 0=FALSE (emergencyActionCode__FALSE) (Bit 2: Optional child present), mask 0x04: 4=TRUE (emergencyActionCode) (Bit 2: Optional child present), mask 0x02: 0=FALSE (phoneNumber__FALSE) (Bit 1: Optional child present), mask 0x02: 2=TRUE (phoneNumber) (Bit 1: Optional child present), mask 0x01: 0=FALSE (companyName__FALSE) (Bit 0 (LSB): Optional child present), mask 0x01: 1=TRUE (companyName) (Bit 0 (LSB): Optional child present)}
      range raw 0x00..0x07
      implementation-data-type=uint8
    V2xFac_DangerousGoodsExtendedType: category=STRUCTURE
      9 x element, all with category=TYPE_REFERENCE:
        presence: implementation-data-type=V2xFac_DangerousGoodsExtendedPresenceType
        dangerousGoodsType: implementation-data-type=V2xFac_DangerousGoodsBasicType
        unNumber: implementation-data-type=uint16
        elevatedTemperature: implementation-data-type=boolean
        tunnelsRestricted: implementation-data-type=boolean
        limitedQuantity: implementation-data-type=boolean
        emergencyActionCode: implementation-data-type=V2xFac_EmergencyActionCodeType
        phoneNumber: implementation-data-type=V2xFac_PhoneNumberType
        companyName: implementation-data-type=V2xFac_CompanyNameType
    V2xFac_DangerousSituationSubCauseCodeType: compu {0=unavailable, 1=emergencyElectronicBrakeEngaged, 2=preCrashSystemEngaged, 3=espEngaged, 4=absEngaged, 5=aebEngaged, 6=brakeWarningEngaged, 7=collisionRiskWarningEngaged}, range raw undefined, implementation-data-type=uint8
    V2xFac_DataParametersPresenceType:
      compu {mask 0x01: 0=FALSE (processMethod__FALSE) (Bit 0 (LSB): Optional child present), mask 0x01: 1=TRUE (processMethod) (Bit 0 (LSB): Optional child present), mask 0x02: 0=FALSE (processAgency__FALSE) (Bit 1: Optional child present), mask 0x02: 2=TRUE (processAgency) (Bit 1: Optional child present), mask 0x04: 0=FALSE (lastCheckedDate__FALSE) (Bit 2: Optional child present), mask 0x04: 4=TRUE (lastCheckedDate) (Bit 2: Optional child present), mask 0x08: 0=FALSE (geoidUsed__FALSE) (Bit 3: Optional child present), mask 0x08: 8=TRUE (geoidUsed) (Bit 3: Optional child present)}
      data-constr=V2xFac_DataParametersPresenceType
      implementation-data-type=uint8
    V2xFac_DataParametersType: category=STRUCTURE
      5 x element, all with category=TYPE_REFERENCE:
        processMethod: implementation-data-type=V2xFac_processMethod108Type
        processAgency: implementation-data-type=V2xFac_processAgency109Type
        lastCheckedDate: implementation-data-type=V2xFac_lastCheckedDate110Type
        geoidUsed: implementation-data-type=V2xFac_geoidUsed111Type
        presence: implementation-data-type=V2xFac_DataParametersPresenceType
    V2xFac_DayOfWeekType:
      compu {mask 0x01: 0=FALSE (unused__FALSE) (--), mask 0x01: 1=TRUE (unused) (--), mask 0x02: 0=FALSE (monday__FALSE) (--), mask 0x02: 2=TRUE (monday) (--), mask 0x04: 0=FALSE (tuesday__FALSE) (--), mask 0x04: 4=TRUE (tuesday) (--), mask 0x08: 0=FALSE (wednesday__FALSE) (--), mask 0x08: 8=TRUE (wednesday) (--), mask 0x10: 0=FALSE (thursday__FALSE) (--), mask 0x10: 16=TRUE (thursday) (--), mask 0x20: 0=FALSE (friday__FALSE) (--), mask 0x20: 32=TRUE (friday) (--), mask 0x40: 0=FALSE (saturday__FALSE) (--), mask 0x40: 64=TRUE (saturday) (--), mask 0x80: 0=FALSE (sunday__FALSE) (--), mask 0x80: 128=TRUE (sunday) (--)}
      data-constr=V2xFac_DayOfWeekType
      implementation-data-type=uint8
    V2xFac_DeltaAltitudeType: compu {1=oneCentimeterUp, -1=oneCentimeterDown, 12800=unavailable}, range raw undefined, implementation-data-type=sint16
    V2xFac_DeltaAngleType: range raw undefined, implementation-data-type=sint16
    V2xFac_DeltaLatitudeType: compu {10=oneMicrodegreeNorth, -10=oneMicrodegreeSouth, 131072=unavailable}, range raw undefined, implementation-data-type=sint32
    V2xFac_DeltaLongitudeType: compu {10=oneMicrodegreeEast, -10=oneMicrodegreeWest, 131072=unavailable}, range raw undefined, implementation-data-type=sint32
    V2xFac_DeltaPositionType: category=STRUCTURE
      element deltaLatitude: implementation-data-type=V2xFac_DeltaLatitudeType
      element deltaLongitude: implementation-data-type=V2xFac_DeltaLongitudeType
    V2xFac_DeltaReferencePositionType: category=STRUCTURE
      element deltaLatitude: implementation-data-type=sint32
      element deltaLongitude: implementation-data-type=sint32
      element deltaAltitude: implementation-data-type=sint16
    V2xFac_DenMsgPresenceType:
      compu {mask 0x04: 0=FALSE (situation__FALSE) (Bit 2: Optional child present), mask 0x04: 4=TRUE (situation) (Bit 2: Optional child present), mask 0x02: 0=FALSE (location__FALSE) (Bit 1: Optional child present), mask 0x02: 2=TRUE (location) (Bit 1: Optional child present), mask 0x01: 0=FALSE (alacarte__FALSE) (Bit 0 (LSB): Optional child present), mask 0x01: 1=TRUE (alacarte) (Bit 0 (LSB): Optional child present)}
      range raw 0x00..0x07
      implementation-data-type=uint8
    V2xFac_DenMsgType: category=STRUCTURE
      5 x element, all with category=TYPE_REFERENCE:
        presence: implementation-data-type=V2xFac_DenMsgPresenceType
        management: implementation-data-type=V2xFac_ManagementContainerType
        situation: implementation-data-type=V2xFac_SituationContainerType
        location: implementation-data-type=V2xFac_LocationContainerType
        alacarte: implementation-data-type=V2xFac_AlacarteContainerType
    V2xFac_DenmMessageRootType: category=STRUCTURE
      element itsPduHeader: implementation-data-type=V2xFac_ItsPduHeaderType
      element denm: implementation-data-type=V2xFac_DenMsgType
      element transactionId: implementation-data-type=uint32
    V2xFac_DescriptiveNameType: range raw undefined, implementation-data-type=V2xFac_StringType
    V2xFac_DestinationPlacePresenceType:
      compu {mask 0x01: 0=FALSE (depRSCode__FALSE) (Bit 0 (LSB): Optional child present), mask 0x01: 1=TRUE (depRSCode) (Bit 0 (LSB): Optional child present), mask 0x02: 0=FALSE (depBlob__FALSE) (Bit 1: Optional child present), mask 0x02: 2=TRUE (depBlob) (Bit 1: Optional child present), mask 0x04: 0=FALSE (plnId__FALSE) (Bit 2: Optional child present), mask 0x04: 4=TRUE (plnId) (Bit 2: Optional child present), mask 0x08: 0=FALSE (plnText__FALSE) (Bit 3: Optional child present), mask 0x08: 8=TRUE (plnText) (Bit 3: Optional child present)}
      data-constr=V2xFac_DestinationPlacePresenceType
      implementation-data-type=uint8
    V2xFac_DestinationPlaceType: category=STRUCTURE
      6 x element, all with category=TYPE_REFERENCE:
        depType: implementation-data-type=V2xFac_DDD_DEPType
        depRSCode: implementation-data-type=V2xFac_ISO14823CodeType
        depBlob: implementation-data-type=V2xFac_depBlob100Type
        plnId: implementation-data-type=uint16
        plnText: implementation-data-type=V2xFac_StringType
        presence: implementation-data-type=V2xFac_DestinationPlacePresenceType
    V2xFac_DestinationRoadPresenceType: compu {mask 0x01: 0=FALSE (ronId__FALSE) (Bit 0 (LSB): Optional child present), mask 0x01: 1=TRUE (ronId) (Bit 0 (LSB): Optional child present), mask 0x02: 0=FALSE (ronText__FALSE) (Bit 1: Optional child present), mask 0x02: 2=TRUE (ronText) (Bit 1: Optional child present)}, data-constr=V2xFac_DestinationRoadPresenceType, implementation-data-type=uint8
    V2xFac_DestinationRoadType: category=STRUCTURE
      4 x element, all with category=TYPE_REFERENCE:
        derType: implementation-data-type=V2xFac_DDD_DERType
        ronId: implementation-data-type=uint16
        ronText: implementation-data-type=V2xFac_StringType
        presence: implementation-data-type=V2xFac_DestinationRoadPresenceType
    V2xFac_DieselEmissionValuesType: category=STRUCTURE
      element particulate: implementation-data-type=V2xFac_particulate0Type
      element absorbtionCoeff: implementation-data-type=V2xFac_Int2Type
    V2xFac_DirectionType: compu {0=sameDirection, 1=oppositeDirection, 2=bothDirections, 3=valueNotUsed}, range raw undefined, implementation-data-type=uint8
    V2xFac_DistanceOrDurationType: category=STRUCTURE
      element value: implementation-data-type=uint16
      element unit: implementation-data-type=V2xFac_RSCUnitType
    V2xFac_DistanceType: category=STRUCTURE
      element value: implementation-data-type=uint16
      element unit: implementation-data-type=V2xFac_RSCUnitType
    V2xFac_DriveDirectionType: compu {0x00=V2XFAC_DRIVINGDIRECTION_FORWARD, 0x01=V2XFAC_DRIVINGDIRECTION_BACKWARD, 0x02=V2XFAC_DRIVINGDIRECTION_UNAVAILABLE}, range raw 0x00..0x02, implementation-data-type=uint8
    V2xFac_DrivenLineOffsetLgType: range raw undefined, implementation-data-type=sint16
    V2xFac_DrivenLineOffsetSmType: range raw undefined, implementation-data-type=sint16
    V2xFac_DriverCharacteristicsType: compu {0=unexperiencedDrivers, 1=experiencedDrivers, 2=rfu1, 3=rfu2}, range raw undefined, implementation-data-type=uint8
    V2xFac_DrivingLaneStatusType:
      compu {mask 0x2000: 0=FALSE (outermostLaneClosed__FALSE) (Bit 13: Outermost lane is closed), mask 0x2000: 8192=TRUE (outermostLaneClosed) (Bit 13: Outermost lane is closed), mask 0x1000: 0=FALSE (secondLaneFromOutsideClosed__FALSE) (Bit 12: Second lane from the outside is closed), mask 0x1000: 4096=TRUE (secondLaneFromOutsideClosed) (Bit 12: Second lane from the outside is closed), mask 0x800: 0=FALSE (thirdLaneFromOutsideClosed__FALSE) (Bit 11: Third lane from the outside is closed), mask 0x800: 2048=TRUE (thirdLaneFromOutsideClosed) (Bit 11: Third lane from the outside is closed), mask 0x400: 0=FALSE (fourthLaneFromOutsideClosed__FALSE) (Bit 10: Fourth lane from the outside is closed), mask 0x400: 1024=TRUE (fourthLaneFromOutsideClosed) (Bit 10: Fourth lane from the outside is closed), mask 0x200: 0=FALSE (fifthLaneFromOutsideClosed__FALSE) (Bit 9: Fifth lane from the outside is closed), mask 0x200: 512=TRUE (fifthLaneFromOutsideClosed) (Bit 9: Fifth lane from the outside is closed), mask 0x100: 0=FALSE (sixthLaneFromOutsideClosed__FALSE) (Bit 8: Sixth lane from the outside is closed), mask 0x100: 256=TRUE (sixthLaneFromOutsideClosed) (Bit 8: Sixth lane from the outside is closed), mask 0x80: 0=FALSE (seventhLaneFromOutsideClosed__FALSE) (Bit 7: Seventh lane from the outside is closed), mask 0x80: 128=TRUE (seventhLaneFromOutsideClosed) (Bit 7: Seventh lane from the outside is closed), mask 0x40: 0=FALSE (eighthLaneFromOutsideClosed__FALSE) (Bit 6: Eighth lane from the outside is closed), mask 0x40: 64=TRUE (eighthLaneFromOutsideClosed) (Bit 6: Eighth lane from the outside is closed), mask 0x20: 0=FALSE (ninthLaneFromOutsideClosed__FALSE) (Bit 5: Ninth lane from the outside is closed), mask 0x20: 32=TRUE (ninthLaneFromOutsideClosed) (Bit 5: Ninth lane from the outside is closed), mask 0x10: 0=FALSE (tenthLaneFromOutsideClosed__FALSE) (Bit 4: Tenth lane from the outside is closed), mask 0x10: 16=TRUE (tenthLaneFromOutsideClosed) (Bit 4: Tenth lane from the outside is closed), mask 0x08: 0=FALSE (eleventhLaneFromOutsideClosed__FALSE) (Bit 3: Eleventh lane from the outside is closed), mask 0x08: 8=TRUE (eleventhLaneFromOutsideClosed) (Bit 3: Eleventh lane from the outside is closed), mask 0x04: 0=FALSE (twelfthLaneFromOutsideClosed__FALSE) (Bit 2: Twelfth lane from the outside is closed), mask 0x04: 4=TRUE (twelfthLaneFromOutsideClosed) (Bit 2: Twelfth lane from the outside is closed), mask 0x02: 0=FALSE (thirteenthLaneFromOutsideClosed__FALSE) (Bit 1: Thirteenth lane from the outside is closed), mask 0x02: 2=TRUE (thirteenthLaneFromOutsideClosed) (Bit 1: Thirteenth lane from the outside is closed), mask 0x01: 0=FALSE (fourteenthLaneFromOutsideClosed__FALSE) (Bit 0 (LSB): Fourteenth lane from the outside is closed), mask 0x01: 1=TRUE (fourteenthLaneFromOutsideClosed) (Bit 0 (LSB): Fourteenth lane from the outside is closed)}
      range raw 0x00..0x3FFF
      implementation-data-type=uint16
    V2xFac_EDTType: category=STRUCTURE
      7 x element, all with category=TYPE_REFERENCE:
        year: implementation-data-type=V2xFac_year80Type
        month_day: implementation-data-type=V2xFac_month_day83Type
        pmd: implementation-data-type=V2xFac_PMDType
        hourMinutes: implementation-data-type=V2xFac_hourMinutes84Type
        dayOfWeek: implementation-data-type=V2xFac_DayOfWeekType
        period: implementation-data-type=V2xFac_HoursMinutesType
        presence: implementation-data-type=V2xFac_DTMPresenceType
    V2xFac_ElevationType: range raw undefined, implementation-data-type=sint16
    V2xFac_EmbarkationStatusType: compu {mask 0x00: 0=FALSE (value__FALSE) (false if 0, true otherwise), mask 0x00: 0=TRUE (value) (false if 0, true otherwise)}, data-constr=V2xFac_EmbarkationStatusType, implementation-data-type=uint8
    V2xFac_EmergencyActionCodeType: category=STRUCTURE
      element count: implementation-data-type=uint8
      element values: category=ARRAY, array-size-semantics=FIXED-SIZE
        element values: array-size=undefined, array-size-semantics=FIXED-SIZE, implementation-data-type=uint8
    V2xFac_EmergencyContainerPresenceType: compu {mask 0x02: 0=FALSE (incidentIndication__FALSE) (Bit 1: Optional child present), mask 0x02: 2=TRUE (incidentIndication) (Bit 1: Optional child present), mask 0x01: 0=FALSE (emergencyPriority__FALSE) (Bit 0 (LSB): Optional child present), mask 0x01: 1=TRUE (emergencyPriority) (Bit 0 (LSB): Optional child present)}, range raw 0x00..0x03, implementation-data-type=uint8
    V2xFac_EmergencyContainerType: category=STRUCTURE
      4 x element, all with category=TYPE_REFERENCE:
        presence: implementation-data-type=V2xFac_EmergencyContainerPresenceType
        lightBarSirenInUse: implementation-data-type=V2xFac_LightBarSirenInUseType
        incidentIndication: implementation-data-type=V2xFac_CauseCodeType
        emergencyPriority: implementation-data-type=V2xFac_EmergencyPriorityType
    V2xFac_EmergencyPriorityType:
      compu {mask 0x02: 0=FALSE (requestForRightOfWay__FALSE) (Bit 1: request for right of way), mask 0x02: 2=TRUE (requestForRightOfWay) (Bit 1: request for right of way), mask 0x01: 0=FALSE (requestForFreeCrossingAtATrafficLight__FALSE) (Bit 0 (LSB): request for free crossing at a traffic light), mask 0x01: 1=TRUE (requestForFreeCrossingAtATrafficLight) (Bit 0 (LSB): request for free crossing at a traffic light)}
      range raw 0x00..0x03
      implementation-data-type=uint8
    V2xFac_EmergencyVehicleApproachingSubCauseCodeType: compu {0=unavailable, 1=emergencyVehicleApproaching, 2=prioritizedVehicleApproaching}, range raw undefined, implementation-data-type=uint8
    V2xFac_EnabledLaneListType: category=STRUCTURE
      element count: implementation-data-type=uint8
      element values: category=ARRAY, array-size-semantics=FIXED-SIZE
        element values: array-size=undefined, array-size-semantics=FIXED-SIZE, implementation-data-type=V2xFac_LaneIDType
    V2xFac_EnergyStorageType:
      compu {mask 0x40: 0=FALSE (hydrogenStorage__FALSE) (Bit 6: hydrogen storage), mask 0x40: 64=TRUE (hydrogenStorage) (Bit 6: hydrogen storage), mask 0x20: 0=FALSE (electricEnergyStorage__FALSE) (Bit 5: electric energy storage), mask 0x20: 32=TRUE (electricEnergyStorage) (Bit 5: electric energy storage), mask 0x10: 0=FALSE (liquidPropaneGas__FALSE) (Bit 4: liquid propane gas), mask 0x10: 16=TRUE (liquidPropaneGas) (Bit 4: liquid propane gas), mask 0x08: 0=FALSE (compressedNaturalGas__FALSE) (Bit 3: compressed natural gas), mask 0x08: 8=TRUE (compressedNaturalGas) (Bit 3: compressed natural gas), mask 0x04: 0=FALSE (diesel__FALSE) (Bit 2: diesel), mask 0x04: 4=TRUE (diesel) (Bit 2: diesel), mask 0x02: 0=FALSE (gasoline__FALSE) (Bit 1: gasoline), mask 0x02: 2=TRUE (gasoline) (Bit 1: gasoline), mask 0x01: 0=FALSE (ammonia__FALSE) (Bit 0 (LSB): ammonia), mask 0x01: 1=TRUE (ammonia) (Bit 0 (LSB): ammonia)}
      range raw 0x00..0x7F
      implementation-data-type=uint8
    V2xFac_EnergyStorageTypeType:
      compu {mask 0x01: 0=FALSE (hydrogenStorage__FALSE) (--), mask 0x01: 1=TRUE (hydrogenStorage) (--), mask 0x02: 0=FALSE (electricEnergyStorage__FALSE) (--), mask 0x02: 2=TRUE (electricEnergyStorage) (--), mask 0x04: 0=FALSE (liquidPropaneGas__FALSE) (--), mask 0x04: 4=TRUE (liquidPropaneGas) (--), mask 0x08: 0=FALSE (compressedNaturalGas__FALSE) (--), mask 0x08: 8=TRUE (compressedNaturalGas) (--), mask 0x10: 0=FALSE (diesel__FALSE) (--), mask 0x10: 16=TRUE (diesel) (--), mask 0x20: 0=FALSE (gasoline__FALSE) (--), mask 0x20: 32=TRUE (gasoline) (--), mask 0x40: 0=FALSE (ammonia__FALSE) (--), mask 0x40: 64=TRUE (ammonia) (--)}
      data-constr=V2xFac_EnergyStorageTypeType
      implementation-data-type=uint8
    V2xFac_EngineCharacteristicsType: compu {0=noEntry, 1=noEngine, 2=petrolUnleaded, 3=petrolLeaded, 4=diesel, 5=lPG, 6=battery, 7=solar, 8=hybrid, 9=hydrogen}, range raw undefined, implementation-data-type=uint8
    V2xFac_EnvironmentalCharacteristicsType: category=STRUCTURE
      element euroValue: implementation-data-type=V2xFac_EuroValueType
      element copValue: implementation-data-type=V2xFac_CopValueType
    V2xFac_EssMobileFrictionType: range raw undefined, implementation-data-type=uint8
    V2xFac_EssPrecipRateType: range raw undefined, implementation-data-type=uint16
    V2xFac_EssPrecipSituationType: compu {1=other, 2=unknown, 3=noPrecipitation, 4=unidentifiedSlight, 5=unidentifiedModerate, 6=unidentifiedHeavy, 7=snowSlight, 8=snowModerate, 9=snowHeavy, 10=rainSlight, 11=rainModerate, 12=rainHeavy, 13=frozenPrecipitationSlight, 14=frozenPrecipitationModerate, 15=frozenPrecipitationHeavy}, range raw 1..15
    V2xFac_EssPrecipYesNoType: compu {1=precip, 2=noPrecip, 3=error}, range raw 1..3
    V2xFac_EssSolarRadiationType: range raw undefined, implementation-data-type=uint16
    V2xFac_EuVehicleCategoryCodeChoiceType: compu {0x01=V2XFAC_EUVEHICLECATEGORYCODE_EU_VEHICLE_CATEGORY_L, 0x02=V2XFAC_EUVEHICLECATEGORYCODE_EU_VEHICLE_CATEGORY_M, 0x03=V2XFAC_EUVEHICLECATEGORYCODE_EU_VEHICLE_CATEGORY_N, 0x04=V2XFAC_EUVEHICLECATEGORYCODE_EU_VEHICLE_CATEGORY_O, 0x05=V2XFAC_EUVEHICLECATEGORYCODE_EU_VEHIC_IE_CATEGORY_T, 0x06=V2XFAC_EUVEHICLECATEGORYCODE_EU_VEHIC_IE_CATEGORY_G}, range raw 0x01..0x06
    V2xFac_EuVehicleCategoryCodeType: category=STRUCTURE
      7 x element, all with category=TYPE_REFERENCE:
        euVehicleCategoryL: implementation-data-type=V2xFac_EuVehicleCategoryLType
        euVehicleCategoryM: implementation-data-type=V2xFac_EuVehicleCategoryMType
        euVehicleCategoryN: implementation-data-type=V2xFac_EuVehicleCategoryNType
        euVehicleCategoryO: implementation-data-type=V2xFac_EuVehicleCategoryOType
        euVehicIeCategoryT: implementation-data-type=V2xFac_NULLType
        euVehicIeCategoryG: implementation-data-type=V2xFac_NULLType
        choice: implementation-data-type=V2xFac_EuVehicleCategoryCodeChoiceType
    V2xFac_EuVehicleCategoryLType: compu {0..6=l1..l7}, range raw 0..6
    V2xFac_EuVehicleCategoryMType: compu {0=m1, 1=m2, 2=m3}, range raw 0..2
    V2xFac_EuVehicleCategoryNType: compu {0=n1, 1=n2, 2=n3}, range raw 0..2
    V2xFac_EuVehicleCategoryOType: compu {0..3=o1..o4}, range raw 0..3
    V2xFac_EuroValueType: compu {0=noEntry, 1..6=euro_1..euro_6, 7..14=reservedForUse1..reservedForUse8, 15=eev}, range raw 0..15
    V2xFac_EventHistoryType: category=STRUCTURE
      element count: implementation-data-type=uint8
      element values: category=ARRAY, array-size-semantics=FIXED-SIZE
        element values: array-size=undefined, array-size-semantics=FIXED-SIZE, implementation-data-type=V2xFac_EventPointType
    V2xFac_EventPointPresenceType: compu {mask 0x01: 0=FALSE (eventDeltaTime__FALSE) (Bit 0 (LSB): Optional child present), mask 0x01: 1=TRUE (eventDeltaTime) (Bit 0 (LSB): Optional child present)}, range raw 0x00..0x01, implementation-data-type=uint8
    V2xFac_EventPointType: category=STRUCTURE
      4 x element, all with category=TYPE_REFERENCE:
        presence: implementation-data-type=V2xFac_EventPointPresenceType
        eventPosition: implementation-data-type=V2xFac_DeltaReferencePositionType
        eventDeltaTime: implementation-data-type=uint16
        informationQuality: implementation-data-type=uint8
    V2xFac_ExhaustEmissionValuesType: category=STRUCTURE
      5 x element, all with category=TYPE_REFERENCE:
        unitType: implementation-data-type=V2xFac_UnitTypeType
        emissionCO: implementation-data-type=uint16
        emissionHC: implementation-data-type=V2xFac_Int2Type
        emissionNOX: implementation-data-type=V2xFac_Int2Type
        emissionHCNOX: implementation-data-type=V2xFac_Int2Type
    V2xFac_Ext1ChoiceType: compu {0x01=V2XFAC_EXT1_CONTENT, 0x02=V2XFAC_EXT1_EXTENSION}, range raw 0x01..0x02
    V2xFac_Ext1Type: category=STRUCTURE
      element choice: implementation-data-type=V2xFac_Ext1ChoiceType
    V2xFac_Ext2ChoiceType: compu {0x01=V2XFAC_EXT2_CONTENT, 0x02=V2XFAC_EXT2_EXTENSION}, range raw 0x01..0x02
    V2xFac_Ext2Type: category=STRUCTURE
      element choice: implementation-data-type=V2xFac_Ext2ChoiceType
    V2xFac_Ext3Type: range raw undefined, implementation-data-type=uint32
    V2xFac_ExteriorLightsType:
      compu {mask 0x80: 0=FALSE (lowBeamHeadlightsOn__FALSE) (Bit 7: low beam headlights on), mask 0x80: 128=TRUE (lowBeamHeadlightsOn) (Bit 7: low beam headlights on), mask 0x40: 0=FALSE (highBeamHeadlightsOn__FALSE) (Bit 6: high beam headlights on), mask 0x40: 64=TRUE (highBeamHeadlightsOn) (Bit 6: high beam headlights on), mask 0x20: 0=FALSE (leftTurnSignalOn__FALSE) (Bit 5: left turn signal on), mask 0x20: 32=TRUE (leftTurnSignalOn) (Bit 5: left turn signal on), mask 0x10: 0=FALSE (rightTurnSignalOn__FALSE) (Bit 4: right turn signal on), mask 0x10: 16=TRUE (rightTurnSignalOn) (Bit 4: right turn signal on), mask 0x08: 0=FALSE (daytimeRunningLightsOn__FALSE) (Bit 3: daytime running lights on), mask 0x08: 8=TRUE (daytimeRunningLightsOn) (Bit 3: daytime running lights on), mask 0x04: 0=FALSE (reverseLightOn__FALSE) (Bit 2: reverse light on), mask 0x04: 4=TRUE (reverseLightOn) (Bit 2: reverse light on), mask 0x02: 0=FALSE (fogLightOn__FALSE) (Bit 1: fog light on), mask 0x02: 2=TRUE (fogLightOn) (Bit 1: fog light on), mask 0x01: 0=FALSE (parkingLightsOn__FALSE) (Bit 0: parking lights on), mask 0x01: 1=TRUE (parkingLightsOn) (Bit 0: parking lights on)}
      range raw 0x00..0xFF
      implementation-data-type=uint8
    V2xFac_GeneralIviContainerType: category=STRUCTURE
      element count: implementation-data-type=uint8
      element values: category=ARRAY, array-size-semantics=FIXED-SIZE
        element values: array-size=undefined, array-size-semantics=FIXED-SIZE, implementation-data-type=V2xFac_GicPartType
    V2xFac_GenericLanePresenceType:
      compu {mask 0x01: 0=FALSE (name__FALSE) (Bit 0 (LSB): Optional child present), mask 0x01: 1=TRUE (name) (Bit 0 (LSB): Optional child present), mask 0x02: 0=FALSE (ingressApproach__FALSE) (Bit 1: Optional child present), mask 0x02: 2=TRUE (ingressApproach) (Bit 1: Optional child present), mask 0x04: 0=FALSE (egressApproach__FALSE) (Bit 2: Optional child present), mask 0x04: 4=TRUE (egressApproach) (Bit 2: Optional child present), mask 0x08: 0=FALSE (maneuvers__FALSE) (Bit 3: Optional child present), mask 0x08: 8=TRUE (maneuvers) (Bit 3: Optional child present), mask 0x10: 0=FALSE (connectsTo__FALSE) (Bit 4: Optional child present), mask 0x10: 16=TRUE (connectsTo) (Bit 4: Optional child present), mask 0x20: 0=FALSE (overlays__FALSE) (Bit 5: Optional child present), mask 0x20: 32=TRUE (overlays) (Bit 5: Optional child present)}
      data-constr=V2xFac_GenericLanePresenceType
      implementation-data-type=uint8
    V2xFac_GenericLaneType: category=STRUCTURE
      10 x element, all with category=TYPE_REFERENCE:
        laneID: implementation-data-type=V2xFac_LaneIDType
        name: implementation-data-type=V2xFac_DescriptiveNameType
        ingressApproach: implementation-data-type=V2xFac_ApproachIDType
        egressApproach: implementation-data-type=V2xFac_ApproachIDType
        laneAttributes: implementation-data-type=V2xFac_LaneAttributesType
        maneuvers: implementation-data-type=V2xFac_AllowedManeuversType
        nodeList: implementation-data-type=V2xFac_NodeListXYType
        connectsTo: implementation-data-type=V2xFac_ConnectsToListType
        overlays: implementation-data-type=V2xFac_OverlayLaneListType
        presence: implementation-data-type=V2xFac_GenericLanePresenceType
    V2xFac_GenericLocationsType: compu {7937=on_bridges, 7938=in_tunnels, 7939=entering_or_leaving_tunnels, 7940=on_ramps, 7941=in_road_construction_area, 7942=around_a_curve, 8026=on_curve, 8009=on_tracks, 8025=in_street, 8027=shoulder, 7943=on_minor_roads, 7944=in_the_opposing_lanes, 7945=adjacent_to_roadway, 8024=across_tracks, 7946=on_bend, 8032=intersection, 7947=entire_intersection, 7948=in_the_median, 7949=moved_to_side_of_road, 7950=moved_to_shoulder, 7951=on_the_roadway, 8010=dip, 8011=traffic_circle, 8028=crossover, 8029=cross_road, 8030=side_road, 8014=to, 8015=by, 8016=through, 8017=area_of, 8018=under, 8019=over, 8020=from, 8021=approaching, 8022=entering_at, 8023=exiting_at, 7952=in_shaded_areas, 7953=in_low_lying_areas, 7954=in_the_downtown_area, 7955=in_the_inner_city_area, 7956=in_parts, 7957=in_some_places, 7958=in_the_ditch, 7959=in_the_valley, 7960=on_hill_top, 7961=near_the_foothills, 7962=at_high_altitudes, 7963=near_the_lake, 7964=near_the_shore, 8008=nearby_basin, 7965=over_the_crest_of_a_hill, 7966=other_than_on_the_roadway, 7967=near_the_beach, 7968=near_beach_access_point, 8006=mountain_pass, 7969=lower_level, 7970=upper_level, 7971=airport, 7972=concourse, 7973=gate, 7974=baggage_claim, 7975=customs_point, 8007=reservation_center, 7976=station, 7977=platform, 7978=dock, 7979=depot, 7980=ev_charging_point, 7981=information_welcome_point, 7982=at_rest_area, 7983=at_service_area, 7984=at_weigh_station, 8033=roadside_park, 7985=picnic_areas, 7986=rest_area, 7987=service_stations, 7988=toilets, 8031=bus_stop, 8012=park_and_ride_lot, 7989=on_the_right, 7990=on_the_left, 7991=in_the_center, 7992=in_the_opposite_direction, 7993=cross_traffic, 7994=northbound_traffic, 7995=eastbound_traffic, 7996=southbound_traffic, 7997=westbound_traffic, 7998=north, 7999=south, 8000=east, 8001=west, 8002=northeast, 8003=northwest, 8004=southeast, 8005=southwest}, range raw 7937..8033
    V2xFac_GeographicLocationContainerPresenceType:
      compu {mask 0x01: 0=FALSE (referencePositionTime__FALSE) (Bit 0 (LSB): Optional child present), mask 0x01: 1=TRUE (referencePositionTime) (Bit 0 (LSB): Optional child present), mask 0x02: 0=FALSE (refereneePositionHeading__FALSE) (Bit 1: Optional child present), mask 0x02: 2=TRUE (refereneePositionHeading) (Bit 1: Optional child present), mask 0x04: 0=FALSE (refereneePositionSpeed__FALSE) (Bit 2: Optional child present), mask 0x04: 4=TRUE (refereneePositionSpeed) (Bit 2: Optional child present)}
      data-constr=V2xFac_GeographicLocationContainerPresenceType
      implementation-data-type=uint8
    V2xFac_GeographicLocationContainerType: category=STRUCTURE
      6 x element, all with category=TYPE_REFERENCE:
        referencePosition: implementation-data-type=V2xFac_ReferencePositionType
        referencePositionTime: implementation-data-type=V2xFac_TimestampItsType
        refereneePositionHeading: implementation-data-type=V2xFac_HeadingType
        refereneePositionSpeed: implementation-data-type=V2xFac_SpeedType
        parts: implementation-data-type=V2xFac_parts5Type
        presence: implementation-data-type=V2xFac_GeographicLocationContainerPresenceType
    V2xFac_GicPartPresenceType:
      compu {mask 0x01: 0=FALSE (detectionZoneIds__FALSE) (Bit 0 (LSB): Optional child present), mask 0x01: 1=TRUE (detectionZoneIds) (Bit 0 (LSB): Optional child present), mask 0x02: 0=FALSE (its_Rrid__FALSE) (Bit 1: Optional child present), mask 0x02: 2=TRUE (its_Rrid) (Bit 1: Optional child present), mask 0x04: 0=FALSE (relevanceZoneIds__FALSE) (Bit 2: Optional child present), mask 0x04: 4=TRUE (relevanceZoneIds) (Bit 2: Optional child present), mask 0x08: 0=FALSE (direction__FALSE) (Bit 3: Optional child present), mask 0x08: 8=TRUE (direction) (Bit 3: Optional child present), mask 0x10: 0=FALSE (driverAwarenessZoneIds__FALSE) (Bit 4: Optional child present), mask 0x10: 16=TRUE (driverAwarenessZoneIds) (Bit 4: Optional child present), mask 0x20: 0=FALSE (minimumAwarenessTime__FALSE) (Bit 5: Optional child present), mask 0x20: 32=TRUE (minimumAwarenessTime) (Bit 5: Optional child present), mask 0x40: 0=FALSE (applicableLanes__FALSE) (Bit 6: Optional child present), mask 0x40: 64=TRUE (applicableLanes) (Bit 6: Optional child present), mask 0x80: 0=FALSE (iviPurpose__FALSE) (Bit 7: Optional child present), mask 0x80: 128=TRUE (iviPurpose) (Bit 7: Optional child present), mask 0x100: 0=FALSE (laneStatus__FALSE) (Bit 8: Optional child present), mask 0x100: 256=TRUE (laneStatus) (Bit 8: Optional child present), mask 0x200: 0=FALSE (vehicleCharacteristics__FALSE) (Bit 9: Optional child present), mask 0x200: 512=TRUE (vehicleCharacteristics) (Bit 9: Optional child present), mask 0x400: 0=FALSE (driverCharacteristics__FALSE) (Bit 10: Optional child present), mask 0x400: 1024=TRUE (driverCharacteristics) (Bit 10: Optional child present), mask 0x800: 0=FALSE (layoutId__FALSE) (Bit 11: Optional child present), mask 0x800: 2048=TRUE (layoutId) (Bit 11: Optional child present), mask 0x1000: 0=FALSE (preStoredLayoutId__FALSE) (Bit 12: Optional child present), mask 0x1000: 4096=TRUE (preStoredLayoutId) (Bit 12: Optional child present), mask 0x2000: 0=FALSE (extraText__FALSE) (Bit 13: Optional child present), mask 0x2000: 8192=TRUE (extraText) (Bit 13: Optional child present)}
      data-constr=V2xFac_GicPartPresenceType
      implementation-data-type=uint8
    V2xFac_GicPartType: category=STRUCTURE
      17 x element, all with category=TYPE_REFERENCE:
        detectionZoneIds: implementation-data-type=V2xFac_detectionZoneIds7Type
        its_Rrid: implementation-data-type=V2xFac_VarLengthNumberType
        relevanceZoneIds: implementation-data-type=V2xFac_relevanceZoneIds8Type
        direction: implementation-data-type=V2xFac_DirectionType
        driverAwarenessZoneIds: implementation-data-type=V2xFac_driverAwarenessZoneIds9Type
        minimumAwarenessTime: implementation-data-type=uint8
        applicableLanes: implementation-data-type=V2xFac_applicableLanes11Type
        iviType: implementation-data-type=V2xFac_IviTypeType
        iviPurpose: implementation-data-type=V2xFac_IviPurposeType
        laneStatus: implementation-data-type=V2xFac_LaneStatusType
        vehicleCharacteristics: implementation-data-type=V2xFac_CompleteVehicleCharacteristicsType
        driverCharacteristics: implementation-data-type=V2xFac_DriverCharacteristicsType
        layoutId: implementation-data-type=uint8
        preStoredLayoutId: implementation-data-type=uint8
        roadSignCodes: implementation-data-type=V2xFac_roadSignCodes14Type
        extraText: implementation-data-type=V2xFac_extraText15Type
        presence: implementation-data-type=V2xFac_GicPartPresenceType
    V2xFac_GlcPartPresenceType:
      compu {mask 0x01: 0=FALSE (laneNumber__FALSE) (Bit 0 (LSB): Optional child present), mask 0x01: 1=TRUE (laneNumber) (Bit 0 (LSB): Optional child present), mask 0x02: 0=FALSE (zoneExtension__FALSE) (Bit 1: Optional child present), mask 0x02: 2=TRUE (zoneExtension) (Bit 1: Optional child present), mask 0x04: 0=FALSE (zoneHeading__FALSE) (Bit 2: Optional child present), mask 0x04: 4=TRUE (zoneHeading) (Bit 2: Optional child present), mask 0x08: 0=FALSE (zone__FALSE) (Bit 3: Optional child present), mask 0x08: 8=TRUE (zone) (Bit 3: Optional child present)}
      data-constr=V2xFac_GlcPartPresenceType
      implementation-data-type=uint8
    V2xFac_GlcPartType: category=STRUCTURE
      6 x element, all with category=TYPE_REFERENCE:
        zoneId: implementation-data-type=V2xFac_ZidType
        laneNumber: implementation-data-type=V2xFac_LanePositionType
        zoneExtension: implementation-data-type=uint8
        zoneHeading: implementation-data-type=V2xFac_HeadingValueType
        zone: implementation-data-type=V2xFac_ZoneType
        presence: implementation-data-type=V2xFac_GlcPartPresenceType
    V2xFac_GnAreaShapeType: compu {0x00=V2XFAC_GNAREASHAPE_CIRCLE, 0x01=V2XFAC_GNAREASHAPE_RECT, 0x02=V2XFAC_GNAREASHAPE_ELLIPSE}, range raw 0x00..0x02, implementation-data-type=uint8
    V2xFac_GnDestinationAreaType: category=STRUCTURE
      6 x element, all with category=TYPE_REFERENCE:
        latitude: implementation-data-type=sint32
        longitude: implementation-data-type=sint32
        distanceA: implementation-data-type=uint16
        distanceB: implementation-data-type=uint16
        angle: implementation-data-type=uint16
        shape: implementation-data-type=V2xFac_GnAreaShapeType
    V2xFac_GoodsTypeType: compu {0=ammunition, 1=chemicals, 2=empty, 3=fuel, 4=glass, 5=dangerous, 6=liquid, 7=livestock, 8=dangerousForPeople, 9=dangerousForTheEnvironment, 10=dangerousForWater, 11=perishableProducts, 12=pharmaceutical, 13=vehicles}, range raw undefined, implementation-data-type=uint8
    V2xFac_HardShoulderStatusType: compu {0x00=V2XFAC_HARDSHOULDERSTATUS_AVAILABLE_FOR_STOPPING, 0x01=V2XFAC_HARDSHOULDERSTATUS_CLOSED, 0x02=V2XFAC_HARDSHOULDERSTATUS_AVAILABLE_FOR_DRIVING}, range raw 0x00..0x02, implementation-data-type=uint8
    V2xFac_HazardousLocation_AnimalOnTheRoadSubCauseCodeType: compu {0=unavailable, 1=wildAnimals, 2=herdOfAnimals, 3=smallAnimals, 4=largeAnimals}, range raw undefined, implementation-data-type=uint8
    V2xFac_HazardousLocation_DangerousCurveSubCauseCodeType: compu {0=unavailable, 1=dangerousLeftTurnCurve, 2=dangerousRightTurnCurve, 3=multipleCurvesStartingWithUnknownTurningDirection, 4=multipleCurvesStartingWithLeftTurn, 5=multipleCurvesStartingWithRightTurn}, range raw undefined, implementation-data-type=uint8
    V2xFac_HazardousLocation_ObstacleOnTheRoadSubCauseCodeType: compu {0=unavailable, 1=shedLoad, 2=partsOfVehicles, 3=partsOfTyres, 4=bigObjects, 5=fallenTrees, 6=hubCaps, 7=waitingVehicles}, range raw undefined, implementation-data-type=uint8
    V2xFac_HazardousLocation_SurfaceConditionSubCauseCodeType: compu {0=unavailable, 1=rockfalls, 2=earthquakeDamage, 3=sewerCollapse, 4=subsidence, 5=snowDrifts, 6=stormDamage, 7=burstPipe, 8=volcanoEruption, 9=fallingIce}, range raw undefined, implementation-data-type=uint8
    V2xFac_HeadingConfidenceType: compu {1=equalOrWithinZeroPointOneDegree, 10=equalOrWithinOneDegree, 126=outOfRange, 127=unavailable}, range raw undefined, implementation-data-type=uint8
    V2xFac_HeadingType: category=STRUCTURE
      element headingValue: implementation-data-type=uint16
      element headingConfidence: implementation-data-type=uint8
    V2xFac_HeadingValueType: compu {0=wgs84North, 900=wgs84East, 1800=wgs84South, 2700=wgs84West, 3601=unavailable}, range raw undefined, implementation-data-type=uint16
    V2xFac_HeightLonCarrType: compu {1=oneCentimeter, 100=unavailable}, range raw undefined, implementation-data-type=uint8
    V2xFac_HighFrequencyContainerChoiceType: compu {0x01=V2XFAC_HIGHFREQCONTAINER_BASICVEHICLECONTAINER, 0x02=V2XFAC_HIGHFREQCONTAINER_RSUCONTAINERHIGHFREQ}, range raw 0x01..0x02, implementation-data-type=uint8
    V2xFac_HighFrequencyContainerType: category=STRUCTURE
      element choice: implementation-data-type=V2xFac_HighFrequencyContainerChoiceType
      element basicVehicleContainerHighFrequency: implementation-data-type=V2xFac_BasicVehicleContainerHighFrequencyType
      element rsuContainerHighFrequency: implementation-data-type=V2xFac_RSUContainerHighFrequencyType
    V2xFac_HoursMinutesType: category=STRUCTURE
      element hours: implementation-data-type=uint8
      element mins: implementation-data-type=uint8
    V2xFac_HumanPresenceOnTheRoadSubCauseCodeType: compu {0=unavailable, 1=childrenOnRoadway, 2=cyclistOnRoadway, 3=motorcyclistOnRoadway}, range raw undefined, implementation-data-type=uint8
    V2xFac_HumanProblemSubCauseCodeType: compu {0=unavailable, 1=glycemiaProblem, 2=heartProblem}, range raw undefined, implementation-data-type=uint8
    V2xFac_ISO14823Attributes38ChoiceType: compu {0x01=V2XFAC_ISO14823ATTRIBUTES38_DTM, 0x02=V2XFAC_ISO14823ATTRIBUTES38_EDT, 0x03=V2XFAC_ISO14823ATTRIBUTES38_ILLL, 0x04=V2XFAC_ISO14823ATTRIBUTES38_VED, 0x05=V2XFAC_ISO14823ATTRIBUTES38_SPE, 0x06=V2XFAC_ISO14823ATTRIBUTES38_ROI, 0x07=V2XFAC_ISO14823ATTRIBUTES38_DBV, 0x08=V2XFAC_ISO14823ATTRIBUTES38_DDD}, range raw 0x01..0x08
    V2xFac_ISO14823Attributes38Type: category=STRUCTURE
      9 x element, all with category=TYPE_REFERENCE:
        dtm: implementation-data-type=V2xFac_DTMType
        edt: implementation-data-type=V2xFac_EDTType
        illl: implementation-data-type=V2xFac_DFLType
        ved: implementation-data-type=V2xFac_VEDType
        spe: implementation-data-type=V2xFac_SPEType
        roi: implementation-data-type=V2xFac_ROIType
        dbv: implementation-data-type=V2xFac_DBVType
        ddd: implementation-data-type=V2xFac_DDDType
        choice: implementation-data-type=V2xFac_ISO14823Attributes38ChoiceType
    V2xFac_ISO14823AttributesType: category=STRUCTURE
      element count: implementation-data-type=uint8
      element values: category=ARRAY, array-size-semantics=FIXED-SIZE
        element values: array-size=undefined, array-size-semantics=FIXED-SIZE, implementation-data-type=V2xFac_ISO14823Attributes38Type
    V2xFac_ISO14823CodePresenceType: compu {mask 0x01: 0=FALSE (attributes__FALSE) (Bit 0 (LSB): Optional child present), mask 0x01: 1=TRUE (attributes) (Bit 0 (LSB): Optional child present)}, data-constr=V2xFac_ISO14823CodePresenceType, implementation-data-type=uint8
    V2xFac_ISO14823CodeType: category=STRUCTURE
      element pictogramCode: implementation-data-type=V2xFac_pictogramCode39Type
      element attributes: implementation-data-type=V2xFac_ISO14823AttributesType
      element presence: implementation-data-type=V2xFac_ISO14823CodePresenceType
    V2xFac_ITIScodesAndText113Type: category=STRUCTURE
      element item: implementation-data-type=V2xFac_item114Type
    V2xFac_ITIScodesAndTextType: category=STRUCTURE
      element count: implementation-data-type=uint8
      element values: category=ARRAY, array-size-semantics=FIXED-SIZE
        element values: array-size=undefined, array-size-semantics=FIXED-SIZE, implementation-data-type=V2xFac_ITIScodesAndText113Type
    V2xFac_ITIScodesType: range raw undefined, implementation-data-type=uint16
    V2xFac_ITIStextType: range raw undefined, implementation-data-type=V2xFac_StringType
    V2xFac_ImpactReductionContainerType: category=STRUCTURE
      12 x element, all with category=TYPE_REFERENCE:
        heightLonCarrLeft: implementation-data-type=uint8
        heightLonCarrRight: implementation-data-type=uint8
        posLonCarrLeft: implementation-data-type=uint8
        posLonCarrRight: implementation-data-type=uint8
        positionOfPillars: implementation-data-type=V2xFac_PositionOfPillarsType
        posCentMass: implementation-data-type=uint8
        wheelBaseVehicle: implementation-data-type=uint8
        turningRadius: implementation-data-type=uint8
        posFrontAx: implementation-data-type=uint8
        positionOfOccupants: implementation-data-type=V2xFac_PositionOfOccupantsType
        vehicleMass: implementation-data-type=uint16
        requestResponseIndication: implementation-data-type=V2xFac_RequestResponseIndicationType
    V2xFac_IncidentResponseEquipmentType: compu {9985=ground_fire_suppression, 9986=heavy_ground_equipment, 9988=aircraft, 9989=marine_equipment, 9990=support_equipment, 9991=medical_rescue_unit, 9993=other, 9994=ground_fire_suppression_other, 9995=engine, 9996=truck_or_aerial, 9997=quint, 9998=tanker_pumper_combination, 10000=brush_truck, 10001=aircraft_rescue_firefighting, 10004=heavy_ground_equipment_other, 10005=dozer_or_plow, 10006=tractor, 10008=tanker_or_tender, 10024=aircraft_other, 10025=aircraft_fixed_wing_tanker, 10026=helitanker, 10027=helicopter, 10034=marine_equipment_other, 10035=fire_boat_with_pump, 10036=boat_no_pump, 10044=support_apparatus_other, 10045=breathing_apparatus_support, 10046=light_and_air_unit, 10054=medical_rescue_unit_other, 10055=rescue_unit, 10056=urban_search_rescue_unit, 10057=high_angle_rescue, 10058=crash_fire_rescue, 10059=bLS_unit, 10060=aLS_unit, 10075=mobile_command_post, 10076=chief_officer_car, 10077=hAZMAT_unit, 10078=type_i_hand_crew, 10079=type_ii_hand_crew, 10083=privately_owned_vehicle, 10084=other_apparatus_resource, 10085=ambulance, 10086=bomb_squad_van, 10087=combine_harvester, 10088=construction_vehicle, 10089=farm_tractor, 10090=grass_cutting_machines, 10091=hAZMAT_containment_tow, 10092=heavy_tow, 10094=light_tow, 10114=flatbed_tow, 10093=hedge_cutting_machines, 10095=mobile_crane, 10096=refuse_collection_vehicle, 10097=resurfacing_vehicle, 10098=road_sweeper, 10099=roadside_litter_collection_crews, 10100=salvage_vehicle, 10101=sand_truck, 10102=snowplow, 10103=steam_roller, 10104=swat_team_van, 10105=track_laying_vehicle, 10106=unknown_vehicle, 10107=white_lining_vehicle, 10108=dump_truck, 10109=supervisor_vehicle, 10110=snow_blower, 10111=rotary_snow_blower, 10112=road_grader, 10113=steam_truck}, range raw 9985..10114
    V2xFac_InformationQualityType: compu {0=unavailable, 1=lowest, 7=highest}, range raw undefined, implementation-data-type=uint8
    V2xFac_Int1Type: range raw undefined, implementation-data-type=uint8
    V2xFac_Int2Type: range raw undefined, implementation-data-type=uint16
    V2xFac_IntersectionGeometryListType: category=STRUCTURE
      element count: implementation-data-type=uint8
      element values: category=ARRAY, array-size-semantics=FIXED-SIZE
        element values: array-size=undefined, array-size-semantics=FIXED-SIZE, implementation-data-type=V2xFac_IntersectionGeometryType
    V2xFac_IntersectionGeometryPresenceType:
      compu {mask 0x01: 0=FALSE (name__FALSE) (Bit 0 (LSB): Optional child present), mask 0x01: 1=TRUE (name) (Bit 0 (LSB): Optional child present), mask 0x02: 0=FALSE (laneWidth__FALSE) (Bit 1: Optional child present), mask 0x02: 2=TRUE (laneWidth) (Bit 1: Optional child present), mask 0x04: 0=FALSE (speedLimits__FALSE) (Bit 2: Optional child present), mask 0x04: 4=TRUE (speedLimits) (Bit 2: Optional child present), mask 0x08: 0=FALSE (preemptPriorityData__FALSE) (Bit 3: Optional child present), mask 0x08: 8=TRUE (preemptPriorityData) (Bit 3: Optional child present)}
      data-constr=V2xFac_IntersectionGeometryPresenceType
      implementation-data-type=uint8
    V2xFac_IntersectionGeometryType: category=STRUCTURE
      9 x element, all with category=TYPE_REFERENCE:
        name: implementation-data-type=V2xFac_DescriptiveNameType
        id: implementation-data-type=V2xFac_IntersectionReferenceIDType
        revision: implementation-data-type=V2xFac_MsgCountType
        refPoint: implementation-data-type=V2xFac_Position3DType
        laneWidth: implementation-data-type=V2xFac_LaneWidthType
        speedLimits: implementation-data-type=V2xFac_SpeedLimitListType
        laneSet: implementation-data-type=V2xFac_LaneListType
        preemptPriorityData: implementation-data-type=V2xFac_PreemptPriorityListType
        presence: implementation-data-type=V2xFac_IntersectionGeometryPresenceType
    V2xFac_IntersectionIDType: range raw undefined, implementation-data-type=uint16
    V2xFac_IntersectionReferenceIDPresenceType: compu {mask 0x01: 0=FALSE (region__FALSE) (Bit 0 (LSB): Optional child present), mask 0x01: 1=TRUE (region) (Bit 0 (LSB): Optional child present)}, data-constr=V2xFac_IntersectionReferenceIDPresenceType, implementation-data-type=uint8
    V2xFac_IntersectionReferenceIDType: category=STRUCTURE
      element region: implementation-data-type=V2xFac_RoadRegulatorIDType
      element id: implementation-data-type=V2xFac_IntersectionIDType
      element presence: implementation-data-type=V2xFac_IntersectionReferenceIDPresenceType
    V2xFac_IntersectionStateListType: category=STRUCTURE
      element count: implementation-data-type=uint8
      element values: category=ARRAY, array-size-semantics=FIXED-SIZE
        element values: array-size=undefined, array-size-semantics=FIXED-SIZE, implementation-data-type=V2xFac_IntersectionStateType
    V2xFac_IntersectionStatePresenceType:
      compu {mask 0x01: 0=FALSE (name__FALSE) (Bit 0 (LSB): Optional child present), mask 0x01: 1=TRUE (name) (Bit 0 (LSB): Optional child present), mask 0x02: 0=FALSE (moy__FALSE) (Bit 1: Optional child present), mask 0x02: 2=TRUE (moy) (Bit 1: Optional child present), mask 0x04: 0=FALSE (timeStamp__FALSE) (Bit 2: Optional child present), mask 0x04: 4=TRUE (timeStamp) (Bit 2: Optional child present), mask 0x08: 0=FALSE (enabledLanes__FALSE) (Bit 3: Optional child present), mask 0x08: 8=TRUE (enabledLanes) (Bit 3: Optional child present), mask 0x10: 0=FALSE (maneuverAssistList__FALSE) (Bit 4: Optional child present), mask 0x10: 16=TRUE (maneuverAssistList) (Bit 4: Optional child present)}
      data-constr=V2xFac_IntersectionStatePresenceType
      implementation-data-type=uint8
    V2xFac_IntersectionStateType: category=STRUCTURE
      10 x element, all with category=TYPE_REFERENCE:
        name: implementation-data-type=V2xFac_DescriptiveNameType
        id: implementation-data-type=V2xFac_IntersectionReferenceIDType
        revision: implementation-data-type=V2xFac_MsgCountType
        status: implementation-data-type=V2xFac_IntersectionStatusObjectType
        moy: implementation-data-type=V2xFac_MinuteOfTheYearType
        timeStamp: implementation-data-type=V2xFac_DSecondType
        enabledLanes: implementation-data-type=V2xFac_EnabledLaneListType
        states: implementation-data-type=V2xFac_MovementListType
        maneuverAssistList: implementation-data-type=V2xFac_ManeuverAssistListType
        presence: implementation-data-type=V2xFac_IntersectionStatePresenceType
    V2xFac_IntersectionStatusObjectType:
      compu {mask 0x01: 0=FALSE (manualControlIsEnabled__FALSE) (--), mask 0x01: 1=TRUE (manualControlIsEnabled) (--), mask 0x02: 0=FALSE (stopTimeIsActivated__FALSE) (--), mask 0x02: 2=TRUE (stopTimeIsActivated) (--), mask 0x04: 0=FALSE (failureFlash__FALSE) (--), mask 0x04: 4=TRUE (failureFlash) (--), mask 0x08: 0=FALSE (preemptIsActive__FALSE) (--), mask 0x08: 8=TRUE (preemptIsActive) (--), mask 0x10: 0=FALSE (signalPriorityIsActive__FALSE) (--), mask 0x10: 16=TRUE (signalPriorityIsActive) (--), mask 0x20: 0=FALSE (fixedTimeOperation__FALSE) (--), mask 0x20: 32=TRUE (fixedTimeOperation) (--), mask 0x40: 0=FALSE (trafficDependentOperation__FALSE) (--), mask 0x40: 64=TRUE (trafficDependentOperation) (--), mask 0x80: 0=FALSE (standbyOperation__FALSE) (--), mask 0x80: 128=TRUE (standbyOperation) (--), mask 0x100: 0=FALSE (failureMode__FALSE) (--), mask 0x100: 256=TRUE (failureMode) (--), mask 0x200: 0=FALSE (off__FALSE) (--), mask 0x200: 512=TRUE (off) (--), mask 0x400: 0=FALSE (recentMAPmessageUpdate__FALSE) (--), mask 0x400: 1024=TRUE (recentMAPmessageUpdate) (--), mask 0x800: 0=FALSE (recentChangeInMAPassignedLanesIDsUsed__FALSE) (--), mask 0x800: 2048=TRUE (recentChangeInMAPassignedLanesIDsUsed) (--), mask 0x1000: 0=FALSE (noValidMAPisAvailableAtThisTime__FALSE) (--), mask 0x1000: 4096=TRUE (noValidMAPisAvailableAtThisTime) (--), mask 0x2000: 0=FALSE (noValidSPATisAvailableAtThisTime__FALSE) (--), mask 0x2000: 8192=TRUE (noValidSPATisAvailableAtThisTime) (--)}
      data-constr=V2xFac_IntersectionStatusObjectType
      implementation-data-type=uint8
    V2xFac_Iso3833VehicleTypeType: compu {0=passengerCar, 1=saloon, 2=convertibleSaloon, 3=pullmanSaloon, 4=stationWagon, 5=truckStationWagon, 6=coupe, 7=convertibIe, 8=multipurposePassengerCar, 9=forwardConrolPassengerCar, 10=specialPassengerCar, 11=bus, 12=minibus, 13=urbanBus, 14=interurbanCoach, 15=longDistanceCoach, 16=articulatedBus, 17=trolleyBus, 18=specialBus, 19=commerciaIVehicle, 20=speciaiCommercialVehicle, 21=specialVehicle, 22=trailingTowingVehicle, 23=semiTrailerTowingVehicle, 24=trailer, 25=busTrailer, 26=generalPurposeTrailer, 27=caravan, 28=specialTrailer, 29=semiTrailer, 30=busSemiTrailer, 31=generalPurposesSemiTrailer, 32=specialSemiTrailer, 33=roadTrain, 34=passengerRoadTrain, 35=articulatedRoadTrain, 36=doubleRoadTrain, 37=compositeRoadTrain, 38=specialRoadTrain, 39=moped, 40=motorCycle}, range raw 0..40
    V2xFac_IssuerIdentifierType: range raw undefined, implementation-data-type=uint16
    V2xFac_ItineraryPathType: category=STRUCTURE
      element count: implementation-data-type=uint8
      element values: category=ARRAY, array-size-semantics=FIXED-SIZE
        element values: array-size=undefined, array-size-semantics=FIXED-SIZE, implementation-data-type=V2xFac_ReferencePositionType
    V2xFac_ItsPduHeaderType: category=STRUCTURE
      element protocolVersion: implementation-data-type=uint8
      element messageId: implementation-data-type=uint8
      element stationId: implementation-data-type=uint32
    V2xFac_IviContainerChoiceType: compu {0x01=V2XFAC_IVICONTAINER_GLC, 0x02=V2XFAC_IVICONTAINER_GIC, 0x03=V2XFAC_IVICONTAINER_RCC, 0x04=V2XFAC_IVICONTAINER_TC, 0x05=V2XFAC_IVICONTAINER_LAC}, range raw 0x01..0x05
    V2xFac_IviContainerType: category=STRUCTURE
      6 x element, all with category=TYPE_REFERENCE:
        glc: implementation-data-type=V2xFac_GeographicLocationContainerType
        gic: implementation-data-type=V2xFac_GeneralIviContainerType
        rcc: implementation-data-type=V2xFac_RoadConfigurationContainerType
        tc: implementation-data-type=V2xFac_TextContainerType
        lac: implementation-data-type=V2xFac_LayoutContainerType
        choice: implementation-data-type=V2xFac_IviContainerChoiceType
    V2xFac_IviIdentificationNumberType: range raw undefined, implementation-data-type=uint16
    V2xFac_IviPurposeType: compu {0=safety, 1=environmental, 2=trafficOptimisation}, range raw undefined, implementation-data-type=uint8
    V2xFac_IviStatusType: compu {0=new, 1=update, 2=cancellation, 3=negation}, range raw undefined, implementation-data-type=uint8
    V2xFac_IviStructurePresenceType: compu {mask 0x01: 0=FALSE (optional__FALSE) (Bit 0 (LSB): Optional child present), mask 0x01: 1=TRUE (optional) (Bit 0 (LSB): Optional child present)}, data-constr=V2xFac_IviStructurePresenceType, implementation-data-type=uint8
    V2xFac_IviStructureType: category=STRUCTURE
      element mandatory: implementation-data-type=V2xFac_ManagementContainerType
      element optional: implementation-data-type=V2xFac_optional4Type
      element presence: implementation-data-type=V2xFac_IviStructurePresenceType
    V2xFac_IviTypeType: compu {0=immediateDangerWarningMessages, 1=regulatoryMessages, 2=trafficRelatedInformationMessages, 3=pollutionMessages, 4=notTrafficRelatedInformationMessages}, range raw undefined, implementation-data-type=uint8
    V2xFac_IvimDataPresenceType:
      compu {mask 0x01: 0=FALSE (glc__FALSE) (Bit 0 (LSB): Optional child present), mask 0x01: 1=TRUE (glc) (Bit 0 (LSB): Optional child present), mask 0x02: 0=FALSE (gic__FALSE) (Bit 1: Optional child present), mask 0x02: 2=TRUE (gic) (Bit 1: Optional child present), mask 0x04: 0=FALSE (rcc__FALSE) (Bit 2: Optional child present), mask 0x04: 4=TRUE (rcc) (Bit 2: Optional child present), mask 0x08: 0=FALSE (tc__FALSE) (Bit 3: Optional child present), mask 0x08: 8=TRUE (tc) (Bit 3: Optional child present), mask 0x10: 0=FALSE (lac__FALSE) (Bit 4: Optional child present), mask 0x10: 16=TRUE (lac) (Bit 4: Optional child present)}
      data-constr=V2xFac_IvimDataPresenceType
      implementation-data-type=uint8
    V2xFac_IvimDataType: category=STRUCTURE
      8 x element, all with category=TYPE_REFERENCE:
        management: implementation-data-type=V2xFac_ManagementContainerType
        glc: implementation-data-type=V2xFac_GeographicLocationContainerType
        gic: implementation-data-type=V2xFac_GeneralIviContainerType
        rcc: implementation-data-type=V2xFac_RoadConfigurationContainerType
        tc: implementation-data-type=V2xFac_TextContainerType
        lac: implementation-data-type=V2xFac_LayoutContainerType
        transactionId: implementation-data-type=uint32
        presence: implementation-data-type=V2xFac_IvimDataPresenceType
    V2xFac_LaneAttributesType: category=STRUCTURE
      element directionalUse: implementation-data-type=V2xFac_LaneDirectionType
      element sharedWith: implementation-data-type=V2xFac_LaneSharingType
      element laneType: implementation-data-type=V2xFac_LaneTypeAttributesType
    V2xFac_LaneAttributes_BarrierType:
      compu {mask 0x01: 0=FALSE (median_RevocableLane__FALSE) (--), mask 0x01: 1=TRUE (median_RevocableLane) (--), mask 0x02: 0=FALSE (median__FALSE) (--), mask 0x02: 2=TRUE (median) (--), mask 0x04: 0=FALSE (whiteLineHashing__FALSE) (--), mask 0x04: 4=TRUE (whiteLineHashing) (--), mask 0x08: 0=FALSE (stripedLines__FALSE) (--), mask 0x08: 8=TRUE (stripedLines) (--), mask 0x10: 0=FALSE (doubleStripedLines__FALSE) (--), mask 0x10: 16=TRUE (doubleStripedLines) (--), mask 0x20: 0=FALSE (trafficCones__FALSE) (--), mask 0x20: 32=TRUE (trafficCones) (--), mask 0x40: 0=FALSE (constructionBarrier__FALSE) (--), mask 0x40: 64=TRUE (constructionBarrier) (--), mask 0x80: 0=FALSE (trafficChannels__FALSE) (--), mask 0x80: 128=TRUE (trafficChannels) (--), mask 0x100: 0=FALSE (lowCurbs__FALSE) (--), mask 0x100: 256=TRUE (lowCurbs) (--), mask 0x200: 0=FALSE (highCurbs__FALSE) (--), mask 0x200: 512=TRUE (highCurbs) (--)}
      data-constr=V2xFac_LaneAttributes_BarrierType
      implementation-data-type=uint8
    V2xFac_LaneAttributes_BikeType:
      compu {mask 0x01: 0=FALSE (bikeRevocableLane__FALSE) (--), mask 0x01: 1=TRUE (bikeRevocableLane) (--), mask 0x02: 0=FALSE (pedestrianUseAllowed__FALSE) (--), mask 0x02: 2=TRUE (pedestrianUseAllowed) (--), mask 0x04: 0=FALSE (isBikeFlyOverLane__FALSE) (--), mask 0x04: 4=TRUE (isBikeFlyOverLane) (--), mask 0x08: 0=FALSE (fixedCycleTime__FALSE) (--), mask 0x08: 8=TRUE (fixedCycleTime) (--), mask 0x10: 0=FALSE (biDirectionalCycleTimes__FALSE) (--), mask 0x10: 16=TRUE (biDirectionalCycleTimes) (--), mask 0x20: 0=FALSE (isolatedByBarrier__FALSE) (--), mask 0x20: 32=TRUE (isolatedByBarrier) (--), mask 0x40: 0=FALSE (unsignalizedSegmentsPresent__FALSE) (--), mask 0x40: 64=TRUE (unsignalizedSegmentsPresent) (--)}
      data-constr=V2xFac_LaneAttributes_BikeType
      implementation-data-type=uint8
    V2xFac_LaneAttributes_CrosswalkType:
      compu {mask 0x01: 0=FALSE (crosswalkRevocableLane__FALSE) (--), mask 0x01: 1=TRUE (crosswalkRevocableLane) (--), mask 0x02: 0=FALSE (bicyleUseAllowed__FALSE) (--), mask 0x02: 2=TRUE (bicyleUseAllowed) (--), mask 0x04: 0=FALSE (isXwalkFlyOverLane__FALSE) (--), mask 0x04: 4=TRUE (isXwalkFlyOverLane) (--), mask 0x08: 0=FALSE (fixedCycleTime__FALSE) (--), mask 0x08: 8=TRUE (fixedCycleTime) (--), mask 0x10: 0=FALSE (biDirectionalCycleTimes__FALSE) (--), mask 0x10: 16=TRUE (biDirectionalCycleTimes) (--), mask 0x20: 0=FALSE (hasPushToWalkButton__FALSE) (--), mask 0x20: 32=TRUE (hasPushToWalkButton) (--), mask 0x40: 0=FALSE (audioSupport__FALSE) (--), mask 0x40: 64=TRUE (audioSupport) (--), mask 0x80: 0=FALSE (rfSignalRequestPresent__FALSE) (--), mask 0x80: 128=TRUE (rfSignalRequestPresent) (--), mask 0x100: 0=FALSE (unsignalizedSegmentsPresent__FALSE) (--), mask 0x100: 256=TRUE (unsignalizedSegmentsPresent) (--)}
      data-constr=V2xFac_LaneAttributes_CrosswalkType
      implementation-data-type=uint8
    V2xFac_LaneAttributes_ParkingType:
      compu {mask 0x01: 0=FALSE (parkingRevocableLane__FALSE) (--), mask 0x01: 1=TRUE (parkingRevocableLane) (--), mask 0x02: 0=FALSE (parallelParkingInUse__FALSE) (--), mask 0x02: 2=TRUE (parallelParkingInUse) (--), mask 0x04: 0=FALSE (headInParkingInUse__FALSE) (--), mask 0x04: 4=TRUE (headInParkingInUse) (--), mask 0x08: 0=FALSE (doNotParkZone__FALSE) (--), mask 0x08: 8=TRUE (doNotParkZone) (--), mask 0x10: 0=FALSE (parkingForBusUse__FALSE) (--), mask 0x10: 16=TRUE (parkingForBusUse) (--), mask 0x20: 0=FALSE (parkingForTaxiUse__FALSE) (--), mask 0x20: 32=TRUE (parkingForTaxiUse) (--), mask 0x40: 0=FALSE (noPublicParkingUse__FALSE) (--), mask 0x40: 64=TRUE (noPublicParkingUse) (--)}
      data-constr=V2xFac_LaneAttributes_ParkingType
      implementation-data-type=uint8
    V2xFac_LaneAttributes_SidewalkType:
      compu {mask 0x01: 0=FALSE (sidewalk_RevocableLane__FALSE) (--), mask 0x01: 1=TRUE (sidewalk_RevocableLane) (--), mask 0x02: 0=FALSE (bicyleUseAllowed__FALSE) (--), mask 0x02: 2=TRUE (bicyleUseAllowed) (--), mask 0x04: 0=FALSE (isSidewalkFlyOverLane__FALSE) (--), mask 0x04: 4=TRUE (isSidewalkFlyOverLane) (--), mask 0x08: 0=FALSE (walkBikes__FALSE) (--), mask 0x08: 8=TRUE (walkBikes) (--)}
      data-constr=V2xFac_LaneAttributes_SidewalkType
      implementation-data-type=uint8
    V2xFac_LaneAttributes_StripingType:
      compu {mask 0x01: 0=FALSE (stripeToConnectingLanesRevocableLane__FALSE) (--), mask 0x01: 1=TRUE (stripeToConnectingLanesRevocableLane) (--), mask 0x02: 0=FALSE (stripeDrawOnLeft__FALSE) (--), mask 0x02: 2=TRUE (stripeDrawOnLeft) (--), mask 0x04: 0=FALSE (stripeDrawOnRight__FALSE) (--), mask 0x04: 4=TRUE (stripeDrawOnRight) (--), mask 0x08: 0=FALSE (stripeToConnectingLanesLeft__FALSE) (--), mask 0x08: 8=TRUE (stripeToConnectingLanesLeft) (--), mask 0x10: 0=FALSE (stripeToConnectingLanesRight__FALSE) (--), mask 0x10: 16=TRUE (stripeToConnectingLanesRight) (--), mask 0x20: 0=FALSE (stripeToConnectingLanesAhead__FALSE) (--), mask 0x20: 32=TRUE (stripeToConnectingLanesAhead) (--)}
      data-constr=V2xFac_LaneAttributes_StripingType
      implementation-data-type=uint8
    V2xFac_LaneAttributes_TrackedVehicleType:
      compu {mask 0x01: 0=FALSE (spec_RevocableLane__FALSE) (--), mask 0x01: 1=TRUE (spec_RevocableLane) (--), mask 0x02: 0=FALSE (spec_commuterRailRoadTrack__FALSE) (--), mask 0x02: 2=TRUE (spec_commuterRailRoadTrack) (--), mask 0x04: 0=FALSE (spec_lightRailRoadTrack__FALSE) (--), mask 0x04: 4=TRUE (spec_lightRailRoadTrack) (--), mask 0x08: 0=FALSE (spec_heavyRailRoadTrack__FALSE) (--), mask 0x08: 8=TRUE (spec_heavyRailRoadTrack) (--), mask 0x10: 0=FALSE (spec_otherRailType__FALSE) (--), mask 0x10: 16=TRUE (spec_otherRailType) (--)}
      data-constr=V2xFac_LaneAttributes_TrackedVehicleType
      implementation-data-type=uint8
    V2xFac_LaneAttributes_VehicleType:
      compu {mask 0x01: 0=FALSE (isVehicleRevocableLane__FALSE) (--), mask 0x01: 1=TRUE (isVehicleRevocableLane) (--), mask 0x02: 0=FALSE (isVehicleFlyOverLane__FALSE) (--), mask 0x02: 2=TRUE (isVehicleFlyOverLane) (--), mask 0x04: 0=FALSE (hovLaneUseOnly__FALSE) (--), mask 0x04: 4=TRUE (hovLaneUseOnly) (--), mask 0x08: 0=FALSE (restrictedToBusUse__FALSE) (--), mask 0x08: 8=TRUE (restrictedToBusUse) (--), mask 0x10: 0=FALSE (restrictedToTaxiUse__FALSE) (--), mask 0x10: 16=TRUE (restrictedToTaxiUse) (--), mask 0x20: 0=FALSE (restrictedFromPublicUse__FALSE) (--), mask 0x20: 32=TRUE (restrictedFromPublicUse) (--), mask 0x40: 0=FALSE (hasIRbeaconCoverage__FALSE) (--), mask 0x40: 64=TRUE (hasIRbeaconCoverage) (--), mask 0x80: 0=FALSE (permissionOnRequest__FALSE) (--), mask 0x80: 128=TRUE (permissionOnRequest) (--)}
      data-constr=V2xFac_LaneAttributes_VehicleType
      implementation-data-type=uint8
    V2xFac_LaneConnectionIDType: range raw undefined, implementation-data-type=uint8
    V2xFac_LaneDataAttributeChoiceType: compu {0x01=V2XFAC_LANEDATAATTRIBUTE_PATH_END_POINT_ANGLE, 0x02=V2XFAC_LANEDATAATTRIBUTE_LANE_CROWN_POINT_CENTER, 0x03=V2XFAC_LANEDATAATTRIBUTE_LANE_CROWN_POINT_LEFT, 0x04=V2XFAC_LANEDATAATTRIBUTE_LANE_CROWN_POINT_RIGHT, 0x05=V2XFAC_LANEDATAATTRIBUTE_LANE_ANGLE, 0x06=V2XFAC_LANEDATAATTRIBUTE_SPEED_LIMITS, 0x07=V2XFAC_LANEDATAATTRIBUTE_REGIONAL}, range raw 0x01..0x07
    V2xFac_LaneDataAttributeListType: category=STRUCTURE
      element count: implementation-data-type=uint8
      element values: category=ARRAY, array-size-semantics=FIXED-SIZE
        element values: array-size=undefined, array-size-semantics=FIXED-SIZE, implementation-data-type=V2xFac_LaneDataAttributeType
    V2xFac_LaneDataAttributeType: category=STRUCTURE
      7 x element, all with category=TYPE_REFERENCE:
        pathEndPointAngle: implementation-data-type=V2xFac_DeltaAngleType
        laneCrownPointCenter: implementation-data-type=V2xFac_RoadwayCrownAngleType
        laneCrownPointLeft: implementation-data-type=V2xFac_RoadwayCrownAngleType
        laneCrownPointRight: implementation-data-type=V2xFac_RoadwayCrownAngleType
        laneAngle: implementation-data-type=V2xFac_MergeDivergeNodeAngleType
        speedLimits: implementation-data-type=V2xFac_SpeedLimitListType
        choice: implementation-data-type=V2xFac_LaneDataAttributeChoiceType
    V2xFac_LaneDirectionType: compu {mask 0x01: 0=FALSE (ingressPath__FALSE) (--), mask 0x01: 1=TRUE (ingressPath) (--), mask 0x02: 0=FALSE (egressPath__FALSE) (--), mask 0x02: 2=TRUE (egressPath) (--)}, data-constr=V2xFac_LaneDirectionType, implementation-data-type=uint8
    V2xFac_LaneIDType: range raw undefined, implementation-data-type=uint8
    V2xFac_LaneInformationPresenceType:
      compu {mask 0x01: 0=FALSE (validity__FALSE) (Bit 0 (LSB): Optional child present), mask 0x01: 1=TRUE (validity) (Bit 0 (LSB): Optional child present), mask 0x02: 0=FALSE (laneTypeQualifier__FALSE) (Bit 1: Optional child present), mask 0x02: 2=TRUE (laneTypeQualifier) (Bit 1: Optional child present), mask 0x04: 0=FALSE (laneWidth__FALSE) (Bit 2: Optional child present), mask 0x04: 4=TRUE (laneWidth) (Bit 2: Optional child present)}
      data-constr=V2xFac_LaneInformationPresenceType
      implementation-data-type=uint8
    V2xFac_LaneInformationType: category=STRUCTURE
      8 x element, all with category=TYPE_REFERENCE:
        laneNumber: implementation-data-type=V2xFac_LanePositionType
        direction: implementation-data-type=V2xFac_DirectionType
        validity: implementation-data-type=V2xFac_DTMType
        laneType: implementation-data-type=V2xFac_LaneTypeType
        laneTypeQualifier: implementation-data-type=V2xFac_CompleteVehicleCharacteristicsType
        laneStatus: implementation-data-type=V2xFac_LaneStatusType
        laneWidth: implementation-data-type=V2xFac_LaneWidthType
        presence: implementation-data-type=V2xFac_LaneInformationPresenceType
    V2xFac_LaneListType: category=STRUCTURE
      element count: implementation-data-type=uint8
      element values: category=ARRAY, array-size-semantics=FIXED-SIZE
        element values: array-size=undefined, array-size-semantics=FIXED-SIZE, implementation-data-type=V2xFac_GenericLaneType
    V2xFac_LanePositionType: compu {-1=offTheRoad, 0=hardShoulder, 1=outermostDrivingLane, 2=secondLaneFromOutside}, range raw undefined, implementation-data-type=sint8
    V2xFac_LaneSharingType:
      compu {mask 0x01: 0=FALSE (overlappingLaneDescriptionProvided__FALSE) (--), mask 0x01: 1=TRUE (overlappingLaneDescriptionProvided) (--), mask 0x02: 0=FALSE (multipleLanesTreatedAsOneLane__FALSE) (--), mask 0x02: 2=TRUE (multipleLanesTreatedAsOneLane) (--), mask 0x04: 0=FALSE (otherNonMotorizedTrafficTypes__FALSE) (--), mask 0x04: 4=TRUE (otherNonMotorizedTrafficTypes) (--), mask 0x08: 0=FALSE (individualMotorizedVehicleTraffic__FALSE) (--), mask 0x08: 8=TRUE (individualMotorizedVehicleTraffic) (--), mask 0x10: 0=FALSE (busVehicleTraffic__FALSE) (--), mask 0x10: 16=TRUE (busVehicleTraffic) (--), mask 0x20: 0=FALSE (taxiVehicleTraffic__FALSE) (--), mask 0x20: 32=TRUE (taxiVehicleTraffic) (--), mask 0x40: 0=FALSE (pedestriansTraffic__FALSE) (--), mask 0x40: 64=TRUE (pedestriansTraffic) (--), mask 0x80: 0=FALSE (cyclistVehicleTraffic__FALSE) (--), mask 0x80: 128=TRUE (cyclistVehicleTraffic) (--), mask 0x100: 0=FALSE (trackedVehicleTraffic__FALSE) (--), mask 0x100: 256=TRUE (trackedVehicleTraffic) (--), mask 0x200: 0=FALSE (pedestrianTraffic__FALSE) (--), mask 0x200: 512=TRUE (pedestrianTraffic) (--)}
      data-constr=V2xFac_LaneSharingType
      implementation-data-type=uint8
    V2xFac_LaneStatusType: compu {0=open, 1=closed, 2=mergeR, 3=mergeL, 4=mergeLR, 5=provisionallyOpen, 6=diverging}, range raw undefined, implementation-data-type=uint8
    V2xFac_LaneTypeAttributesChoiceType: compu {0x01=V2XFAC_LANETYPEATTRIBUTES_VEHICLE, 0x02=V2XFAC_LANETYPEATTRIBUTES_CROSSWALK, 0x03=V2XFAC_LANETYPEATTRIBUTES_BIKE_LANE, 0x04=V2XFAC_LANETYPEATTRIBUTES_SIDEWALK, 0x05=V2XFAC_LANETYPEATTRIBUTES_MEDIAN, 0x06=V2XFAC_LANETYPEATTRIBUTES_STRIPING, 0x07=V2XFAC_LANETYPEATTRIBUTES_TRACKED_VEHICLE, 0x08=V2XFAC_LANETYPEATTRIBUTES_PARKING}, range raw 0x01..0x08
    V2xFac_LaneTypeAttributesType: category=STRUCTURE
      9 x element, all with category=TYPE_REFERENCE:
        vehicle: implementation-data-type=V2xFac_LaneAttributes_VehicleType
        crosswalk: implementation-data-type=V2xFac_LaneAttributes_CrosswalkType
        bikeLane: implementation-data-type=V2xFac_LaneAttributes_BikeType
        sidewalk: implementation-data-type=V2xFac_LaneAttributes_SidewalkType
        median: implementation-data-type=V2xFac_LaneAttributes_BarrierType
        striping: implementation-data-type=V2xFac_LaneAttributes_StripingType
        trackedVehicle: implementation-data-type=V2xFac_LaneAttributes_TrackedVehicleType
        parking: implementation-data-type=V2xFac_LaneAttributes_ParkingType
        choice: implementation-data-type=V2xFac_LaneTypeAttributesChoiceType
    V2xFac_LaneTypeType: compu {0=traffic, 1=through, 2=reversible, 3=acceleration, 4=deceleration, 5=leftHandTurning, 6=rightHandTurning, 7=dedicatedVehicle, 8=bus, 9=taxi, 10=hov, 11=hot, 12=pedestrian, 13=bikeLane, 14=median, 15=striping, 16=trackedVehicle, 17=parking, 18=emergency, 19=verge}, range raw undefined, implementation-data-type=uint8
    V2xFac_LaneWidthType: range raw undefined, implementation-data-type=uint16
    V2xFac_LateralAccelerationType: category=STRUCTURE
      element lateralAccelerationValue: implementation-data-type=sint16
      element lateralAccelerationConfidence: implementation-data-type=uint8
    V2xFac_LateralAccelerationValueType: compu {-1=pointOneMeterPerSecSquaredToRight, 1=pointOneMeterPerSecSquaredToLeft, 161=unavailable}, range raw undefined, implementation-data-type=sint16
    V2xFac_LatitudeType: compu {10=oneMicrodegreeNorth, -10=oneMicrodegreeSouth, 900000001=unavailable}, range raw undefined, implementation-data-type=sint32
    V2xFac_LayerIDType: range raw undefined, implementation-data-type=uint8
    V2xFac_LayerTypeType: compu {0=none, 1=mixedContent, 2=generalMapData, 3=intersectionData, 4=curveData, 5=roadwaySectionData, 6=parkingAreaData, 7=sharedLaneData}, range raw 0..7
    V2xFac_LayoutComponentType: category=STRUCTURE
      6 x element, all with category=TYPE_REFERENCE:
        layoutComponentId: implementation-data-type=uint8
        height: implementation-data-type=uint8
        width: implementation-data-type=uint16
        x: implementation-data-type=uint16
        y: implementation-data-type=uint8
        textScripting: implementation-data-type=V2xFac_textScripting53Type
    V2xFac_LayoutContainerPresenceType: compu {mask 0x01: 0=FALSE (height__FALSE) (Bit 0 (LSB): Optional child present), mask 0x01: 1=TRUE (height) (Bit 0 (LSB): Optional child present), mask 0x02: 0=FALSE (width__FALSE) (Bit 1: Optional child present), mask 0x02: 2=TRUE (width) (Bit 1: Optional child present)}, data-constr=V2xFac_LayoutContainerPresenceType, implementation-data-type=uint8
    V2xFac_LayoutContainerType: category=STRUCTURE
      5 x element, all with category=TYPE_REFERENCE:
        layoutId: implementation-data-type=uint8
        height: implementation-data-type=uint8
        width: implementation-data-type=uint16
        layoutComponents: implementation-data-type=V2xFac_layoutComponents30Type
        presence: implementation-data-type=V2xFac_LayoutContainerPresenceType
    V2xFac_LightBarSirenInUseType: compu {mask 0x02: 0=FALSE (lightBarActivated__FALSE) (Bit 1: light bar activated), mask 0x02: 2=TRUE (lightBarActivated) (Bit 1: light bar activated), mask 0x01: 0=FALSE (sirenActivated__FALSE) (Bit 0 (LSB): siren activated), mask 0x01: 1=TRUE (sirenActivated) (Bit 0 (LSB): siren activated)}, range raw 0x00..0x03, implementation-data-type=uint8
    V2xFac_LoadTypeType: category=STRUCTURE
      element goodsType: implementation-data-type=V2xFac_GoodsTypeType
      element dangerousGoodsType: implementation-data-type=V2xFac_DangerousGoodsBasicType
      element specialTransportType: implementation-data-type=V2xFac_SpecialTransportTypeType
    V2xFac_LocationContainerPresenceType:
      compu {mask 0x04: 0=FALSE (eventSpeed__FALSE) (Bit 2: Optional child present), mask 0x04: 4=TRUE (eventSpeed) (Bit 2: Optional child present), mask 0x02: 0=FALSE (eventPositionHeading__FALSE) (Bit 1: Optional child present), mask 0x02: 2=TRUE (eventPositionHeading) (Bit 1: Optional child present), mask 0x01: 0=FALSE (roadType__FALSE) (Bit 0 (LSB): Optional child present), mask 0x01: 1=TRUE (roadType) (Bit 0 (LSB): Optional child present)}
      range raw 0x00..0x07
      implementation-data-type=uint8
    V2xFac_LocationContainerType: category=STRUCTURE
      5 x element, all with category=TYPE_REFERENCE:
        presence: implementation-data-type=V2xFac_LocationContainerPresenceType
        eventSpeed: implementation-data-type=V2xFac_SpeedType
        eventPositionHeading: implementation-data-type=V2xFac_HeadingType
        traces: implementation-data-type=V2xFac_TracesType
        roadType: implementation-data-type=V2xFac_RoadTypeType
    V2xFac_LongitudeType: compu {10=oneMicrodegreeEast, -10=oneMicrodegreeWest, 1800000001=unavailable}, range raw undefined, implementation-data-type=sint32
    V2xFac_LongitudinalAccelerationType: category=STRUCTURE
      element longitudinalAccelerationValue: implementation-data-type=sint16
      element longitudinalAccelerationConfidence: implementation-data-type=uint8
    V2xFac_LongitudinalAccelerationValueType: compu {1=pointOneMeterPerSecSquaredForward, -1=pointOneMeterPerSecSquaredBackward, 161=unavailable}, range raw undefined, implementation-data-type=sint16
    V2xFac_LowFrequencyContainerChoiceType: compu {0x01=V2XFAC_LOWFREQCONTAINER_BASIC_VEHICLE_CONTAINER_LOW_FREQ}, range raw 0x01, implementation-data-type=uint8
    V2xFac_LowFrequencyContainerType: category=STRUCTURE
      element choice: implementation-data-type=V2xFac_LowFrequencyContainerChoiceType
      element basicVehicleContainerLowFrequency: implementation-data-type=V2xFac_BasicVehicleContainerLowFrequencyType
    V2xFac_ManagementContainerPresenceType:
      compu {mask 0x08: 0=FALSE (termination__FALSE) (Bit 3: Optional child present), mask 0x08: 8=TRUE (termination) (Bit 3: Optional child present), mask 0x04: 0=FALSE (relevanceDistance__FALSE) (Bit 2: Optional child present), mask 0x04: 4=TRUE (relevanceDistance) (Bit 2: Optional child present), mask 0x02: 0=FALSE (relevanceTrafficDirection__FALSE) (Bit 1: Optional child present), mask 0x02: 2=TRUE (relevanceTrafficDirection) (Bit 1: Optional child present), mask 0x01: 0=FALSE (transmissionInterval__FALSE) (Bit 0 (LSB): Optional child present), mask 0x01: 1=TRUE (transmissionInterval) (Bit 0 (LSB): Optional child present)}
      range raw 0x00..0x0F
      implementation-data-type=uint8
    V2xFac_ManagementContainerType: category=STRUCTURE
      11 x element, all with category=TYPE_REFERENCE:
        presence: implementation-data-type=V2xFac_ManagementContainerPresenceType
        actionId: implementation-data-type=V2xFac_ActionIdType
        detectionTime: implementation-data-type=uint64
        referenceTime: implementation-data-type=uint64
        termination: implementation-data-type=V2xFac_TerminationType
        eventPosition: implementation-data-type=V2xFac_ReferencePositionType
        relevanceDistance: implementation-data-type=V2xFac_RelevanceDistanceType
        relevanceTrafficDirection: implementation-data-type=V2xFac_RelevanceTrafficDirectionType
        validityDuration: implementation-data-type=uint32
        transmissionInterval: implementation-data-type=uint16
        stationType: implementation-data-type=uint8
    V2xFac_ManeuverAssistListType: category=STRUCTURE
      element count: implementation-data-type=uint8
      element values: category=ARRAY, array-size-semantics=FIXED-SIZE
        element values: array-size=undefined, array-size-semantics=FIXED-SIZE, implementation-data-type=V2xFac_ConnectionManeuverAssistType
    V2xFac_MapDataPresenceType:
      compu {mask 0x01: 0=FALSE (timeStamp__FALSE) (Bit 0 (LSB): Optional child present), mask 0x01: 1=TRUE (timeStamp) (Bit 0 (LSB): Optional child present), mask 0x02: 0=FALSE (layerType__FALSE) (Bit 1: Optional child present), mask 0x02: 2=TRUE (layerType) (Bit 1: Optional child present), mask 0x04: 0=FALSE (layerID__FALSE) (Bit 2: Optional child present), mask 0x04: 4=TRUE (layerID) (Bit 2: Optional child present), mask 0x08: 0=FALSE (intersections__FALSE) (Bit 3: Optional child present), mask 0x08: 8=TRUE (intersections) (Bit 3: Optional child present), mask 0x10: 0=FALSE (roadSegments__FALSE) (Bit 4: Optional child present), mask 0x10: 16=TRUE (roadSegments) (Bit 4: Optional child present), mask 0x20: 0=FALSE (dataParameters__FALSE) (Bit 5: Optional child present), mask 0x20: 32=TRUE (dataParameters) (Bit 5: Optional child present), mask 0x40: 0=FALSE (restrictionList__FALSE) (Bit 6: Optional child present), mask 0x40: 64=TRUE (restrictionList) (Bit 6: Optional child present)}
      data-constr=V2xFac_MapDataPresenceType
      implementation-data-type=uint8
    V2xFac_MapDataType: category=STRUCTURE
      9 x element, all with category=TYPE_REFERENCE:
        timeStamp: implementation-data-type=V2xFac_MinuteOfTheYearType
        msgIssueRevision: implementation-data-type=V2xFac_MsgCountType
        layerType: implementation-data-type=V2xFac_LayerTypeType
        layerID: implementation-data-type=V2xFac_LayerIDType
        intersections: implementation-data-type=V2xFac_IntersectionGeometryListType
        roadSegments: implementation-data-type=V2xFac_RoadSegmentListType
        dataParameters: implementation-data-type=V2xFac_DataParametersType
        restrictionList: implementation-data-type=V2xFac_RestrictionClassListType
        presence: implementation-data-type=V2xFac_MapDataPresenceType
    V2xFac_MapemDataPresenceType:
      compu {mask 0x01: 0=FALSE (timeStamp__FALSE) (Bit 0 (LSB): Optional child present), mask 0x01: 1=TRUE (timeStamp) (Bit 0 (LSB): Optional child present), mask 0x02: 0=FALSE (layerType__FALSE) (Bit 1: Optional child present), mask 0x02: 2=TRUE (layerType) (Bit 1: Optional child present), mask 0x04: 0=FALSE (layerID__FALSE) (Bit 2: Optional child present), mask 0x04: 4=TRUE (layerID) (Bit 2: Optional child present), mask 0x08: 0=FALSE (intersections__FALSE) (Bit 3: Optional child present), mask 0x08: 8=TRUE (intersections) (Bit 3: Optional child present), mask 0x10: 0=FALSE (roadSegments__FALSE) (Bit 4: Optional child present), mask 0x10: 16=TRUE (roadSegments) (Bit 4: Optional child present), mask 0x20: 0=FALSE (dataParameters__FALSE) (Bit 5: Optional child present), mask 0x20: 32=TRUE (dataParameters) (Bit 5: Optional child present), mask 0x40: 0=FALSE (restrictionList__FALSE) (Bit 6: Optional child present), mask 0x40: 64=TRUE (restrictionList) (Bit 6: Optional child present)}
      data-constr=V2xFac_MapemDataPresenceType
      implementation-data-type=uint8
    V2xFac_MapemDataType: category=STRUCTURE
      10 x element, all with category=TYPE_REFERENCE:
        timeStamp: implementation-data-type=V2xFac_MinuteOfTheYearType
        msgIssueRevision: implementation-data-type=V2xFac_MsgCountType
        layerType: implementation-data-type=V2xFac_LayerTypeType
        layerID: implementation-data-type=V2xFac_LayerIDType
        intersections: implementation-data-type=V2xFac_IntersectionGeometryListType
        roadSegments: implementation-data-type=V2xFac_RoadSegmentListType
        dataParameters: implementation-data-type=V2xFac_DataParametersType
        restrictionList: implementation-data-type=V2xFac_RestrictionClassListType
        transactionId: implementation-data-type=uint32
        presence: implementation-data-type=V2xFac_MapemDataPresenceType
    V2xFac_MergeDivergeNodeAngleType: range raw undefined, implementation-data-type=sint16
    V2xFac_MinuteOfTheYearType: range raw undefined, implementation-data-type=uint32
    V2xFac_MonthDayType: category=STRUCTURE
      element month: implementation-data-type=uint8
      element day: implementation-data-type=uint8
    V2xFac_MovementEventListType: category=STRUCTURE
      element count: implementation-data-type=uint8
      element values: category=ARRAY, array-size-semantics=FIXED-SIZE
        element values: array-size=undefined, array-size-semantics=FIXED-SIZE, implementation-data-type=V2xFac_MovementEventType
    V2xFac_MovementEventPresenceType: compu {mask 0x01: 0=FALSE (timing__FALSE) (Bit 0 (LSB): Optional child present), mask 0x01: 1=TRUE (timing) (Bit 0 (LSB): Optional child present), mask 0x02: 0=FALSE (speeds__FALSE) (Bit 1: Optional child present), mask 0x02: 2=TRUE (speeds) (Bit 1: Optional child present)}, data-constr=V2xFac_MovementEventPresenceType, implementation-data-type=uint8
    V2xFac_MovementEventType: category=STRUCTURE
      4 x element, all with category=TYPE_REFERENCE:
        eventState: implementation-data-type=V2xFac_MovementPhaseStateType
        timing: implementation-data-type=V2xFac_TimeChangeDetailsType
        speeds: implementation-data-type=V2xFac_AdvisorySpeedListType
        presence: implementation-data-type=V2xFac_MovementEventPresenceType
    V2xFac_MovementListType: category=STRUCTURE
      element count: implementation-data-type=uint8
      element values: category=ARRAY, array-size-semantics=FIXED-SIZE
        element values: array-size=undefined, array-size-semantics=FIXED-SIZE, implementation-data-type=V2xFac_MovementStateType
    V2xFac_MovementPhaseStateType: compu {0=unavailable, 1=dark, 2=stop_Then_Proceed, 3=stop_And_Remain, 4=pre_Movement, 5=permissive_Movement_Allowed, 6=protected_Movement_Allowed, 7=permissive_clearance, 8=protected_clearance, 9=caution_Conflicting_Traffic}, range raw 0..9
    V2xFac_MovementStatePresenceType: compu {mask 0x01: 0=FALSE (movementName__FALSE) (Bit 0 (LSB): Optional child present), mask 0x01: 1=TRUE (movementName) (Bit 0 (LSB): Optional child present), mask 0x02: 0=FALSE (maneuverAssistList__FALSE) (Bit 1: Optional child present), mask 0x02: 2=TRUE (maneuverAssistList) (Bit 1: Optional child present)}, data-constr=V2xFac_MovementStatePresenceType, implementation-data-type=uint8
    V2xFac_MovementStateType: category=STRUCTURE
      5 x element, all with category=TYPE_REFERENCE:
        movementName: implementation-data-type=V2xFac_DescriptiveNameType
        signalGroup: implementation-data-type=V2xFac_SignalGroupIDType
        state_time_speed: implementation-data-type=V2xFac_MovementEventListType
        maneuverAssistList: implementation-data-type=V2xFac_ManeuverAssistListType
        presence: implementation-data-type=V2xFac_MovementStatePresenceType
    V2xFac_MsgCountType: range raw undefined, implementation-data-type=uint8
    V2xFac_NULLType: range raw undefined
    V2xFac_NodeAttributeSetXYPresenceType:
      compu {mask 0x01: 0=FALSE (localNode__FALSE) (Bit 0 (LSB): Optional child present), mask 0x01: 1=TRUE (localNode) (Bit 0 (LSB): Optional child present), mask 0x02: 0=FALSE (disabled__FALSE) (Bit 1: Optional child present), mask 0x02: 2=TRUE (disabled) (Bit 1: Optional child present), mask 0x04: 0=FALSE (enabled__FALSE) (Bit 2: Optional child present), mask 0x04: 4=TRUE (enabled) (Bit 2: Optional child present), mask 0x08: 0=FALSE (data__FALSE) (Bit 3: Optional child present), mask 0x08: 8=TRUE (data) (Bit 3: Optional child present), mask 0x10: 0=FALSE (dWidth__FALSE) (Bit 4: Optional child present), mask 0x10: 16=TRUE (dWidth) (Bit 4: Optional child present), mask 0x20: 0=FALSE (dElevation__FALSE) (Bit 5: Optional child present), mask 0x20: 32=TRUE (dElevation) (Bit 5: Optional child present)}
      data-constr=V2xFac_NodeAttributeSetXYPresenceType
      implementation-data-type=uint8
    V2xFac_NodeAttributeSetXYType: category=STRUCTURE
      7 x element, all with category=TYPE_REFERENCE:
        localNode: implementation-data-type=V2xFac_NodeAttributeXYListType
        disabled: implementation-data-type=V2xFac_SegmentAttributeXYListType
        enabled: implementation-data-type=V2xFac_SegmentAttributeXYListType
        data: implementation-data-type=V2xFac_LaneDataAttributeListType
        dWidth: implementation-data-type=V2xFac_Offset_B10Type
        dElevation: implementation-data-type=V2xFac_Offset_B10Type
        presence: implementation-data-type=V2xFac_NodeAttributeSetXYPresenceType
    V2xFac_NodeAttributeXYListType: category=STRUCTURE
      element count: implementation-data-type=uint8
      element values: category=ARRAY, array-size-semantics=FIXED-SIZE
        element values: array-size=undefined, array-size-semantics=FIXED-SIZE, implementation-data-type=V2xFac_NodeAttributeXYType
    V2xFac_NodeAttributeXYType: compu {0=reserved, 1=stopLine, 2=roundedCapStyleA, 3=roundedCapStyleB, 4=mergePoint, 5=divergePoint, 6=downstreamStopLine, 7=downstreamStartNode, 8=closedToTraffic, 9=safeIsland, 10=curbPresentAtStepOff, 11=hydrantPresent}, range raw 0..11
    V2xFac_NodeListXYChoiceType: compu {0x01=V2XFAC_NODELISTXY_NODES, 0x02=V2XFAC_NODELISTXY_COMPUTED}, range raw 0x01..0x02
    V2xFac_NodeListXYType: category=STRUCTURE
      element nodes: implementation-data-type=V2xFac_NodeSetXYType
      element computed: implementation-data-type=V2xFac_ComputedLaneType
      element choice: implementation-data-type=V2xFac_NodeListXYChoiceType
    V2xFac_NodeOffsetPointXYChoiceType: compu {0x01=V2XFAC_NODEOFFSETPOINTXY_NODE_XY1, 0x02=V2XFAC_NODEOFFSETPOINTXY_NODE_XY2, 0x03=V2XFAC_NODEOFFSETPOINTXY_NODE_XY3, 0x04=V2XFAC_NODEOFFSETPOINTXY_NODE_XY4, 0x05=V2XFAC_NODEOFFSETPOINTXY_NODE_XY5, 0x06=V2XFAC_NODEOFFSETPOINTXY_NODE_XY6, 0x07=V2XFAC_NODEOFFSETPOINTXY_NODE_LAT_LON, 0x08=V2XFAC_NODEOFFSETPOINTXY_REGIONAL}, range raw 0x01..0x08
    V2xFac_NodeOffsetPointXYType: category=STRUCTURE
      8 x element, all with category=TYPE_REFERENCE:
        node_XY1: implementation-data-type=V2xFac_Node_XY_20bType
        node_XY2: implementation-data-type=V2xFac_Node_XY_22bType
        node_XY3: implementation-data-type=V2xFac_Node_XY_24bType
        node_XY4: implementation-data-type=V2xFac_Node_XY_26bType
        node_XY5: implementation-data-type=V2xFac_Node_XY_28bType
        node_XY6: implementation-data-type=V2xFac_Node_XY_32bType
        node_LatLon: implementation-data-type=V2xFac_Node_LLmD_64bType
        choice: implementation-data-type=V2xFac_NodeOffsetPointXYChoiceType
    V2xFac_NodeSetXYType: category=STRUCTURE
      element count: implementation-data-type=uint8
      element values: category=ARRAY, array-size-semantics=FIXED-SIZE
        element values: array-size=undefined, array-size-semantics=FIXED-SIZE, implementation-data-type=V2xFac_NodeXYType
    V2xFac_NodeXYPresenceType: compu {mask 0x01: 0=FALSE (attributes__FALSE) (Bit 0 (LSB): Optional child present), mask 0x01: 1=TRUE (attributes) (Bit 0 (LSB): Optional child present)}, data-constr=V2xFac_NodeXYPresenceType, implementation-data-type=uint8
    V2xFac_NodeXYType: category=STRUCTURE
      element delta: implementation-data-type=V2xFac_NodeOffsetPointXYType
      element attributes: implementation-data-type=V2xFac_NodeAttributeSetXYType
      element presence: implementation-data-type=V2xFac_NodeXYPresenceType
    V2xFac_Node_LLmD_64bType: category=STRUCTURE
      element lon: implementation-data-type=V2xFac_LongitudeType
      element lat: implementation-data-type=V2xFac_LatitudeType
    V2xFac_Node_XY_20bType: category=STRUCTURE
      element x: implementation-data-type=V2xFac_Offset_B10Type
      element y: implementation-data-type=V2xFac_Offset_B10Type
    V2xFac_Node_XY_22bType: category=STRUCTURE
      element x: implementation-data-type=V2xFac_Offset_B11Type
      element y: implementation-data-type=V2xFac_Offset_B11Type
    V2xFac_Node_XY_24bType: category=STRUCTURE
      element x: implementation-data-type=V2xFac_Offset_B12Type
      element y: implementation-data-type=V2xFac_Offset_B12Type
    V2xFac_Node_XY_26bType: category=STRUCTURE
      element x: implementation-data-type=V2xFac_Offset_B13Type
      element y: implementation-data-type=V2xFac_Offset_B13Type
    V2xFac_Node_XY_28bType: category=STRUCTURE
      element x: implementation-data-type=V2xFac_Offset_B14Type
      element y: implementation-data-type=V2xFac_Offset_B14Type
    V2xFac_Node_XY_32bType: category=STRUCTURE
      element x: implementation-data-type=V2xFac_Offset_B16Type
      element y: implementation-data-type=V2xFac_Offset_B16Type
    V2xFac_NumberOfOccupantsType: compu {1=oneOccupant, 127=unavailable}, range raw undefined, implementation-data-type=uint8
    V2xFac_Offset_B{10..14}Type: range raw undefined, implementation-data-type=sint16
    V2xFac_Offset_B16Type: range raw undefined, implementation-data-type=sint16
    V2xFac_OverlayLaneListType: category=STRUCTURE
      element count: implementation-data-type=uint8
      element values: category=ARRAY, array-size-semantics=FIXED-SIZE
        element values: array-size=undefined, array-size-semantics=FIXED-SIZE, implementation-data-type=V2xFac_LaneIDType
    V2xFac_PMDType: compu {mask 0x01: 0=FALSE (national_holiday__FALSE) (--), mask 0x01: 1=TRUE (national_holiday) (--), mask 0x02: 0=FALSE (even_days__FALSE) (--), mask 0x02: 2=TRUE (even_days) (--), mask 0x04: 0=FALSE (odd_days__FALSE) (--), mask 0x04: 4=TRUE (odd_days) (--), mask 0x08: 0=FALSE (market_day__FALSE) (--), mask 0x08: 8=TRUE (market_day) (--)}, data-constr=V2xFac_PMDType, implementation-data-type=uint8
    V2xFac_PassengerCapacityType: category=STRUCTURE
      element numberOfSeats: implementation-data-type=V2xFac_Int1Type
      element numberOfStandingPlaces: implementation-data-type=V2xFac_Int1Type
    V2xFac_PathDeltaTimeType: compu {1=tenMilliSecondsInPast}, range raw undefined, implementation-data-type=uint16
    V2xFac_PathHistoryType: category=STRUCTURE
      element count: implementation-data-type=uint8
      element values: category=ARRAY, array-size-semantics=FIXED-SIZE
        element values: array-size=undefined, array-size-semantics=FIXED-SIZE, implementation-data-type=V2xFac_PathPointType
    V2xFac_PathPointPresenceType: compu {mask 0x01: 0=FALSE (pathDeltaTime__FALSE) (Bit 0 (LSB): Optional child present), mask 0x01: 1=TRUE (pathDeltaTime) (Bit 0 (LSB): Optional child present)}, range raw 0x00..0x01, implementation-data-type=uint8
    V2xFac_PathPointType: category=STRUCTURE
      element presence: implementation-data-type=V2xFac_PathPointPresenceType
      element pathPosition: implementation-data-type=V2xFac_DeltaReferencePositionType
      element pathDeltaTime: implementation-data-type=uint16
    V2xFac_PedestrianBicycleDetectType: compu {mask 0x00: 0=FALSE (value__FALSE) (false if 0, true otherwise), mask 0x00: 0=TRUE (value) (false if 0, true otherwise)}, data-constr=V2xFac_PedestrianBicycleDetectType, implementation-data-type=uint8
    V2xFac_PerformanceClassType: compu {0=unavailable, 1=performanceClassA, 2=performanceClassB}, range raw undefined, implementation-data-type=uint8
    V2xFac_PhoneNumberType: category=STRUCTURE
      element count: implementation-data-type=uint8
      element values: category=ARRAY, array-size-semantics=FIXED-SIZE
        element values: array-size=undefined, array-size-semantics=FIXED-SIZE, implementation-data-type=uint8
    V2xFac_PolygonalLineChoiceType: compu {0x01=V2XFAC_POLYGONALLINE_DELTA_POSITIONS, 0x02=V2XFAC_POLYGONALLINE_DELTA_POSITIONS_WITH_ALTITUDE, 0x03=V2XFAC_POLYGONALLINE_ABSOLUTE_POSITIONS, 0x04=V2XFAC_POLYGONALLINE_ABSOLUTE_POSITIONS_WITH_ALTITUDE}, range raw 0x01..0x04
    V2xFac_PolygonalLineType: category=STRUCTURE
      5 x element, all with category=TYPE_REFERENCE:
        deltaPositions: implementation-data-type=V2xFac_deltaPositions54Type
        deltaPositionsWithAltitude: implementation-data-type=V2xFac_deltaPositionsWithAltitude55Type
        absolutePositions: implementation-data-type=V2xFac_absolutePositions56Type
        absolutePositionsWithAltitude: implementation-data-type=V2xFac_absolutePositionsWithAltitude57Type
        choice: implementation-data-type=V2xFac_PolygonalLineChoiceType
    V2xFac_PosCentMassType: compu {1=tenCentimeters, 63=unavailable}, range raw undefined, implementation-data-type=uint8
    V2xFac_PosConfidenceEllipseType: category=STRUCTURE
      element semiMajorConfidence: implementation-data-type=uint16
      element semiMinorConfidence: implementation-data-type=uint16
      element semiMajorOrientation: implementation-data-type=V2xFac_HeadingType
    V2xFac_PosFrontAxType: compu {1=tenCentimeters, 20=unavailable}, range raw undefined, implementation-data-type=uint8
    V2xFac_PosLonCarrType: compu {1=oneCentimeter, 127=unavailable}, range raw undefined, implementation-data-type=uint8
    V2xFac_PosPillarType: compu {1=tenCentimeters, 30=unavailable}, range raw undefined, implementation-data-type=uint8
    V2xFac_Position3DPresenceType: compu {mask 0x01: 0=FALSE (elevation__FALSE) (Bit 0 (LSB): Optional child present), mask 0x01: 1=TRUE (elevation) (Bit 0 (LSB): Optional child present)}, data-constr=V2xFac_Position3DPresenceType, implementation-data-type=uint8
    V2xFac_Position3DType: category=STRUCTURE
      4 x element, all with category=TYPE_REFERENCE:
        lat: implementation-data-type=V2xFac_LatitudeType
        long: implementation-data-type=V2xFac_LongitudeType
        elevation: implementation-data-type=V2xFac_ElevationType
        presence: implementation-data-type=V2xFac_Position3DPresenceType
    V2xFac_PositionOfOccupantsType:
      compu {mask 0x80000: 0=FALSE (row1LeftOccupied__FALSE) (Bit 19: row 1 left occupied), mask 0x80000: 524288=TRUE (row1LeftOccupied) (Bit 19: row 1 left occupied), mask 0x40000: 0=FALSE (row1RightOccupied__FALSE) (Bit 18: row 1 right occupied), mask 0x40000: 262144=TRUE (row1RightOccupied) (Bit 18: row 1 right occupied), mask 0x20000: 0=FALSE (row1MidOccupied__FALSE) (Bit 17: row 1 mid occupied), mask 0x20000: 131072=TRUE (row1MidOccupied) (Bit 17: row 1 mid occupied), mask 0x10000: 0=FALSE (row1NotDetectable__FALSE) (Bit 16: row 1 not detectable), mask 0x10000: 65536=TRUE (row1NotDetectable) (Bit 16: row 1 not detectable), mask 0x8000: 0=FALSE (row1NotPresent__FALSE) (Bit 15: row 1 not present), mask 0x8000: 32768=TRUE (row1NotPresent) (Bit 15: row 1 not present), mask 0x4000: 0=FALSE (row2LeftOccupied__FALSE) (Bit 14: row 2 left occupied), mask 0x4000: 16384=TRUE (row2LeftOccupied) (Bit 14: row 2 left occupied), mask 0x2000: 0=FALSE (row2RightOccupied__FALSE) (Bit 13: row 2 right occupied), mask 0x2000: 8192=TRUE (row2RightOccupied) (Bit 13: row 2 right occupied), mask 0x1000: 0=FALSE (row2MidOccupied__FALSE) (Bit 12: row 2 mid occupied), mask 0x1000: 4096=TRUE (row2MidOccupied) (Bit 12: row 2 mid occupied), mask 0x800: 0=FALSE (row2NotDetectable__FALSE) (Bit 11: row 2 not detectable), mask 0x800: 2048=TRUE (row2NotDetectable) (Bit 11: row 2 not detectable), mask 0x400: 0=FALSE (row2NotPresent__FALSE) (Bit 10: row 2 not present), mask 0x400: 1024=TRUE (row2NotPresent) (Bit 10: row 2 not present), mask 0x200: 0=FALSE (row3LeftOccupied__FALSE) (Bit 9: row 3 left occupied), mask 0x200: 512=TRUE (row3LeftOccupied) (Bit 9: row 3 left occupied), mask 0x100: 0=FALSE (row3RightOccupied__FALSE) (Bit 8: row 3 right occupied), mask 0x100: 256=TRUE (row3RightOccupied) (Bit 8: row 3 right occupied), mask 0x80: 0=FALSE (row3MidOccupied__FALSE) (Bit 7: row 3 mid occupied), mask 0x80: 128=TRUE (row3MidOccupied) (Bit 7: row 3 mid occupied), mask 0x40: 0=FALSE (row3NotDetectable__FALSE) (Bit 6: row 3 not detectable), mask 0x40: 64=TRUE (row3NotDetectable) (Bit 6: row 3 not detectable), mask 0x20: 0=FALSE (row3NotPresent__FALSE) (Bit 5: row 3 not present), mask 0x20: 32=TRUE (row3NotPresent) (Bit 5: row 3 not present), mask 0x10: 0=FALSE (row4LeftOccupied__FALSE) (Bit 4: row 4 left occupied), mask 0x10: 16=TRUE (row4LeftOccupied) (Bit 4: row 4 left occupied), mask 0x08: 0=FALSE (row4RightOccupied__FALSE) (Bit 3: row 4 right occupied), mask 0x08: 8=TRUE (row4RightOccupied) (Bit 3: row 4 right occupied), mask 0x04: 0=FALSE (row4MidOccupied__FALSE) (Bit 2: row 4 mid occupied), mask 0x04: 4=TRUE (row4MidOccupied) (Bit 2: row 4 mid occupied), mask 0x02: 0=FALSE (row4NotDetectable__FALSE) (Bit 1: row 4 not detectable), mask 0x02: 2=TRUE (row4NotDetectable) (Bit 1: row 4 not detectable), mask 0x01: 0=FALSE (row4NotPresent__FALSE) (Bit 0 (LSB): row 4 not present), mask 0x01: 1=TRUE (row4NotPresent) (Bit 0 (LSB): row 4 not present)}
      range raw 0x00..0xFFFFF
      implementation-data-type=uint32
    V2xFac_PositionOfPillarsType: category=STRUCTURE
      element count: implementation-data-type=uint8
      element values: category=ARRAY, array-size-semantics=FIXED-SIZE
        element values: array-size=undefined, array-size-semantics=FIXED-SIZE, implementation-data-type=uint8
    V2xFac_PositioningSolutionTypeType: compu {0x00=V2XFAC_POSITIONINGSOLUTIONTYPE_NO_POSITIONING_SOLUTION, 0x01=V2XFAC_POSITIONINGSOLUTIONTYPE_SGNSS, 0x02=V2XFAC_POSITIONINGSOLUTIONTYPE_DGNSS, 0x03=V2XFAC_POSITIONINGSOLUTIONTYPE_SGNSSPLUSDR, 0x04=V2XFAC_POSITIONINGSOLUTIONTYPE_DGNSSPLUSDR, 0x05=V2XFAC_POSITIONINGSOLUTIONTYPE_DR}, range raw 0x00..0x05, implementation-data-type=uint8
    V2xFac_PostCrashSubCauseCodeType: compu {0=unavailable, 1=accidentWithoutECallTriggered, 2=accidentWithECallManuallyTriggered, 3=accidentWithECallAutomaticallyTriggered, 4=accidentWithECallTriggeredWithoutAccessToCellularNetwork}, range raw undefined, implementation-data-type=uint8
    V2xFac_PreemptPriorityListType: category=STRUCTURE
      element count: implementation-data-type=uint8
      element values: category=ARRAY, array-size-semantics=FIXED-SIZE
        element values: array-size=undefined, array-size-semantics=FIXED-SIZE, implementation-data-type=V2xFac_SignalControlZoneType
    V2xFac_ProtectedCommunicationZonePresenceType:
      compu {mask 0x04: 0=FALSE (expiryTime__FALSE) (Bit 2: Optional child present), mask 0x04: 4=TRUE (expiryTime) (Bit 2: Optional child present), mask 0x02: 0=FALSE (protectedZoneRadius__FALSE) (Bit 1: Optional child present), mask 0x02: 2=TRUE (protectedZoneRadius) (Bit 1: Optional child present), mask 0x01: 0=FALSE (protectedZoneID__FALSE) (Bit 0 (LSB): Optional child present), mask 0x01: 1=TRUE (protectedZoneID) (Bit 0 (LSB): Optional child present)}
      range raw 0x00..0x07
      implementation-data-type=uint8
    V2xFac_ProtectedCommunicationZoneType: category=STRUCTURE
      7 x element, all with category=TYPE_REFERENCE:
        presence: implementation-data-type=V2xFac_ProtectedCommunicationZonePresenceType
        protectedZoneType: implementation-data-type=V2xFac_ProtectedZoneTypeType
        expiryTime: implementation-data-type=uint64
        protectedZoneLatitude: implementation-data-type=sint16
        protectedZoneLongitude: implementation-data-type=sint16
        protectedZoneRadius: implementation-data-type=uint8
        protectedZoneID: implementation-data-type=uint32
    V2xFac_ProtectedCommunicationZonesRSUType: category=STRUCTURE
      element count: implementation-data-type=uint8
      element values: category=ARRAY, array-size-semantics=FIXED-SIZE
        element values: array-size=undefined, array-size-semantics=FIXED-SIZE, implementation-data-type=V2xFac_ProtectedCommunicationZoneType
    V2xFac_ProtectedZoneIDType: range raw undefined, implementation-data-type=uint32
    V2xFac_ProtectedZoneRadiusType: compu {1=oneMeter}, range raw undefined, implementation-data-type=uint8
    V2xFac_ProtectedZoneTypeType: compu {0x00=V2XFAC_PROTECTEDZONETYPE_CEN_DSRC_TOLLING}, range raw 0x00, implementation-data-type=uint8
    V2xFac_ProviderType: category=STRUCTURE
      element countryCode: implementation-data-type=V2xFac_CountryCodeType
      element providerIdentifier: implementation-data-type=V2xFac_IssuerIdentifierType
    V2xFac_PtActivationDataType: category=STRUCTURE
      element count: implementation-data-type=uint8
      element values: category=ARRAY, array-size-semantics=FIXED-SIZE
        element values: array-size=undefined, array-size-semantics=FIXED-SIZE, implementation-data-type=uint8
    V2xFac_PtActivationType: category=STRUCTURE
      element ptActivationType: implementation-data-type=uint8
      element ptActivationData: implementation-data-type=V2xFac_PtActivationDataType
    V2xFac_PtActivationTypeType: compu {0=undefinedCodingType, 1=r09_16CodingType, 2=vdv_50149CodingType}, range raw undefined, implementation-data-type=uint8
    V2xFac_PublicTransportContainerPresenceType: compu {mask 0x01: 0=FALSE (ptActivation__FALSE) (Bit 0 (LSB): Optional child present), mask 0x01: 1=TRUE (ptActivation) (Bit 0 (LSB): Optional child present)}, range raw 0x00..0x01, implementation-data-type=uint8
    V2xFac_PublicTransportContainerType: category=STRUCTURE
      element presence: implementation-data-type=V2xFac_PublicTransportContainerPresenceType
      element embarkationStatus: implementation-data-type=boolean
      element ptActivation: implementation-data-type=V2xFac_PtActivationType
    V2xFac_ROIType: range raw undefined, implementation-data-type=uint8
    V2xFac_RSCUnitType: compu {0=kmperh, 1=milesperh, 2=kilometre, 3=meter, 4=decimetre, 5=centimetre, 6=mile, 7=yard, 8=foot, 9=minutesOfTime, 10=tonnes, 11=hundredkg, 12=pound, 13=rateOfIncline}, range raw undefined, implementation-data-type=uint8
    V2xFac_RSCodeType: category=STRUCTURE
      element layoutComponentId: implementation-data-type=uint8
      element code: implementation-data-type=V2xFac_code59Type
    V2xFac_RSUContainerHighFrequencyPresenceType: compu {mask 0x01: 0=FALSE (protectedCommunicationZonesRSU__FALSE) (Bit 0 (LSB): Optional child present), mask 0x01: 1=TRUE (protectedCommunicationZonesRSU) (Bit 0 (LSB): Optional child present)}, range raw 0x00..0x01, implementation-data-type=uint8
    V2xFac_RSUContainerHighFrequencyType: category=STRUCTURE
      element presence: implementation-data-type=V2xFac_RSUContainerHighFrequencyPresenceType
      element protectedCommunicationZonesRSU: implementation-data-type=V2xFac_ProtectedCommunicationZonesRSUType
    V2xFac_RccPartType: category=STRUCTURE
      element zoneIds: implementation-data-type=V2xFac_zoneIds16Type
      element roadType: implementation-data-type=V2xFac_RoadTypeType
      element laneConfiguration: implementation-data-type=V2xFac_laneConfiguration17Type
    V2xFac_ReferenceDenmsType: category=STRUCTURE
      element count: implementation-data-type=uint8
      element values: category=ARRAY, array-size-semantics=FIXED-SIZE
        element values: array-size=undefined, array-size-semantics=FIXED-SIZE, implementation-data-type=V2xFac_ActionIdType
    V2xFac_ReferencePositionType: category=STRUCTURE
      4 x element, all with category=TYPE_REFERENCE:
        latitude: implementation-data-type=sint32
        longitude: implementation-data-type=sint32
        posConfidenceEllipse: implementation-data-type=V2xFac_PosConfidenceEllipseType
        altitude: implementation-data-type=V2xFac_AltitudeType
    V2xFac_RegulatorySpeedLimitType: category=STRUCTURE
      element type: implementation-data-type=V2xFac_SpeedLimitTypeType
      element speed: implementation-data-type=V2xFac_VelocityType
    V2xFac_RelevanceDistanceType:
      compu {0x00=V2XFAC_RELEVANCEDISTANCE_LESS_THAN_50_M, 0x01=V2XFAC_RELEVANCEDISTANCE_LESS_THAN_100_M, 0x02=V2XFAC_RELEVANCEDISTANCE_LESS_THAN_200_M, 0x03=V2XFAC_RELEVANCEDISTANCE_LESS_THAN_500_M, 0x04=V2XFAC_RELEVANCEDISTANCE_LESS_THAN_1000_M, 0x05=V2XFAC_RELEVANCEDISTANCE_LESS_THAN_5_KM, 0x06=V2XFAC_RELEVANCEDISTANCE_LESS_THAN_10_KM, 0x07=V2XFAC_RELEVANCEDISTANCE_OVER_10_KM}
      range raw 0x00..0x07
      implementation-data-type=uint8
    V2xFac_RelevanceTrafficDirectionType: compu {0x00=V2XFAC_RELEVANCETRAFFICDIRECTION_ALL_TRAFFIC_DIRECTIONS, 0x01=V2XFAC_RELEVANCETRAFFICDIRECTION_UPSTREAM_TRAFFIC, 0x02=V2XFAC_RELEVANCETRAFFICDIRECTION_DOWNSTREAM_TRAFFIC, 0x03=V2XFAC_RELEVANCETRAFFICDIRECTION_OPPOSITE_TRAFFIC}, range raw 0x00..0x03, implementation-data-type=uint8
    V2xFac_RequestResponseIndicationType: compu {0x00=V2XFAC_REQUESTRESPONSEINDICATION_REQUEST, 0x01=V2XFAC_REQUESTRESPONSEINDICATION_RESPONSE}, range raw 0x00..0x01, implementation-data-type=uint8
    V2xFac_RescueAndRecoveryWorkInProgressSubCauseCodeType: compu {0=unavailable, 1=emergencyVehicles, 2=rescueHelicopterLanding, 3=policeActivityOngoing, 4=medicalEmergencyOngoing, 5=childAbductionInProgress}, range raw undefined, implementation-data-type=uint8
    V2xFac_RescueContainerType: category=STRUCTURE
      element lightBarSirenInUse: implementation-data-type=V2xFac_LightBarSirenInUseType
    V2xFac_ResponderGroupAffectedType: compu {9729=emergency_vehicle_units, 9730=federal_law_enforcement_units, 9731=state_police_units, 9732=county_police_units, 9733=local_police_units, 9734=ambulance_units, 9735=rescue_units, 9736=fire_units, 9737=hAZMAT_units, 9738=light_tow_unit, 9739=heavy_tow_unit, 9740=freeway_service_patrols, 9741=transportation_response_units, 9742=private_contractor_response_units}, range raw 9729..9742
    V2xFac_RestrictedTypesType: category=STRUCTURE
      element count: implementation-data-type=uint8
      element values: category=ARRAY, array-size-semantics=FIXED-SIZE
        element values: array-size=undefined, array-size-semantics=FIXED-SIZE, implementation-data-type=uint8
    V2xFac_RestrictionAppliesToType: compu {0=none, 1=equippedTransit, 2=equippedTaxis, 3=equippedOther, 4=emissionCompliant, 5=equippedBicycle, 6=weightCompliant, 7=heightCompliant, 8=pedestrians, 9=slowMovingPersons, 10=wheelchairUsers, 11=visualDisabilities, 12=audioDisabilities, 13=otherUnknownDisabilities}, range raw 0..13
    V2xFac_RestrictionClassAssignmentType: category=STRUCTURE
      element id: implementation-data-type=V2xFac_RestrictionClassIDType
      element users: implementation-data-type=V2xFac_RestrictionUserTypeListType
    V2xFac_RestrictionClassIDType: range raw undefined, implementation-data-type=uint8
    V2xFac_RestrictionClassListType: category=STRUCTURE
      element count: implementation-data-type=uint8
      element values: category=ARRAY, array-size-semantics=FIXED-SIZE
        element values: array-size=undefined, array-size-semantics=FIXED-SIZE, implementation-data-type=V2xFac_RestrictionClassAssignmentType
    V2xFac_RestrictionUserTypeChoiceType: compu {0x01=V2XFAC_RESTRICTIONUSERTYPE_BASIC_TYPE, 0x02=V2XFAC_RESTRICTIONUSERTYPE_REGIONAL}, range raw 0x01..0x02
    V2xFac_RestrictionUserTypeListType: category=STRUCTURE
      element count: implementation-data-type=uint8
      element values: category=ARRAY, array-size-semantics=FIXED-SIZE
        element values: array-size=undefined, array-size-semantics=FIXED-SIZE, implementation-data-type=V2xFac_RestrictionUserTypeType
    V2xFac_RestrictionUserTypeType: category=STRUCTURE
      element basicType: implementation-data-type=V2xFac_RestrictionAppliesToType
      element choice: implementation-data-type=V2xFac_RestrictionUserTypeChoiceType
    V2xFac_RoadConfigurationContainerType: category=STRUCTURE
      element count: implementation-data-type=uint8
      element values: category=ARRAY, array-size-semantics=FIXED-SIZE
        element values: array-size=undefined, array-size-semantics=FIXED-SIZE, implementation-data-type=V2xFac_RccPartType
    V2xFac_RoadLaneSetListType: category=STRUCTURE
      element count: implementation-data-type=uint8
      element values: category=ARRAY, array-size-semantics=FIXED-SIZE
        element values: array-size=undefined, array-size-semantics=FIXED-SIZE, implementation-data-type=V2xFac_GenericLaneType
    V2xFac_RoadRegulatorIDType: range raw undefined, implementation-data-type=uint16
    V2xFac_RoadSegmentIDType: range raw undefined, implementation-data-type=uint16
    V2xFac_RoadSegmentListType: category=STRUCTURE
      element count: implementation-data-type=uint8
      element values: category=ARRAY, array-size-semantics=FIXED-SIZE
        element values: array-size=undefined, array-size-semantics=FIXED-SIZE, implementation-data-type=V2xFac_RoadSegmentType
    V2xFac_RoadSegmentPresenceType:
      compu {mask 0x01: 0=FALSE (name__FALSE) (Bit 0 (LSB): Optional child present), mask 0x01: 1=TRUE (name) (Bit 0 (LSB): Optional child present), mask 0x02: 0=FALSE (laneWidth__FALSE) (Bit 1: Optional child present), mask 0x02: 2=TRUE (laneWidth) (Bit 1: Optional child present), mask 0x04: 0=FALSE (speedLimits__FALSE) (Bit 2: Optional child present), mask 0x04: 4=TRUE (speedLimits) (Bit 2: Optional child present)}
      data-constr=V2xFac_RoadSegmentPresenceType
      implementation-data-type=uint8
    V2xFac_RoadSegmentReferenceIDPresenceType: compu {mask 0x01: 0=FALSE (region__FALSE) (Bit 0 (LSB): Optional child present), mask 0x01: 1=TRUE (region) (Bit 0 (LSB): Optional child present)}, data-constr=V2xFac_RoadSegmentReferenceIDPresenceType, implementation-data-type=uint8
    V2xFac_RoadSegmentReferenceIDType: category=STRUCTURE
      element region: implementation-data-type=V2xFac_RoadRegulatorIDType
      element id: implementation-data-type=V2xFac_RoadSegmentIDType
      element presence: implementation-data-type=V2xFac_RoadSegmentReferenceIDPresenceType
    V2xFac_RoadSegmentType: category=STRUCTURE
      8 x element, all with category=TYPE_REFERENCE:
        name: implementation-data-type=V2xFac_DescriptiveNameType
        id: implementation-data-type=V2xFac_RoadSegmentReferenceIDType
        revision: implementation-data-type=V2xFac_MsgCountType
        refPoint: implementation-data-type=V2xFac_Position3DType
        laneWidth: implementation-data-type=V2xFac_LaneWidthType
        speedLimits: implementation-data-type=V2xFac_SpeedLimitListType
        roadLaneSet: implementation-data-type=V2xFac_RoadLaneSetListType
        presence: implementation-data-type=V2xFac_RoadSegmentPresenceType
    V2xFac_RoadTypeType: compu {0x00=V2XFAC_ROADTYPE_URBAN_NOSTRUCTURALSEPARATIONTOOPPOSITELANES, 0x01=V2XFAC_ROADTYPE_URBAN_WITHSTRUCTURALSEPARATIONTOOPPOSITELANES, 0x02=V2XFAC_ROADTYPE_NONURBAN_NOSTRUCTURALSEPARATIONTOOPPOSITELANES, 0x03=V2XFAC_ROADTYPE_ONURBAN_WITHSTRUCTURALSEPARATIONTOOPPOSITELANES}, range raw 0x00..0x03, implementation-data-type=uint8
    V2xFac_RoadWorksContainerBasicPresenceType: compu {mask 0x02: 0=FALSE (roadworksSubCauseCode__FALSE) (Bit 1: Optional child present), mask 0x02: 2=TRUE (roadworksSubCauseCode) (Bit 1: Optional child present), mask 0x01: 0=FALSE (closedLanes__FALSE) (Bit 0 (LSB): Optional child present), mask 0x01: 1=TRUE (closedLanes) (Bit 0 (LSB): Optional child present)}, range raw 0x00..0x03, implementation-data-type=uint8
    V2xFac_RoadWorksContainerBasicType: category=STRUCTURE
      4 x element, all with category=TYPE_REFERENCE:
        presence: implementation-data-type=V2xFac_RoadWorksContainerBasicPresenceType
        roadworksSubCauseCode: implementation-data-type=uint8
        lightBarSirenInUse: implementation-data-type=V2xFac_LightBarSirenInUseType
        closedLanes: implementation-data-type=V2xFac_ClosedLanesType
    V2xFac_RoadWorksContainerExtendedPresenceType:
      compu {mask 0x100: 0=FALSE (lightBarSirenInUse__FALSE) (Bit 8: Optional child present), mask 0x100: 256=TRUE (lightBarSirenInUse) (Bit 8: Optional child present), mask 0x80: 0=FALSE (closedLanes__FALSE) (Bit 7: Optional child present), mask 0x80: 128=TRUE (closedLanes) (Bit 7: Optional child present), mask 0x40: 0=FALSE (restriction__FALSE) (Bit 6: Optional child present), mask 0x40: 64=TRUE (restriction) (Bit 6: Optional child present), mask 0x20: 0=FALSE (speedLimit__FALSE) (Bit 5: Optional child present), mask 0x20: 32=TRUE (speedLimit) (Bit 5: Optional child present), mask 0x10: 0=FALSE (incidentIndication__FALSE) (Bit 4: Optional child present), mask 0x10: 16=TRUE (incidentIndication) (Bit 4: Optional child present), mask 0x08: 0=FALSE (recommendedPath__FALSE) (Bit 3: Optional child present), mask 0x08: 8=TRUE (recommendedPath) (Bit 3: Optional child present), mask 0x04: 0=FALSE (startingPointSpeedLimit__FALSE) (Bit 2: Optional child present), mask 0x04: 4=TRUE (startingPointSpeedLimit) (Bit 2: Optional child present), mask 0x02: 0=FALSE (trafficFlowRule__FALSE) (Bit 1: Optional child present), mask 0x02: 2=TRUE (trafficFlowRule) (Bit 1: Optional child present), mask 0x01: 0=FALSE (referenceDenms__FALSE) (Bit 0 (LSB): Optional child present), mask 0x01: 1=TRUE (referenceDenms) (Bit 0 (LSB): Optional child present)}
      range raw 0x00..0x1FF
      implementation-data-type=uint16
    V2xFac_RoadWorksContainerExtendedType: category=STRUCTURE
      10 x element, all with category=TYPE_REFERENCE:
        presence: implementation-data-type=V2xFac_RoadWorksContainerExtendedPresenceType
        lightBarSirenInUse: implementation-data-type=V2xFac_LightBarSirenInUseType
        closedLanes: implementation-data-type=V2xFac_ClosedLanesType
        restriction: implementation-data-type=V2xFac_RestrictedTypesType
        speedLimit: implementation-data-type=uint8
        incidentIndication: implementation-data-type=V2xFac_CauseCodeType
        recommendedPath: implementation-data-type=V2xFac_ItineraryPathType
        startingPointSpeedLimit: implementation-data-type=V2xFac_DeltaReferencePositionType
        trafficFlowRule: implementation-data-type=V2xFac_TrafficRuleType
        referenceDenms: implementation-data-type=V2xFac_ReferenceDenmsType
    V2xFac_RoadwayCrownAngleType: range raw undefined, implementation-data-type=sint8
    V2xFac_RoadworksSubCauseCodeType: compu {0=unavailable, 1=majorRoadworks, 2=roadMarkingWork, 3=slowMovingRoadMaintenance, 4=shortTermStationaryRoadworks, 5=streetCleaning, 6=winterService}, range raw undefined, implementation-data-type=uint8
    V2xFac_SPATPresenceType: compu {mask 0x01: 0=FALSE (timeStamp__FALSE) (Bit 0 (LSB): Optional child present), mask 0x01: 1=TRUE (timeStamp) (Bit 0 (LSB): Optional child present), mask 0x02: 0=FALSE (name__FALSE) (Bit 1: Optional child present), mask 0x02: 2=TRUE (name) (Bit 1: Optional child present)}, data-constr=V2xFac_SPATPresenceType, implementation-data-type=uint8
    V2xFac_SPATType: category=STRUCTURE
      4 x element, all with category=TYPE_REFERENCE:
        timeStamp: implementation-data-type=V2xFac_MinuteOfTheYearType
        name: implementation-data-type=V2xFac_DescriptiveNameType
        intersections: implementation-data-type=V2xFac_IntersectionStateListType
        presence: implementation-data-type=V2xFac_SPATPresenceType
    V2xFac_SPEPresenceType: compu {mask 0x01: 0=FALSE (spm__FALSE) (Bit 0 (LSB): Optional child present), mask 0x01: 1=TRUE (spm) (Bit 0 (LSB): Optional child present), mask 0x02: 0=FALSE (mns__FALSE) (Bit 1: Optional child present), mask 0x02: 2=TRUE (mns) (Bit 1: Optional child present)}, data-constr=V2xFac_SPEPresenceType, implementation-data-type=uint8
    V2xFac_SPEType: category=STRUCTURE
      4 x element, all with category=TYPE_REFERENCE:
        spm: implementation-data-type=uint8
        mns: implementation-data-type=uint8
        unit: implementation-data-type=V2xFac_RSCUnitType
        presence: implementation-data-type=V2xFac_SPEPresenceType
    V2xFac_SafetyCarContainerPresenceType:
      compu {mask 0x04: 0=FALSE (incidentIndication__FALSE) (Bit 2: Optional child present), mask 0x04: 4=TRUE (incidentIndication) (Bit 2: Optional child present), mask 0x02: 0=FALSE (trafficRule__FALSE) (Bit 1: Optional child present), mask 0x02: 2=TRUE (trafficRule) (Bit 1: Optional child present), mask 0x01: 0=FALSE (speedLimit__FALSE) (Bit 0 (LSB): Optional child present), mask 0x01: 1=TRUE (speedLimit) (Bit 0 (LSB): Optional child present)}
      range raw 0x00..0x07
      implementation-data-type=uint8
    V2xFac_SafetyCarContainerType: category=STRUCTURE
      5 x element, all with category=TYPE_REFERENCE:
        presence: implementation-data-type=V2xFac_SafetyCarContainerPresenceType
        lightBarSirenInUse: implementation-data-type=V2xFac_LightBarSirenInUseType
        incidentIndication: implementation-data-type=V2xFac_CauseCodeType
        trafficRule: implementation-data-type=V2xFac_TrafficRuleType
        speedLimit: implementation-data-type=uint8
    V2xFac_Scale_B12Type: range raw undefined, implementation-data-type=sint16
    V2xFac_SegmentAttributeXYListType: category=STRUCTURE
      element count: implementation-data-type=uint8
      element values: category=ARRAY, array-size-semantics=FIXED-SIZE
        element values: array-size=undefined, array-size-semantics=FIXED-SIZE, implementation-data-type=V2xFac_SegmentAttributeXYType
    V2xFac_SegmentAttributeXYType: compu {0=reserved, 1=doNotBlock, 2=whiteLine, 3=mergingLaneLeft, 4=mergingLaneRight, 5=curbOnLeft, 6=curbOnRight, 7=loadingzoneOnLeft, 8=loadingzoneOnRight, 9=turnOutPointOnLeft, 10=turnOutPointOnRight, 11=adjacentParkingOnLeft, 12=adjacentParkingOnRight, 13=adjacentBikeLaneOnLeft, 14=adjacentBikeLaneOnRight, 15=sharedBikeLane, 16=bikeBoxInFront, 17=transitStopOnLeft, 18=transitStopOnRight, 19=transitStopInLane, 20=sharedWithTrackedVehicle, 21=safeIsland, 22=lowCurbsPresent, 23=rumbleStripPresent, 24=audibleSignalingPresent, 25=adaptiveTimingPresent, 26=rfSignalRequestPresent, 27=partialCurbIntrusion, 28=taperToLeft, 29=taperToRight, 30=taperToCenterLine, 31=parallelParking, 32=headInParking, 33=freeParking, 34=timeRestrictionsOnParking, 35=costToPark, 36=midBlockCurbPresent, 37=unEvenPavementPresent}, range raw 0..37
    V2xFac_SegmentPresenceType: compu {mask 0x01: 0=FALSE (laneWidth__FALSE) (Bit 0 (LSB): Optional child present), mask 0x01: 1=TRUE (laneWidth) (Bit 0 (LSB): Optional child present)}, data-constr=V2xFac_SegmentPresenceType, implementation-data-type=uint8
    V2xFac_SegmentType: category=STRUCTURE
      element line: implementation-data-type=V2xFac_PolygonalLineType
      element laneWidth: implementation-data-type=V2xFac_LaneWidthType
      element presence: implementation-data-type=V2xFac_SegmentPresenceType
    V2xFac_SemiAxisLengthType: compu {1=oneCentimeter, 4094=outOfRange, 4095=unavailable}, range raw undefined, implementation-data-type=uint16
    V2xFac_SequenceNumberType: range raw undefined, implementation-data-type=uint16
    V2xFac_SignalControlZoneType: category=STRUCTURE
    V2xFac_SignalGroupIDType: range raw undefined, implementation-data-type=uint8
    V2xFac_SignalViolationSubCauseCodeType: compu {0=unavailable, 1=stopSignViolation, 2=trafficLightViolation, 3=turningRegulationViolation}, range raw undefined, implementation-data-type=uint8
    V2xFac_SituationContainerPresenceType: compu {mask 0x02: 0=FALSE (linkedCause__FALSE) (Bit 1: Optional child present), mask 0x02: 2=TRUE (linkedCause) (Bit 1: Optional child present), mask 0x01: 0=FALSE (eventHistory__FALSE) (Bit 0 (LSB): Optional child present), mask 0x01: 1=TRUE (eventHistory) (Bit 0 (LSB): Optional child present)}, range raw 0x00..0x03, implementation-data-type=uint8
    V2xFac_SituationContainerType: category=STRUCTURE
      5 x element, all with category=TYPE_REFERENCE:
        presence: implementation-data-type=V2xFac_SituationContainerPresenceType
        informationQuality: implementation-data-type=uint8
        eventType: implementation-data-type=V2xFac_CauseCodeType
        linkedCause: implementation-data-type=V2xFac_CauseCodeType
        eventHistory: implementation-data-type=V2xFac_EventHistoryType
    V2xFac_SlowVehicleSubCauseCodeType: compu {0=unavailable, 1=maintenanceVehicle, 2=vehiclesSlowingToLookAtAccident, 3=abnormalLoad, 4=abnormalWideLoad, 5=convoy, 6=snowplough, 7=deicing, 8=saltingVehicles}, range raw undefined, implementation-data-type=uint8
    V2xFac_SoundLevelType: category=STRUCTURE
      element soundstationary: implementation-data-type=V2xFac_Int1Type
      element sounddriveby: implementation-data-type=V2xFac_Int1Type
    V2xFac_SpatemDataPresenceType: compu {mask 0x01: 0=FALSE (timeStamp__FALSE) (Bit 0 (LSB): Optional child present), mask 0x01: 1=TRUE (timeStamp) (Bit 0 (LSB): Optional child present), mask 0x02: 0=FALSE (name__FALSE) (Bit 1: Optional child present), mask 0x02: 2=TRUE (name) (Bit 1: Optional child present)}, data-constr=V2xFac_SpatemDataPresenceType, implementation-data-type=uint8
    V2xFac_SpatemDataType: category=STRUCTURE
      5 x element, all with category=TYPE_REFERENCE:
        timeStamp: implementation-data-type=V2xFac_MinuteOfTheYearType
        name: implementation-data-type=V2xFac_DescriptiveNameType
        intersections: implementation-data-type=V2xFac_IntersectionStateListType
        transactionId: implementation-data-type=uint32
        presence: implementation-data-type=V2xFac_SpatemDataPresenceType
    V2xFac_SpecialTransportContainerType: category=STRUCTURE
      element specialTransportType: implementation-data-type=V2xFac_SpecialTransportTypeType
      element lightBarSirenInUse: implementation-data-type=V2xFac_LightBarSirenInUseType
    V2xFac_SpecialTransportTypeType:
      compu {mask 0x08: 0=FALSE (heavyLoad__FALSE) (Bit 3: heavy load), mask 0x08: 8=TRUE (heavyLoad) (Bit 3: heavy load), mask 0x04: 0=FALSE (excessWidth__FALSE) (Bit 2: excess width), mask 0x04: 4=TRUE (excessWidth) (Bit 2: excess width), mask 0x02: 0=FALSE (excessLength__FALSE) (Bit 1: excess length), mask 0x02: 2=TRUE (excessLength) (Bit 1: excess length), mask 0x01: 0=FALSE (excessHeight__FALSE) (Bit 0 (LSB): excess height), mask 0x01: 1=TRUE (excessHeight) (Bit 0 (LSB): excess height)}
      range raw 0x00..0x0F
      implementation-data-type=uint8
    V2xFac_SpecialVehicleContainerChoiceType:
      compu {0x01=V2XFAC_SPECIALVEHICLECONTAINER_PUBLIC_TRANSPORT_CONTAINER, 0x02=V2XFAC_SPECIALVEHICLECONTAINER_DANGEROUS_GOODS_CONTAINER, 0x03=V2XFAC_SPECIALVEHICLECONTAINER_ROAD_WORKS_CONTAINER_BASIC, 0x04=V2XFAC_SPECIALVEHICLECONTAINER_RESCUE_CONTAINER, 0x05=V2XFAC_SPECIALVEHICLECONTAINER_EMERGENCY_CONTAINER, 0x06=V2XFAC_SPECIALVEHICLECONTAINER_SAFETY_CAR_CONTAINER}
      range raw 0x01..0x06
      implementation-data-type=uint8
    V2xFac_SpecialVehicleContainerType: category=STRUCTURE
      8 x element, all with category=TYPE_REFERENCE:
        choice: implementation-data-type=V2xFac_SpecialVehicleContainerChoiceType
        publicTransportContainer: implementation-data-type=V2xFac_PublicTransportContainerType
        specialTransportContainer: implementation-data-type=V2xFac_SpecialTransportContainerType
        dangerousGoodsContainer: implementation-data-type=V2xFac_DangerousGoodsContainerType
        roadWorksContainerBasic: implementation-data-type=V2xFac_RoadWorksContainerBasicType
        rescueContainer: implementation-data-type=V2xFac_RescueContainerType
        emergencyContainer: implementation-data-type=V2xFac_EmergencyContainerType
        safetyCarContainer: implementation-data-type=V2xFac_SafetyCarContainerType
    V2xFac_SpeedAdviceType: range raw undefined, implementation-data-type=uint16
    V2xFac_SpeedConfidenceType: compu {1=equalOrWithinOneCentimeterPerSec, 100=equalOrWithinOneMeterPerSec, 126=outOfRange, 127=unavailable}, range raw undefined, implementation-data-type=uint8
    V2xFac_SpeedLimitListType: category=STRUCTURE
      element count: implementation-data-type=uint8
      element values: category=ARRAY, array-size-semantics=FIXED-SIZE
        element values: array-size=undefined, array-size-semantics=FIXED-SIZE, implementation-data-type=V2xFac_RegulatorySpeedLimitType
    V2xFac_SpeedLimitType: compu {1=oneKmPerHour}, range raw undefined, implementation-data-type=uint8
    V2xFac_SpeedLimitTypeType: compu {0=unknown, 1=maxSpeedInSchoolZone, 2=maxSpeedInSchoolZoneWhenChildrenArePresent, 3=maxSpeedInConstructionZone, 4=vehicleMinSpeed, 5=vehicleMaxSpeed, 6=vehicleNightMaxSpeed, 7=truckMinSpeed, 8=truckMaxSpeed, 9=truckNightMaxSpeed, 10=vehiclesWithTrailersMinSpeed, 11=vehiclesWithTrailersMaxSpeed, 12=vehiclesWithTrailersNightMaxSpeed}, range raw 0..12
    V2xFac_SpeedType: category=STRUCTURE
      element speedValue: implementation-data-type=uint16
      element speedConfidence: implementation-data-type=uint8
    V2xFac_SpeedValueType: compu {0=standstill, 1=oneCentimeterPerSec, 16383=unavailable}, range raw undefined, implementation-data-type=uint16
    V2xFac_StationIDType: range raw undefined, implementation-data-type=uint32
    V2xFac_StationTypeType: compu {0=unknown, 1=pedestrian, 2=cyclist, 3=moped, 4=motorcycle, 5=passengerCar, 6=bus, 7=lightTruck, 8=heavyTruck, 9=trailer, 10=specialVehicles, 11=tram, 15=roadSideUnit}, range raw undefined, implementation-data-type=uint8
    V2xFac_StationarySinceType: compu {0x00=V2XFAC_STATIONARYSINCE_LESS_THAN_1_MINUTE, 0x01=V2XFAC_STATIONARYSINCE_LESS_THAN_2_MINUTES, 0x02=V2XFAC_STATIONARYSINCE_LESS_THAN_15_MINUTES, 0x03=V2XFAC_STATIONARYSINCE_EQUAL_OR_GREATER_15_MINUTES}, range raw 0x00..0x03, implementation-data-type=uint8
    V2xFac_StationaryVehicleContainerPresenceType:
      compu {mask 0x20: 0=FALSE (stationarySince__FALSE) (Bit 5: Optional child present), mask 0x20: 32=TRUE (stationarySince) (Bit 5: Optional child present), mask 0x10: 0=FALSE (stationaryCause__FALSE) (Bit 4: Optional child present), mask 0x10: 16=TRUE (stationaryCause) (Bit 4: Optional child present), mask 0x08: 0=FALSE (carryingDangerousGoods__FALSE) (Bit 3: Optional child present), mask 0x08: 8=TRUE (carryingDangerousGoods) (Bit 3: Optional child present), mask 0x04: 0=FALSE (numberOfOccupants__FALSE) (Bit 2: Optional child present), mask 0x04: 4=TRUE (numberOfOccupants) (Bit 2: Optional child present), mask 0x02: 0=FALSE (vehicleIdentification__FALSE) (Bit 1: Optional child present), mask 0x02: 2=TRUE (vehicleIdentification) (Bit 1: Optional child present), mask 0x01: 0=FALSE (energyStorageType__FALSE) (Bit 0 (LSB): Optional child present), mask 0x01: 1=TRUE (energyStorageType) (Bit 0 (LSB): Optional child present)}
      range raw 0x00..0x3F
      implementation-data-type=uint8
    V2xFac_StationaryVehicleContainerType: category=STRUCTURE
      7 x element, all with category=TYPE_REFERENCE:
        presence: implementation-data-type=V2xFac_StationaryVehicleContainerPresenceType
        stationarySince: implementation-data-type=V2xFac_StationarySinceType
        stationaryCause: implementation-data-type=V2xFac_CauseCodeType
        carryingDangerousGoods: implementation-data-type=V2xFac_DangerousGoodsExtendedType
        numberOfOccupants: implementation-data-type=uint8
        vehicleIdentification: implementation-data-type=V2xFac_VehicleIdentificationType
        energyStorageType: implementation-data-type=V2xFac_EnergyStorageType
    V2xFac_StationaryVehicleSubCauseCodeType: compu {0=unavailable, 1=humanProblem, 2=vehicleBreakdown, 3=postCrash, 4=publicTransportStop, 5=carryingDangerousGoods}, range raw undefined, implementation-data-type=uint8
    V2xFac_SteeringWheelAngleConfidenceType: compu {1=equalOrWithinOnePointFiveDegree, 126=outOfRange, 127=unavailable}, range raw undefined, implementation-data-type=uint8
    V2xFac_SteeringWheelAngleType: category=STRUCTURE
      element steeringWheelAngleValue: implementation-data-type=uint16
      element steeringWheelAngleConfidence: implementation-data-type=uint8
    V2xFac_SteeringWheelAngleValueType: compu {0=straight, -1=onePointFiveDegreesToRight, 1=onePointFiveDegreesToLeft, 512=unavailable}, range raw undefined, implementation-data-type=sint16
    V2xFac_StringType: range raw undefined
    V2xFac_SubCauseCodeTypeType: range raw undefined, implementation-data-type=uint8
    V2xFac_TcPartPresenceType:
      compu {mask 0x01: 0=FALSE (detectionZoneIds__FALSE) (Bit 0 (LSB): Optional child present), mask 0x01: 1=TRUE (detectionZoneIds) (Bit 0 (LSB): Optional child present), mask 0x02: 0=FALSE (driverAwarenessZoneIds__FALSE) (Bit 1: Optional child present), mask 0x02: 2=TRUE (driverAwarenessZoneIds) (Bit 1: Optional child present), mask 0x04: 0=FALSE (minimumAwarenessTime__FALSE) (Bit 2: Optional child present), mask 0x04: 4=TRUE (minimumAwarenessTime) (Bit 2: Optional child present), mask 0x08: 0=FALSE (applicableLanes__FALSE) (Bit 3: Optional child present), mask 0x08: 8=TRUE (applicableLanes) (Bit 3: Optional child present), mask 0x10: 0=FALSE (layoutId__FALSE) (Bit 4: Optional child present), mask 0x10: 16=TRUE (layoutId) (Bit 4: Optional child present), mask 0x20: 0=FALSE (preStoredLayoutId__FALSE) (Bit 5: Optional child present), mask 0x20: 32=TRUE (preStoredLayoutId) (Bit 5: Optional child present), mask 0x40: 0=FALSE (text__FALSE) (Bit 6: Optional child present), mask 0x40: 64=TRUE (text) (Bit 6: Optional child present)}
      data-constr=V2xFac_TcPartPresenceType
      implementation-data-type=uint8
    V2xFac_TcPartType: category=STRUCTURE
      11 x element, all with category=TYPE_REFERENCE:
        detectionZoneIds: implementation-data-type=V2xFac_detectionZoneIds18Type
        relevanceZoneIds: implementation-data-type=V2xFac_relevanceZoneIds19Type
        direction: implementation-data-type=V2xFac_DirectionType
        driverAwarenessZoneIds: implementation-data-type=V2xFac_driverAwarenessZoneIds20Type
        minimumAwarenessTime: implementation-data-type=uint8
        applicableLanes: implementation-data-type=V2xFac_applicableLanes22Type
        layoutId: implementation-data-type=uint8
        preStoredLayoutId: implementation-data-type=uint8
        text: implementation-data-type=V2xFac_text25Type
        data: implementation-data-type=V2xFac_data26Type
        presence: implementation-data-type=V2xFac_TcPartPresenceType
    V2xFac_TemperatureType: compu {-60=equalOrSmallerThanMinus60Deg, 1=oneDegreeCelsius, 67=equalOrGreaterThan67Deg}, range raw undefined, implementation-data-type=sint8
    V2xFac_TerminationType: compu {0x00=V2XFAC_TERMINATION_ISCANCELLATION, 0x01=V2XFAC_TERMINATION_ISNEGATION}, range raw 0x00..0x01, implementation-data-type=uint8
    V2xFac_TextContainerType: category=STRUCTURE
      element count: implementation-data-type=uint8
      element values: category=ARRAY, array-size-semantics=FIXED-SIZE
        element values: array-size=undefined, array-size-semantics=FIXED-SIZE, implementation-data-type=V2xFac_TcPartType
    V2xFac_TextCopy63Type: category=STRUCTURE
      4 x element, all with category=TYPE_REFERENCE:
        layoutComponentId: implementation-data-type=uint8, implementation-data-type=uint8
        language: implementation-data-type=V2xFac_language62Type, implementation-data-type=V2xFac_language62Type
        textContent: implementation-data-type=uint8, implementation-data-type=V2xFac_StringType
        presence: implementation-data-type=V2xFac_TextPresenceType
    V2xFac_TextPresenceType: compu {mask 0x01: 0=FALSE (layoutComponentId__FALSE) (Bit 0 (LSB): Optional child present), mask 0x01: 1=TRUE (layoutComponentId) (Bit 0 (LSB): Optional child present)}, data-constr=V2xFac_TextPresenceType, implementation-data-type=uint8
    V2xFac_TextType: category=STRUCTURE
      4 x element, all with category=TYPE_REFERENCE:
        layoutComponentId: implementation-data-type=uint8
        language: implementation-data-type=V2xFac_language62Type
        textContent: implementation-data-type=V2xFac_StringType
        presence: implementation-data-type=V2xFac_TextPresenceType
    V2xFac_TimeChangeDetailsPresenceType:
      compu {mask 0x01: 0=FALSE (startTime__FALSE) (Bit 0 (LSB): Optional child present), mask 0x01: 1=TRUE (startTime) (Bit 0 (LSB): Optional child present), mask 0x02: 0=FALSE (maxEndTime__FALSE) (Bit 1: Optional child present), mask 0x02: 2=TRUE (maxEndTime) (Bit 1: Optional child present), mask 0x04: 0=FALSE (likelyTime__FALSE) (Bit 2: Optional child present), mask 0x04: 4=TRUE (likelyTime) (Bit 2: Optional child present), mask 0x08: 0=FALSE (confidence__FALSE) (Bit 3: Optional child present), mask 0x08: 8=TRUE (confidence) (Bit 3: Optional child present), mask 0x10: 0=FALSE (nextTime__FALSE) (Bit 4: Optional child present), mask 0x10: 16=TRUE (nextTime) (Bit 4: Optional child present)}
      data-constr=V2xFac_TimeChangeDetailsPresenceType
      implementation-data-type=uint8
    V2xFac_TimeChangeDetailsType: category=STRUCTURE
      7 x element, all with category=TYPE_REFERENCE:
        startTime: implementation-data-type=V2xFac_TimeMarkType
        minEndTime: implementation-data-type=V2xFac_TimeMarkType
        maxEndTime: implementation-data-type=V2xFac_TimeMarkType
        likelyTime: implementation-data-type=V2xFac_TimeMarkType
        confidence: implementation-data-type=V2xFac_TimeIntervalConfidenceType
        nextTime: implementation-data-type=V2xFac_TimeMarkType
        presence: implementation-data-type=V2xFac_TimeChangeDetailsPresenceType
    V2xFac_TimeIntervalConfidenceType: range raw undefined, implementation-data-type=uint8
    V2xFac_TimeMarkType: range raw undefined, implementation-data-type=uint16
    V2xFac_TimestampItsType: compu {0=utcStartOf2004, 1=oneMillisecAfterUTCStartOf2004}, range raw undefined, implementation-data-type=uint64
    V2xFac_TracesType: category=STRUCTURE
      element count: implementation-data-type=uint8
      element values: category=ARRAY, array-size-semantics=FIXED-SIZE
        element values: array-size=undefined, array-size-semantics=FIXED-SIZE, implementation-data-type=V2xFac_PathHistoryType
    V2xFac_TractorCharacteristicsPresenceType:
      compu {mask 0x01: 0=FALSE (equalTo__FALSE) (Bit 0 (LSB): Optional child present), mask 0x01: 1=TRUE (equalTo) (Bit 0 (LSB): Optional child present), mask 0x02: 0=FALSE (notEqualTo__FALSE) (Bit 1: Optional child present), mask 0x02: 2=TRUE (notEqualTo) (Bit 1: Optional child present), mask 0x04: 0=FALSE (ranges__FALSE) (Bit 2: Optional child present), mask 0x04: 4=TRUE (ranges) (Bit 2: Optional child present)}
      data-constr=V2xFac_TractorCharacteristicsPresenceType
      implementation-data-type=uint8
    V2xFac_TractorCharacteristicsType: category=STRUCTURE
      4 x element, all with category=TYPE_REFERENCE:
        equalTo: implementation-data-type=V2xFac_equalTo65Type
        notEqualTo: implementation-data-type=V2xFac_notEqualTo66Type
        ranges: implementation-data-type=V2xFac_ranges67Type
        presence: implementation-data-type=V2xFac_TractorCharacteristicsPresenceType
    V2xFac_TrafficClassIdType: range raw undefined, implementation-data-type=uint8
    V2xFac_TrafficConditionSubCauseCodeType: compu {0=unavailable, 1=increasedVolumeOfTraffic, 2=trafficJamSlowlyIncreasing, 3=trafficJamIncreasing, 4=trafficJamStronglyIncreasing, 5=trafficStationary, 6=trafficJamSlightlyDecreasing, 7=trafficJamDecreasing, 8=trafficJamStronglyDecreasing}, range raw undefined, implementation-data-type=uint8
    V2xFac_TrafficRuleType: compu {0x00=V2XFAC_TRAFFICRULE_NO_PASSING, 0x01=V2XFAC_TRAFFICRULE_NO_PASSING_FOR_TRUCKS, 0x02=V2XFAC_TRAFFICRULE_PASS_TO_RIGHT, 0x03=V2XFAC_TRAFFICRULE_PASS_TO_LEFT}, range raw 0x00..0x03, implementation-data-type=uint8
    V2xFac_TrailerCharacteristicsPresenceType:
      compu {mask 0x01: 0=FALSE (equalTo__FALSE) (Bit 0 (LSB): Optional child present), mask 0x01: 1=TRUE (equalTo) (Bit 0 (LSB): Optional child present), mask 0x02: 0=FALSE (notEqualTo__FALSE) (Bit 1: Optional child present), mask 0x02: 2=TRUE (notEqualTo) (Bit 1: Optional child present), mask 0x04: 0=FALSE (ranges__FALSE) (Bit 2: Optional child present), mask 0x04: 4=TRUE (ranges) (Bit 2: Optional child present)}
      data-constr=V2xFac_TrailerCharacteristicsPresenceType
      implementation-data-type=uint8
    V2xFac_TrailerCharacteristicsType: category=STRUCTURE
      4 x element, all with category=TYPE_REFERENCE:
        equalTo: implementation-data-type=V2xFac_equalTo68Type
        notEqualTo: implementation-data-type=V2xFac_notEqualTo69Type
        ranges: implementation-data-type=V2xFac_ranges70Type
        presence: implementation-data-type=V2xFac_TrailerCharacteristicsPresenceType
    V2xFac_TrainCharacteristicsType: category=STRUCTURE
      4 x element, all with category=TYPE_REFERENCE:
        equalTo: implementation-data-type=V2xFac_equalTo65Type
        notEqualTo: implementation-data-type=V2xFac_notEqualTo66Type
        ranges: implementation-data-type=V2xFac_ranges67Type
        presence: implementation-data-type=V2xFac_TractorCharacteristicsPresenceType
    V2xFac_TransmissionIntervalType: compu {1=oneMilliSecond, 10000=tenSeconds}, range raw undefined, implementation-data-type=uint16
    V2xFac_TurningRadiusType: compu {1=point4Meters, 255=unavailable}, range raw undefined, implementation-data-type=uint8
    V2xFac_UnitTypeType: compu {0=mg_km, 1=mg_kWh}, range raw 0..1
    V2xFac_VDSType: range raw undefined, implementation-data-type=V2xFac_StringType
    V2xFac_VEDPresenceType:
      compu {mask 0x01: 0=FALSE (hei__FALSE) (Bit 0 (LSB): Optional child present), mask 0x01: 1=TRUE (hei) (Bit 0 (LSB): Optional child present), mask 0x02: 0=FALSE (wid__FALSE) (Bit 1: Optional child present), mask 0x02: 2=TRUE (wid) (Bit 1: Optional child present), mask 0x04: 0=FALSE (vln__FALSE) (Bit 2: Optional child present), mask 0x04: 4=TRUE (vln) (Bit 2: Optional child present), mask 0x08: 0=FALSE (wei__FALSE) (Bit 3: Optional child present), mask 0x08: 8=TRUE (wei) (Bit 3: Optional child present)}
      data-constr=V2xFac_VEDPresenceType
      implementation-data-type=uint8
    V2xFac_VEDType: category=STRUCTURE
      5 x element, all with category=TYPE_REFERENCE:
        hei: implementation-data-type=V2xFac_DistanceType
        wid: implementation-data-type=V2xFac_DistanceType
        vln: implementation-data-type=V2xFac_DistanceType
        wei: implementation-data-type=V2xFac_WeightType
        presence: implementation-data-type=V2xFac_VEDPresenceType
    V2xFac_ValidityDurationType: compu {0=timeOfDetection, 1=oneSecondAfterDetection}, range raw undefined, implementation-data-type=uint32
    V2xFac_VarLengthNumberChoiceType: compu {0x01=V2XFAC_VARLENGTHNUMBER_CONTENT, 0x02=V2XFAC_VARLENGTHNUMBER_EXTENSION}, range raw 0x01..0x02
    V2xFac_VarLengthNumberType: category=STRUCTURE
      element choice: implementation-data-type=V2xFac_VarLengthNumberChoiceType
    V2xFac_VcClassType: compu {0=classA, 1=classB, 2=classC, 3=classD, 4=classE, 5=classF, 6=classG, 7=classH}, range raw undefined, implementation-data-type=uint8
    V2xFac_VcCodePresenceType:
      compu {mask 0x01: 0=FALSE (validity__FALSE) (Bit 0 (LSB): Optional child present), mask 0x01: 1=TRUE (validity) (Bit 0 (LSB): Optional child present), mask 0x02: 0=FALSE (value__FALSE) (Bit 1: Optional child present), mask 0x02: 2=TRUE (value) (Bit 1: Optional child present), mask 0x04: 0=FALSE (unit__FALSE) (Bit 2: Optional child present), mask 0x04: 4=TRUE (unit) (Bit 2: Optional child present)}
      data-constr=V2xFac_VcCodePresenceType
      implementation-data-type=uint8
    V2xFac_VcCodeType: category=STRUCTURE
      7 x element, all with category=TYPE_REFERENCE:
        roadSignClass: implementation-data-type=V2xFac_VcClassType
        roadSignCode: implementation-data-type=uint8
        vcOption: implementation-data-type=V2xFac_VcOptionType
        validity: implementation-data-type=V2xFac_validity72Type
        value: implementation-data-type=uint16
        unit: implementation-data-type=V2xFac_RSCUnitType
        presence: implementation-data-type=V2xFac_VcCodePresenceType
    V2xFac_VcOptionType: compu {0=none, 1=a, 2=b, 3=c, 4=d, 5=e, 6=f, 7=g}, range raw undefined, implementation-data-type=uint8
    V2xFac_VdsType: category=STRUCTURE
      element count: implementation-data-type=uint8
      element values: category=ARRAY, array-size-semantics=FIXED-SIZE
        element values: array-size=undefined, array-size-semantics=FIXED-SIZE, implementation-data-type=uint8
    V2xFac_VehicleBreakdownSubCauseCodeType: compu {0=unavailable, 1=lackOfFuel, 2=lackOfBatteryPower, 3=engineProblem, 4=transmissionProblem, 5=engineCoolingProblem, 6=brakingSystemProblem, 7=steeringProblem, 8=tyrePuncture}, range raw undefined, implementation-data-type=uint8
    V2xFac_VehicleCharacteristicsFixValuesChoiceType: compu {0x01=V2XFAC_VEHICLECHARACTERISTICSFIXVALUES_SIMPLE_VEHICLE_TYPE, 0x02=V2XFAC_VEHICLECHARACTERISTICSFIXVALUES_EU_VEHICLE_CATEGORY_CODE, 0x03=V2XFAC_VEHICLECHARACTERISTICSFIXVALUES_ISO3833VEHICLE_TYPE, 0x04=V2XFAC_VEHICLECHARACTERISTICSFIXVALUES_EURO_AND_CO2VALUE, 0x05=V2XFAC_VEHICLECHARACTERISTICSFIXVALUES_ENGINE_CHARACTERISTICS, 0x06=V2XFAC_VEHICLECHARACTERISTICSFIXVALUES_LOAD_TYPE, 0x07=V2XFAC_VEHICLECHARACTERISTICSFIXVALUES_USAGE}, range raw 0x01..0x07
    V2xFac_VehicleCharacteristicsFixValuesCopy74Type: category=STRUCTURE
      8 x element, all with category=TYPE_REFERENCE:
        simpleVehicleType: implementation-data-type=V2xFac_StationTypeType, implementation-data-type=V2xFac_StationTypeType
        euVehicleCategoryCode: implementation-data-type=V2xFac_EuVehicleCategoryCodeType, implementation-data-type=V2xFac_EuVehicleCategoryCodeType
        iso3833VehicleType: implementation-data-type=V2xFac_Iso3833VehicleTypeType, implementation-data-type=V2xFac_Iso3833VehicleTypeType
        loadType: implementation-data-type=V2xFac_LoadTypeType, implementation-data-type=V2xFac_LoadTypeType
        usage: implementation-data-type=V2xFac_VehicleRoleType, implementation-data-type=V2xFac_VehicleRoleType
        choice: implementation-data-type=V2xFac_VehicleCharacteristicsFixValuesChoiceType, implementation-data-type=V2xFac_VehicleCharacteristicsFixValuesChoiceType
        euroAndCo2value: implementation-data-type=V2xFac_EnvironmentalCharacteristicsType
        engineCharacteristics: implementation-data-type=V2xFac_EngineCharacteristicsType
    V2xFac_VehicleCharacteristicsFixValuesCopy75Type: category=STRUCTURE
      8 x element, all with category=TYPE_REFERENCE:
        simpleVehicleType: implementation-data-type=V2xFac_StationTypeType, implementation-data-type=V2xFac_StationTypeType
        euVehicleCategoryCode: implementation-data-type=V2xFac_EuVehicleCategoryCodeType, implementation-data-type=V2xFac_EuVehicleCategoryCodeType
        iso3833VehicleType: implementation-data-type=V2xFac_Iso3833VehicleTypeType, implementation-data-type=V2xFac_Iso3833VehicleTypeType
        loadType: implementation-data-type=V2xFac_LoadTypeType, implementation-data-type=V2xFac_LoadTypeType
        usage: implementation-data-type=V2xFac_VehicleRoleType, implementation-data-type=V2xFac_VehicleRoleType
        choice: implementation-data-type=V2xFac_VehicleCharacteristicsFixValuesChoiceType, implementation-data-type=V2xFac_VehicleCharacteristicsFixValuesChoiceType
        euroAndCo2value: implementation-data-type=V2xFac_EnvironmentalCharacteristicsType
        engineCharacteristics: implementation-data-type=V2xFac_EngineCharacteristicsType
    V2xFac_VehicleCharacteristicsFixValuesType: category=STRUCTURE
      8 x element, all with category=TYPE_REFERENCE:
        simpleVehicleType: implementation-data-type=V2xFac_StationTypeType
        euVehicleCategoryCode: implementation-data-type=V2xFac_EuVehicleCategoryCodeType
        iso3833VehicleType: implementation-data-type=V2xFac_Iso3833VehicleTypeType
        euroAndCo2value: implementation-data-type=V2xFac_EnvironmentalCharacteristicsType
        engineCharacteristics: implementation-data-type=V2xFac_EngineCharacteristicsType
        loadType: implementation-data-type=V2xFac_LoadTypeType
        usage: implementation-data-type=V2xFac_VehicleRoleType
        choice: implementation-data-type=V2xFac_VehicleCharacteristicsFixValuesChoiceType
    V2xFac_VehicleCharacteristicsRangesCopy78Type: category=STRUCTURE
      element comparisonOperator: implementation-data-type=V2xFac_ComparisonOperatorType, implementation-data-type=V2xFac_ComparisonOperatorType
      element limits: implementation-data-type=V2xFac_limits76Type, implementation-data-type=V2xFac_limits76Type
    V2xFac_VehicleCharacteristicsRangesType: category=STRUCTURE
      element comparisonOperator: implementation-data-type=V2xFac_ComparisonOperatorType
      element limits: implementation-data-type=V2xFac_limits76Type
    V2xFac_VehicleDimensionsType: category=STRUCTURE
      element vehicleLengthOverall: implementation-data-type=V2xFac_Int1Type
      element vehicleHeigthOverall: implementation-data-type=V2xFac_Int1Type
      element vehicleWidthOverall: implementation-data-type=V2xFac_Int1Type
    V2xFac_VehicleGroupAffectedType: compu {9217=all_vehicles, 9218=bicycles, 9219=motorcycles, 9220=cars, 9221=light_vehicles, 9222=cars_and_light_vehicles, 9223=cars_with_trailers, 9224=cars_with_recreational_trailers, 9225=vehicles_with_trailers, 9226=heavy_vehicles, 9227=trucks, 9228=buses, 9229=articulated_buses, 9230=school_buses, 9231=vehicles_with_semi_trailers, 9232=vehicles_with_double_trailers, 9233=high_profile_vehicles, 9234=wide_vehicles, 9235=long_vehicles, 9236=hazardous_loads, 9237=exceptional_loads, 9238=abnormal_loads, 9239=convoys, 9240=maintenance_vehicles, 9241=delivery_vehicles, 9242=vehicles_with_even_numbered_license_plates, 9243=vehicles_with_odd_numbered_license_plates, 9244=vehicles_with_parking_permits, 9245=vehicles_with_catalytic_converters, 9246=vehicles_without_catalytic_converters, 9247=gas_powered_vehicles, 9248=diesel_powered_vehicles, 9249=lPG_vehicles, 9250=military_convoys, 9251=military_vehicles}, range raw 9217..9251
    V2xFac_VehicleIdentificationPresenceType: compu {mask 0x02: 0=FALSE (wmiNumber__FALSE) (Bit 1: Optional child present), mask 0x02: 2=TRUE (wmiNumber) (Bit 1: Optional child present), mask 0x01: 0=FALSE (vds__FALSE) (Bit 0 (LSB): Optional child present), mask 0x01: 1=TRUE (vds) (Bit 0 (LSB): Optional child present)}, range raw 0x00..0x03, implementation-data-type=uint8
    V2xFac_VehicleIdentificationType: category=STRUCTURE
      element presence: implementation-data-type=V2xFac_VehicleIdentificationPresenceType
      element wmiNumber: implementation-data-type=V2xFac_WmiNumberType
      element vds: implementation-data-type=V2xFac_VdsType
    V2xFac_VehicleLengthConfidenceIndicationType:
      compu {0x00=V2XFAC_VEHICLELENGTHCONFIDENCEINDICATION_NOTRAILERPRESENT, 0x01=V2XFAC_VEHICLELENGTHCONFIDENCEINDICATION_TRAILERPRESENTWITHKNOWNLENGTH, 0x02=V2XFAC_VEHICLELENGTHCONFIDENCEINDICATION_TRAILERPRESENTWITHUNKNOWNLENGTH, 0x03=V2XFAC_VEHICLELENGTHCONFIDENCEINDICATION_TRAILERPRESENCEISUNKNOWN, 0x04=V2XFAC_VEHICLELENGTHCONFIDENCEINDICATION_UNAVAILABLE}
      range raw 0x00..0x04
      implementation-data-type=uint8
    V2xFac_VehicleLengthType: category=STRUCTURE
      element vehicleLengthValue: implementation-data-type=uint16
      element vehicleLengthConfidenceIndication: implementation-data-type=V2xFac_VehicleLengthConfidenceIndicationType
    V2xFac_VehicleLengthValueType: compu {1=tenCentimeters, 1022=outOfRange, 1023=unavailable}, range raw undefined, implementation-data-type=uint16
    V2xFac_VehicleRoleType:
      compu {0x00=V2XFAC_VEHICLEROLE_DEFAULT, 0x01=V2XFAC_VEHICLEROLE_PUBLIC_TRANSPORT, 0x02=V2XFAC_VEHICLEROLE_SPECIAL_TRANSPORT, 0x03=V2XFAC_VEHICLEROLE_DANGEROUS_GOODS, 0x04=V2XFAC_VEHICLEROLE_ROAD_WORK, 0x05=V2XFAC_VEHICLEROLE_RESCUE, 0x06=V2XFAC_VEHICLEROLE_EMERGENCY, 0x07=V2XFAC_VEHICLEROLE_SAFETY_CAR, 0x08=V2XFAC_VEHICLEROLE_AGRICULTURAL, 0x09=V2XFAC_VEHICLEROLE_COMMERCIAL, 0x0a=V2XFAC_VEHICLEROLE_MILITARY, 0x0b=V2XFAC_VEHICLEROLE_ROAD_OPERATOR, 0x0c=V2XFAC_VEHICLEROLE_TAXI, 0x0d=V2XFAC_VEHICLEROLE_RESERVED_1, 0x0e=V2XFAC_VEHICLEROLE_RESERVED_2, 0x0f=V2XFAC_VEHICLEROLE_RESERVED_3}
      range raw 0x00..0x0f
      implementation-data-type=uint8
    V2xFac_VehicleWeightLimitsType: category=STRUCTURE
      element vehicleMaxLadenWeight: implementation-data-type=V2xFac_Int2Type
      element vehicleTrainMaximumWeight: implementation-data-type=V2xFac_Int2Type
      element vehicleWeightUnladen: implementation-data-type=V2xFac_Int2Type
    V2xFac_VehicleWidthType: compu {1=tenCentimeters, 61=outOfRange, 62=unavailable}, range raw undefined, implementation-data-type=uint8
    V2xFac_VelocityType: range raw undefined, implementation-data-type=uint16
    V2xFac_VerticalAccelerationType: category=STRUCTURE
      element verticalAccelerationValue: implementation-data-type=sint16
      element verticalAccelerationConfidence: implementation-data-type=uint8
    V2xFac_VerticalAccelerationValueType: compu {1=pointOneMeterPerSecSquaredUp, -1=pointOneMeterPerSecSquaredDown, 161=unavailable}, range raw undefined, implementation-data-type=sint16
    V2xFac_WMInumberType: range raw undefined, implementation-data-type=V2xFac_StringType
    V2xFac_WaitOnStoplineType: compu {mask 0x00: 0=FALSE (value__FALSE) (false if 0, true otherwise), mask 0x00: 0=TRUE (value) (false if 0, true otherwise)}, data-constr=V2xFac_WaitOnStoplineType, implementation-data-type=uint8
    V2xFac_WeightType: category=STRUCTURE
      element value: implementation-data-type=uint16
      element unit: implementation-data-type=V2xFac_RSCUnitType
    V2xFac_WheelBaseVehicleType: compu {1=tenCentimeters, 127=unavailable}, range raw undefined, implementation-data-type=uint8
    V2xFac_WmiNumberType: category=STRUCTURE
      element count: implementation-data-type=uint8
      element values: category=ARRAY, array-size-semantics=FIXED-SIZE
        element values: array-size=undefined, array-size-semantics=FIXED-SIZE, implementation-data-type=uint8
    V2xFac_WrongWayDrivingSubCauseCodeType: compu {0=unavailable, 1=wrongLane, 2=wrongDirection}, range raw undefined, implementation-data-type=uint8
    V2xFac_YawRateConfidenceType: compu {0x00=YAWRATECONFIDENCE_DEGSEC_000_01, 0x01=YAWRATECONFIDENCE_DEGSEC_000_05, 0x02=YAWRATECONFIDENCE_DEGSEC_000_10, 0x03=YAWRATECONFIDENCE_DEGSEC_001_00, 0x04=YAWRATECONFIDENCE_DEGSEC_005_00, 0x05=YAWRATECONFIDENCE_DEGSEC_010_00, 0x06=YAWRATECONFIDENCE_DEGSEC_100_00, 0x07=YAWRATECONFIDENCE_OUTOFRANGE, 0x08=YAWRATECONFIDENCE_UNAVAILABLE}, range raw 0x00..0x08, implementation-data-type=uint8
    V2xFac_YawRateType: category=STRUCTURE
      element yawRateValue: implementation-data-type=sint16
      element yawRateConfidence: implementation-data-type=V2xFac_YawRateConfidenceType
    V2xFac_YawRateValueType: compu {0=straight, -1=degSec_000_01ToRight, 1=degSec_000_01ToLeft, 32767=unavailable}, range raw undefined, implementation-data-type=sint16
    V2xFac_ZidType: range raw undefined, implementation-data-type=uint8
    V2xFac_ZoneChoiceType: compu {0x01=V2XFAC_ZONE_SEGMENT, 0x02=V2XFAC_ZONE_AREA, 0x03=V2XFAC_ZONE_COMPUTED_SEGMENT}, range raw 0x01..0x03
    V2xFac_ZoneLengthType: range raw undefined, implementation-data-type=uint16
    V2xFac_ZoneType: category=STRUCTURE
      4 x element, all with category=TYPE_REFERENCE:
        segment: implementation-data-type=V2xFac_SegmentType
        area: implementation-data-type=V2xFac_PolygonalLineType
        computedSegment: implementation-data-type=V2xFac_ComputedSegmentType
        choice: implementation-data-type=V2xFac_ZoneChoiceType
    V2xFac_absolutePositions56Type: category=STRUCTURE
      element count: implementation-data-type=uint8
      element values: category=ARRAY, array-size-semantics=FIXED-SIZE
        element values: array-size=undefined, array-size-semantics=FIXED-SIZE, implementation-data-type=V2xFac_AbsolutePositionType
    V2xFac_absolutePositionsWithAltitude57Type: category=STRUCTURE
      element count: implementation-data-type=uint8
      element values: category=ARRAY, array-size-semantics=FIXED-SIZE
        element values: array-size=undefined, array-size-semantics=FIXED-SIZE, implementation-data-type=V2xFac_AbsolutePositionWAltitudeType
    V2xFac_ambientOrRoadConditionPictogram44Type: compu {0=ambientCondition, 1=roadCondition}, range raw 0..1
    V2xFac_applicableLanes11Type: category=STRUCTURE
      element count: implementation-data-type=uint8
      element values: category=ARRAY, array-size-semantics=FIXED-SIZE
        element values: array-size=undefined, array-size-semantics=FIXED-SIZE, implementation-data-type=V2xFac_LanePositionType
    V2xFac_applicableLanes22Type: category=STRUCTURE
      element count: implementation-data-type=uint8
      element values: category=ARRAY, array-size-semantics=FIXED-SIZE
        element values: array-size=undefined, array-size-semantics=FIXED-SIZE, implementation-data-type=V2xFac_LanePositionType
    V2xFac_code59ChoiceType: compu {0x01=V2XFAC_CODE59_VIENNA_CONVENTION, 0x02=V2XFAC_CODE59_ISO14823, 0x03=V2XFAC_CODE59_ITIS_CODES, 0x04=V2XFAC_CODE59_ANY_CATALOGUE}, range raw 0x01..0x04
    V2xFac_code59Type: category=STRUCTURE
      5 x element, all with category=TYPE_REFERENCE:
        viennaConvention: implementation-data-type=V2xFac_VcCodeType
        iso14823: implementation-data-type=V2xFac_ISO14823CodeType
        itisCodes: implementation-data-type=uint16
        anyCatalogue: implementation-data-type=V2xFac_AnyCatalogueType
        choice: implementation-data-type=V2xFac_code59ChoiceType
    V2xFac_countryCode40Type: category=ARRAY
      element V2xFac_countryCode40Type: array-size=undefined, array-size-semantics=FIXED-SIZE, implementation-data-type=uint8
    V2xFac_data26Type: category=ARRAY
      element V2xFac_data26Type: category=TYPE_REFERENCE, array-size=undefined, array-size-semantics=FIXED-SIZE
    V2xFac_deltaPositions54Type: category=STRUCTURE
      element count: implementation-data-type=uint8
      element values: category=ARRAY, array-size-semantics=FIXED-SIZE
        element values: array-size=undefined, array-size-semantics=FIXED-SIZE, implementation-data-type=V2xFac_DeltaPositionType
    V2xFac_deltaPositionsWithAltitude55Type: category=STRUCTURE
      element count: implementation-data-type=uint8
      element values: category=ARRAY, array-size-semantics=FIXED-SIZE
        element values: array-size=undefined, array-size-semantics=FIXED-SIZE, implementation-data-type=V2xFac_DeltaReferencePositionType
    V2xFac_depBlob100Type: category=ARRAY
      element V2xFac_depBlob100Type: category=TYPE_REFERENCE, array-size=undefined, array-size-semantics=FIXED-SIZE
    V2xFac_detectionZoneIds18Type: category=STRUCTURE
      element count: implementation-data-type=uint8
      element values: category=ARRAY, array-size-semantics=FIXED-SIZE
        element values: array-size=undefined, array-size-semantics=FIXED-SIZE, implementation-data-type=V2xFac_ZidType
    V2xFac_detectionZoneIds7Type: category=STRUCTURE
      element count: implementation-data-type=uint8
      element values: category=ARRAY, array-size-semantics=FIXED-SIZE
        element values: array-size=undefined, array-size-semantics=FIXED-SIZE, implementation-data-type=V2xFac_ZidType
    V2xFac_dp96Type: category=STRUCTURE
      element count: implementation-data-type=uint8
      element values: category=ARRAY, array-size-semantics=FIXED-SIZE
        element values: array-size=undefined, array-size-semantics=FIXED-SIZE, implementation-data-type=V2xFac_DestinationPlaceType
    V2xFac_dr97Type: category=STRUCTURE
      element count: implementation-data-type=uint8
      element values: category=ARRAY, array-size-semantics=FIXED-SIZE
        element values: array-size=undefined, array-size-semantics=FIXED-SIZE, implementation-data-type=V2xFac_DestinationRoadType
    V2xFac_driverAwarenessZoneIds20Type: category=STRUCTURE
      element count: implementation-data-type=uint8
      element values: category=ARRAY, array-size-semantics=FIXED-SIZE
        element values: array-size=undefined, array-size-semantics=FIXED-SIZE, implementation-data-type=V2xFac_ZidType
    V2xFac_driverAwarenessZoneIds9Type: category=STRUCTURE
      element count: implementation-data-type=uint8
      element values: category=ARRAY, array-size-semantics=FIXED-SIZE
        element values: array-size=undefined, array-size-semantics=FIXED-SIZE, implementation-data-type=V2xFac_ZidType
    V2xFac_equalTo65Type: category=STRUCTURE
      element count: implementation-data-type=uint8
      element values: category=ARRAY, array-size-semantics=FIXED-SIZE
        element values: array-size=undefined, array-size-semantics=FIXED-SIZE, implementation-data-type=V2xFac_VehicleCharacteristicsFixValuesType
    V2xFac_equalTo68Type: category=STRUCTURE
      element count: implementation-data-type=uint8
      element values: category=ARRAY, array-size-semantics=FIXED-SIZE
        element values: array-size=undefined, array-size-semantics=FIXED-SIZE, implementation-data-type=V2xFac_VehicleCharacteristicsFixValuesCopy74Type
    V2xFac_extraText15Type: category=STRUCTURE
      element count: implementation-data-type=uint8
      element values: category=ARRAY, array-size-semantics=FIXED-SIZE
        element values: array-size=undefined, array-size-semantics=FIXED-SIZE, implementation-data-type=V2xFac_TextCopy63Type
    V2xFac_geoidUsed111Type: range raw undefined, implementation-data-type=V2xFac_StringType
    V2xFac_hourMinutes84Type: category=STRUCTURE
      element shm: implementation-data-type=V2xFac_HoursMinutesType
      element ehm: implementation-data-type=V2xFac_HoursMinutesType
    V2xFac_ioList94Type: category=STRUCTURE
      element count: implementation-data-type=uint8
      element values: category=ARRAY, array-size-semantics=FIXED-SIZE
        element values: array-size=undefined, array-size-semantics=FIXED-SIZE, implementation-data-type=V2xFac_DDD_IOType
    V2xFac_item114ChoiceType: compu {0x01=V2XFAC_ITEM114_ITIS, 0x02=V2XFAC_ITEM114_TEXT}, range raw 0x01..0x02
    V2xFac_item114Type: category=STRUCTURE
      element itis: implementation-data-type=V2xFac_ITIScodesType
      element text: implementation-data-type=V2xFac_ITIStextType
      element choice: implementation-data-type=V2xFac_item114ChoiceType
    V2xFac_laneConfiguration17Type: category=STRUCTURE
      element count: implementation-data-type=uint8
      element values: category=ARRAY, array-size-semantics=FIXED-SIZE
        element values: array-size=undefined, array-size-semantics=FIXED-SIZE, implementation-data-type=V2xFac_LaneInformationType
    V2xFac_language62Type: compu {bitfield_texttable}, data-constr=V2xFac_language62Type, implementation-data-type=uint8
    V2xFac_lastCheckedDate110Type: range raw undefined, implementation-data-type=V2xFac_StringType
    V2xFac_layoutComponents30Type: category=STRUCTURE
      element count: implementation-data-type=uint8
      element values: category=ARRAY, array-size-semantics=FIXED-SIZE
        element values: array-size=undefined, array-size-semantics=FIXED-SIZE, implementation-data-type=V2xFac_LayoutComponentType
    V2xFac_limits76ChoiceType: compu {0x01=V2XFAC_LIMITS76_NUMBER_OF_AXLES, 0x02=V2XFAC_LIMITS76_VEHICLE_DIMENSIONS, 0x03=V2XFAC_LIMITS76_VEHICLE_WEIGHT_LIMITS, 0x04=V2XFAC_LIMITS76_AXLE_WEIGHT_LIMITS, 0x05=V2XFAC_LIMITS76_PASSENGER_CAPACITY, 0x06=V2XFAC_LIMITS76_EXHAUST_EMISSION_VALUES, 0x07=V2XFAC_LIMITS76_DIESEL_EMISSION_VALUES, 0x08=V2XFAC_LIMITS76_SOUND_LEVEL}, range raw 0x01..0x08
    V2xFac_limits76Type: category=STRUCTURE
      9 x element, all with category=TYPE_REFERENCE:
        numberOfAxles: implementation-data-type=uint8
        vehicleDimensions: implementation-data-type=V2xFac_VehicleDimensionsType
        vehicleWeightLimits: implementation-data-type=V2xFac_VehicleWeightLimitsType
        axleWeightLimits: implementation-data-type=V2xFac_AxleWeightLimitsType
        passengerCapacity: implementation-data-type=V2xFac_PassengerCapacityType
        exhaustEmissionValues: implementation-data-type=V2xFac_ExhaustEmissionValuesType
        dieselEmissionValues: implementation-data-type=V2xFac_DieselEmissionValuesType
        soundLevel: implementation-data-type=V2xFac_SoundLevelType
        choice: implementation-data-type=V2xFac_limits76ChoiceType
    V2xFac_month_day83Type: category=STRUCTURE
      element smd: implementation-data-type=V2xFac_MonthDayType
      element emd: implementation-data-type=V2xFac_MonthDayType
    V2xFac_notEqualTo66Type: category=STRUCTURE
      element count: implementation-data-type=uint8
      element values: category=ARRAY, array-size-semantics=FIXED-SIZE
        element values: array-size=undefined, array-size-semantics=FIXED-SIZE, implementation-data-type=V2xFac_VehicleCharacteristicsFixValuesType
    V2xFac_notEqualTo69Type: category=STRUCTURE
      element count: implementation-data-type=uint8
      element values: category=ARRAY, array-size-semantics=FIXED-SIZE
        element values: array-size=undefined, array-size-semantics=FIXED-SIZE, implementation-data-type=V2xFac_VehicleCharacteristicsFixValuesCopy75Type
    V2xFac_offsetXaxis106ChoiceType: compu {0x01=V2XFAC_OFFSETXAXIS106_SMALL, 0x02=V2XFAC_OFFSETXAXIS106_LARGE}, range raw 0x01..0x02
    V2xFac_offsetXaxis106Type: category=STRUCTURE
      element small: implementation-data-type=V2xFac_DrivenLineOffsetSmType
      element large: implementation-data-type=V2xFac_DrivenLineOffsetLgType
      element choice: implementation-data-type=V2xFac_offsetXaxis106ChoiceType
    V2xFac_offsetYaxis107ChoiceType: compu {0x01=V2XFAC_OFFSETYAXIS107_SMALL, 0x02=V2XFAC_OFFSETYAXIS107_LARGE}, range raw 0x01..0x02
    V2xFac_offsetYaxis107Type: category=STRUCTURE
      element small: implementation-data-type=V2xFac_DrivenLineOffsetSmType
      element large: implementation-data-type=V2xFac_DrivenLineOffsetLgType
      element choice: implementation-data-type=V2xFac_offsetYaxis107ChoiceType
    V2xFac_optional4Type: category=STRUCTURE
      element count: implementation-data-type=uint8
      element values: category=ARRAY, array-size-semantics=FIXED-SIZE
        element values: array-size=undefined, array-size-semantics=FIXED-SIZE, implementation-data-type=V2xFac_IviContainerType
    V2xFac_particulate0Type: category=STRUCTURE
      element unitType: implementation-data-type=V2xFac_UnitTypeType
      element value: implementation-data-type=uint16
    V2xFac_parts5Type: category=STRUCTURE
      element count: implementation-data-type=uint8
      element values: category=ARRAY, array-size-semantics=FIXED-SIZE
        element values: array-size=undefined, array-size-semantics=FIXED-SIZE, implementation-data-type=V2xFac_GlcPartType
    V2xFac_pictogramCategoryCode45Type: category=STRUCTURE
      element nature: implementation-data-type=uint8
      element serialNumber: implementation-data-type=uint8
    V2xFac_pictogramCode39Type: category=STRUCTURE
      element countryCode: implementation-data-type=V2xFac_countryCode40Type
      element serviceCategoryCode: implementation-data-type=V2xFac_serviceCategoryCode41Type
      element pictogramCategoryCode: implementation-data-type=V2xFac_pictogramCategoryCode45Type
    V2xFac_processAgency109Type: range raw undefined, implementation-data-type=V2xFac_StringType
    V2xFac_processMethod108Type: range raw undefined, implementation-data-type=V2xFac_StringType
    V2xFac_publicFacilitiesPictogram43Type: compu {0=publicFacilities}, range raw 0
    V2xFac_ranges67Type: category=STRUCTURE
      element count: implementation-data-type=uint8
      element values: category=ARRAY, array-size-semantics=FIXED-SIZE
        element values: array-size=undefined, array-size-semantics=FIXED-SIZE, implementation-data-type=V2xFac_VehicleCharacteristicsRangesType
    V2xFac_ranges70Type: category=STRUCTURE
      element count: implementation-data-type=uint8
      element values: category=ARRAY, array-size-semantics=FIXED-SIZE
        element values: array-size=undefined, array-size-semantics=FIXED-SIZE, implementation-data-type=V2xFac_VehicleCharacteristicsRangesCopy78Type
    V2xFac_relevanceZoneIds19Type: category=STRUCTURE
      element count: implementation-data-type=uint8
      element values: category=ARRAY, array-size-semantics=FIXED-SIZE
        element values: array-size=undefined, array-size-semantics=FIXED-SIZE, implementation-data-type=V2xFac_ZidType
    V2xFac_relevanceZoneIds8Type: category=STRUCTURE
      element count: implementation-data-type=uint8
      element values: category=ARRAY, array-size-semantics=FIXED-SIZE
        element values: array-size=undefined, array-size-semantics=FIXED-SIZE, implementation-data-type=V2xFac_ZidType
    V2xFac_roadSignCodes14Type: category=STRUCTURE
      element count: implementation-data-type=uint8
      element values: category=ARRAY, array-size-semantics=FIXED-SIZE
        element values: array-size=undefined, array-size-semantics=FIXED-SIZE, implementation-data-type=V2xFac_RSCodeType
    V2xFac_serviceCategoryCode41ChoiceType: compu {0x01=V2XFAC_SERVICECATEGORYCODE41_TRAFFIC_SIGN_PICTOGRAM, 0x02=V2XFAC_SERVICECATEGORYCODE41_PUBLIC_FACILITIES_PICTOGRAM, 0x03=V2XFAC_SERVICECATEGORYCODE41_AMBIENT_OR_ROAD_CONDITION_PICTOGRAM}, range raw 0x01..0x03
    V2xFac_serviceCategoryCode41Type: category=STRUCTURE
      4 x element, all with category=TYPE_REFERENCE:
        trafficSignPictogram: implementation-data-type=V2xFac_trafficSignPictogram42Type
        publicFacilitiesPictogram: implementation-data-type=V2xFac_publicFacilitiesPictogram43Type
        ambientOrRoadConditionPictogram: implementation-data-type=V2xFac_ambientOrRoadConditionPictogram44Type
        choice: implementation-data-type=V2xFac_serviceCategoryCode41ChoiceType
    V2xFac_text25Type: category=STRUCTURE
      element count: implementation-data-type=uint8
      element values: category=ARRAY, array-size-semantics=FIXED-SIZE
        element values: array-size=undefined, array-size-semantics=FIXED-SIZE, implementation-data-type=V2xFac_TextType
    V2xFac_textScripting53Type: compu {0=horizontal, 1=vertical}, range raw undefined, implementation-data-type=uint8
    V2xFac_trafficSignPictogram42Type: compu {0=dangerWarning, 1=regulatory, 2=informative}, range raw 0..2
    V2xFac_trailer34Type: category=STRUCTURE
      element count: implementation-data-type=uint8
      element values: category=ARRAY, array-size-semantics=FIXED-SIZE
        element values: array-size=undefined, array-size-semantics=FIXED-SIZE, implementation-data-type=V2xFac_TrailerCharacteristicsType
    V2xFac_validity72Type: category=STRUCTURE
      element count: implementation-data-type=uint8
      element values: category=ARRAY, array-size-semantics=FIXED-SIZE
        element values: array-size=undefined, array-size-semantics=FIXED-SIZE, implementation-data-type=V2xFac_DTMType
    V2xFac_year80Type: category=STRUCTURE
      element syr: implementation-data-type=uint16
      element eyr: implementation-data-type=uint16
    V2xFac_zoneIds16Type: category=STRUCTURE
      element count: implementation-data-type=uint8
      element values: category=ARRAY, array-size-semantics=FIXED-SIZE
        element values: array-size=undefined, array-size-semantics=FIXED-SIZE, implementation-data-type=V2xFac_ZidType
