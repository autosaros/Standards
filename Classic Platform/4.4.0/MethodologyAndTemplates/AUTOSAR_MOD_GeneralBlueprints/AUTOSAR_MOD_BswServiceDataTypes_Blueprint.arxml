[part 1 of 3: packages /AUTOSAR/ComM/ImplementationDataTypes_Blueprint to /AUTOSAR/StbM/ImplementationDataTypes_Blueprint]
AUTOSAR XML (schema 00046)
package /AUTOSAR/ComM/ImplementationDataTypes_Blueprint
  5 x impl type:
    ComM_InhibitionStatusType:
      compu {mask 0x01: 0=FALSE (WakeupInhibitionActive__FALSE) (Bit 0 (LSB): Wake Up inhibition active), mask 0x01: 1=TRUE (WakeupInhibitionActive) (Bit 0 (LSB): Wake Up inhibition active), mask 0x02: 0=FALSE (LimitedToNoCom__FALSE) (Bit 1: Limit to COMM_NO_COMMUNICATION mode), mask 0x02: 2=TRUE (LimitedToNoCom) (Bit 1: Limit to COMM_NO_COMMUNICATION mode)}
      range raw 0x00..0x03
      implementation-data-type=uint8
    ComM_ModeType: compu {2=COMM_FULL_COMMUNICATION, 0=COMM_NO_COMMUNICATION, 1=COMM_SILENT_COMMUNICATION}, range raw 0..2, implementation-data-type=uint8
    ComM_UserHandleArrayType: category=STRUCTURE
      element numberOfRequesters: implementation-data-type=uint8
      element handleArray: implementation-data-type=ComM_UserHandleSubArrayType, variation-point=blueprint-condition=p=l-1=channel_name = {ecuc(ComM/ComMConfigSet/ComMChannel.SHORT-NAME)}
    ComM_UserHandleSubArrayType: category=ARRAY
      element ComM_UserHandleSubArrayType: array-size=undefined, array-size-semantics=FIXED-SIZE, implementation-data-type=ComM_UserHandleType
    ComM_UserHandleType: range raw undefined, implementation-data-type=uint8
package /AUTOSAR/ComStack_Types/ImplementationDataTypes_Blueprint
  impl type NetworkHandleType: range raw undefined, implementation-data-type=uint8
package /AUTOSAR/Csm/ImplementationDataTypes_Blueprint
  28 x impl type:
    Crypto_OperationModeType: compu {0x01=CRYPTO_OPERATIONMODE_START, 0x02=CRYPTO_OPERATIONMODE_UPDATE, 0x03=CRYPTO_OPERATIONMODE_STREAMSTART, 0x04=CRYPTO_OPERATIONMODE_FINISH, 0x07=CRYPTO_OPERATIONMODE_SINGLECALL}, range raw 0x01..0x07
    Crypto_VerifyResultType: compu {0x00=CRYPTO_E_VER_OK, 0x01=CRYPTO_E_VER_NOT_OK}, range raw 0x00..0x01
    Csm_AEADDecryptAssociatedDataType: category=ARRAY
      element Csm_AEADDecryptAssociatedDataType: array-size=undefined, array-size-semantics=FIXED-SIZE, implementation-data-type=uint8
    Csm_AEADDecryptCiphertextType: category=ARRAY
      element Csm_AEADDecryptCiphertextType: array-size=undefined, array-size-semantics=FIXED-SIZE, implementation-data-type=uint8
    Csm_AEADDecryptPlaintextType: category=ARRAY
      element Csm_AEADDecryptPlaintextType: array-size=undefined, array-size-semantics=FIXED-SIZE, implementation-data-type=uint8
    Csm_AEADDecryptTagType: category=ARRAY
      element Csm_AEADDecryptTagType: array-size=undefined, array-size-semantics=FIXED-SIZE, implementation-data-type=uint8
    Csm_AEADEncryptAssociatedDataType: category=ARRAY
      element Csm_AEADEncryptAssociatedDataType: array-size=undefined, array-size-semantics=FIXED-SIZE, implementation-data-type=uint8
    Csm_AEADEncryptCiphertextType: category=ARRAY
      element Csm_AEADEncryptCiphertextType: array-size=undefined, array-size-semantics=FIXED-SIZE, implementation-data-type=uint8
    Csm_AEADEncryptPlaintextType: category=ARRAY
      element Csm_AEADEncryptPlaintextType: array-size=undefined, array-size-semantics=FIXED-SIZE, implementation-data-type=uint8
    Csm_AEADEncryptTagType: category=ARRAY
      element Csm_AEADEncryptTagType: array-size=undefined, array-size-semantics=FIXED-SIZE, implementation-data-type=uint8
    Csm_DataPtr: category=DATA_REFERENCE, sw-pointer-target-props={target-category=TYPE_REFERENCE, implementation-data-type=uint8, sw-impl-policy=CONST}
    Csm_DecryptDataType: category=ARRAY
      element Csm_DecryptDataType: array-size=undefined, array-size-semantics=FIXED-SIZE, implementation-data-type=uint8
    Csm_DecryptResultType: category=ARRAY
      element Csm_DecryptResultType: array-size=undefined, array-size-semantics=FIXED-SIZE, implementation-data-type=uint8
    Csm_EncryptDataType: category=ARRAY
      element Csm_EncryptDataType: array-size=undefined, array-size-semantics=FIXED-SIZE, implementation-data-type=uint8
    Csm_EncryptResultType: category=ARRAY
      element Csm_EncryptResultType: array-size=undefined, array-size-semantics=FIXED-SIZE, implementation-data-type=uint8
    Csm_HashDataType: category=ARRAY
      element Csm_HashDataType: array-size=undefined, array-size-semantics=FIXED-SIZE, implementation-data-type=uint8
    Csm_HashResultType: category=ARRAY
      element Csm_HashResultType: array-size=undefined, array-size-semantics=FIXED-SIZE, implementation-data-type=uint8
    Csm_KeyDataType: category=ARRAY
      element Csm_KeyDataType: array-size=undefined, array-size-semantics=FIXED-SIZE, implementation-data-type=uint8
    Csm_MacGenerateDataType: category=ARRAY
      element Csm_MacGenerateDataType: array-size=undefined, array-size-semantics=FIXED-SIZE, implementation-data-type=uint8
    Csm_MacGenerateResultType: category=ARRAY
      element Csm_MacGenerateResultType: array-size=undefined, array-size-semantics=FIXED-SIZE, implementation-data-type=uint8
    Csm_MacVerifyCompareType: category=ARRAY
      element Csm_MacVerifyCompareType: array-size=undefined, array-size-semantics=FIXED-SIZE, implementation-data-type=uint8
    Csm_MacVerifyDataType: category=ARRAY
      element Csm_MacVerifyDataType: array-size=undefined, array-size-semantics=FIXED-SIZE, implementation-data-type=uint8
    Csm_RandomGenerateResultType: category=ARRAY
      element Csm_RandomGenerateResultType: array-size=undefined, array-size-semantics=FIXED-SIZE, implementation-data-type=uint8
    Csm_ResultType: compu {0x02=E_SMALL_BUFFER, 0x03=E_ENTROPY_EXHAUSTION, 0x04=E_KEY_READ_FAIL, 0x05=E_KEY_NOT_AVAILABLE, 0x06=E_KEY_NOT_VALID, 0x07=E_JOB_CANCELED, 0x00=E_OK, 0x01=E_NOT_OK, 0x08=E_KEY_EMPTY, 0=E_OK, 1=E_NOT_OK}, range raw 0x00..0x08, implementation-data-type=Std_ReturnType
    Csm_SignatureGenerateDataType: category=ARRAY
      element Csm_SignatureGenerateDataType: array-size=undefined, array-size-semantics=FIXED-SIZE, implementation-data-type=uint8
    Csm_SignatureGenerateResultType: category=ARRAY
      element Csm_SignatureGenerateResultType: array-size=undefined, array-size-semantics=FIXED-SIZE, implementation-data-type=uint8
    Csm_SignatureVerifyCompareType: category=ARRAY
      element Csm_SignatureVerifyCompareType: array-size=undefined, array-size-semantics=FIXED-SIZE, implementation-data-type=uint8
    Csm_SignatureVerifyDataType: category=ARRAY
      element Csm_SignatureVerifyDataType: array-size=undefined, array-size-semantics=FIXED-SIZE, implementation-data-type=uint8
package /AUTOSAR/Dcm/ImplementationDataTypes_Blueprint
  57 x impl type:
    ControlMask:
      variation-point=blueprint-condition=p=l-1=({ecuc(Dcm/DcmConfigSet/DcmDsp/DcmDspData.DcmDspDataUsePort)} == (USE_DATA_SYNCH_CLIENT_SERVER || USE_DATA_ASYNCH_CLIENT_SERVER || USE_DATA_ASYNCH_CLIENT_SERVER_ERROR)) && ({ecuc(Dcm/DcmConfigSet/DcmDsp/DcmDspDid/DcmDspDidInfoRef->DcmDspDidInfo/DcmDspDidControl/DcmDspDidControlMask)} == DCM_CONTROLMASK_EXTERNAL) &&({ecuc(Dcm/DcmConfigSet/DcmDsp/DcmDspDid/DcmDspDidInfoRef->DcmDspDidInfo/DcmDspDidControl/DcmDspDidControlEnableMask)} == NULL)
      range raw undefined
      implementation-data-type=uint8
      variation-point=blueprint-condition=verbatim=l-5=({ecuc(Dcm/DcmConfigSet/DcmDsp/DcmDspData/DcmDspDataInfoRef->DcmDspDidInfo/DcmDspDidControl/DcmDspDidControlMaskSize)} == 0x01)
      range raw undefined
      implementation-data-type=uint16
      variation-point=blueprint-condition=verbatim=l-5=({ecuc(Dcm/DcmConfigSet/DcmDsp/DcmDspData/DcmDspDataInfoRef->DcmDspDidInfo/DcmDspDidControl/DcmDspDidControlMaskSize)} == 0x02)
      range raw undefined
      implementation-data-type=uint32
      variation-point=blueprint-condition=verbatim=l-5=({ecuc(Dcm/DcmConfigSet/DcmDsp/DcmDspData/DcmDspDataInfoRef->DcmDspDidInfo/DcmDspDidControl/DcmDspDidControlMaskSize)} >= 0x03)
    Dcm_AuthenticationRoleType: category=ARRAY
      element Dcm_AuthenticationRoleType: array-size=undefined, array-size-semantics=FIXED-SIZE, implementation-data-type=uint8
    Dcm_ConfirmationStatusType: compu {0x00=DCM_RES_POS_OK, 0x01=DCM_RES_POS_NOT_OK, 0x02=DCM_RES_NEG_OK, 0x03=DCM_RES_NEG_NOT_OK}, range raw 0x00..0x03, implementation-data-type=uint8
    Dcm_ControlMaskType:
      variation-point=blueprint-condition=p=l-1=({ecuc(Dcm/DcmConfigSet/DcmDsp/DcmDspData.DcmDspDataUsePort)} == (USE_DATA_SYNCH_CLIENT_SERVER || USE_DATA_ASYNCH_CLIENT_SERVER || USE_DATA_ASYNCH_CLIENT_SERVER_ERROR)) && ({ecuc(Dcm/DcmConfigSet/DcmDsp/DcmDspDid/DcmDspDidInfoRef->DcmDspDidInfo/DcmDspDidControl/DcmDspDidControlMask)} == DCM_CONTROLMASK_EXTERNAL) && ({ecuc(Dcm/?DcmConfigSet/?DcmDsp/?DcmDspDid/?DcmDspDidInfoRef->DcmDspDidInfo/?DcmDspDidControl/?DcmDspDidControlEnableMask)} == NULL)
      range raw undefined
      implementation-data-type=Dcm_ControlMask_ArrayType
      variation-point=blueprint-condition=verbatim=l-5=Variation ({ecuc(Dcm/DcmConfigSet/DcmDsp/DcmDspDid/DcmDspDidInfoRef->DcmDspDidInfo/DcmDspDidControl/DcmDspDidControlMaskSize)} >= 0x05
      range raw undefined
      implementation-data-type=uint8
      variation-point=blueprint-condition=verbatim=l-5=({ecuc(Dcm/DcmConfigSet/DcmDsp/DcmDspDid/DcmDspDidInfoRef->DcmDspDidInfo/DcmDspDidControl/DcmDspDidControlMaskSize)} == 0x01)
      range raw undefined
      implementation-data-type=uint16
      variation-point=blueprint-condition=verbatim=l-5=({ecuc(Dcm/DcmConfigSet/DcmDsp/DcmDspDid/DcmDspDidInfoRef->DcmDspDidInfo/DcmDspDidControl/DcmDspDidControlMaskSize)} == 0x02)
      range raw undefined
      implementation-data-type=uint32
      variation-point=blueprint-condition=verbatim=l-5=(({ecuc(Dcm/DcmConfigSet/DcmDsp/DcmDspDid/DcmDspDidInfoRef->DcmDspDidInfo/DcmDspDidControl/DcmDspDidControlMaskSize)}== 0x03)||{ecuc(Dcm/DcmConfigSet/DcmDsp/DcmDspDid/DcmDspDidInfoRef->DcmDspDidInfo/DcmDspDidControl/DcmDspDidControlMaskSize)}== 0x04))
    Dcm_ControlMask_16Type:
      variation-point=blueprint-condition=p=l-1=({ecuc(Dcm/DcmConfigSet/DcmDsp/DcmDspData/DcmDspDataUsePort)} == USE_DATA_SENDER_RECEIVER || USE_DATA_SENDER_RECEIVER_AS_SERVICE) && ({ecuc(Dcm/DcmConfigSet/DcmDsp/DcmDspDid/DcmDspDidInfoRef->DcmDspDidInfo/DcmDspDidControl/DcmDspDidControlEnableMask)} == NULL) &&({ecuc(Dcm/DcmConfigSet/DcmDsp/DcmDspDid/DcmDspDidInfoRef->DcmDspDidInfo/DcmDspDidControl/DcmDspDidControlMaskSize)} == 0x02)
      range raw undefined
      implementation-data-type=uint16
    Dcm_ControlMask_32Type:
      variation-point=blueprint-condition=p=l-1=({ecuc(Dcm/DcmConfigSet/DcmDsp/DcmDspData/DcmDspDataUsePort)} == USE_DATA_SENDER_RECEIVER || USE_DATA_SENDER_RECEIVER_AS_SERVICE) && ({ecuc(Dcm/DcmConfigSet/DcmDsp/DcmDspDid/DcmDspDidInfoRef->DcmDspDidInfo/DcmDspDidControl/DcmDspDidControlEnableMask)} == NULL) && ({ecuc(Dcm/DcmConfigSet/DcmDsp/DcmDspDid/DcmDspDidInfoRef->DcmDspDidInfo/DcmDspDidControl/DcmDspDidControlMaskSize)} >= 0x03)
      range raw undefined
      implementation-data-type=uint32
    Dcm_ControlMask_8Type:
      variation-point=blueprint-condition=p=l-1=({ecuc(Dcm/DcmConfigSet/DcmDsp/DcmDspData/DcmDspDataUsePort)} == USE_DATA_SENDER_RECEIVER || USE_DATA_SENDER_RECEIVER_AS_SERVICE) && ({ecuc(Dcm/DcmConfigSet/DcmDsp/DcmDspDid/DcmDspDidInfoRef->DcmDspDidInfo/DcmDspDidControl/DcmDspDidControlEnableMask)} == NULL) && ({ecuc(Dcm/DcmConfigSet/DcmDsp/DcmDspDid/DcmDspDidInfoRef->DcmDspDidInfo/DcmDspDidControl/DcmDspDidControlMaskSize)} == 0x01)
      range raw undefined
      implementation-data-type=uint8
    Dcm_ControlMask_ArrayType: category=ARRAY, variation-point=blueprint-condition=p=l-1=({ecuc(Dcm/?DcmConfigSet/?DcmDsp/?DcmDspData.?DcmDspDataUsePort)} == (USE_DATA_SYNCH_CLIENT_SERVER || USE_DATA_ASYNCH_CLIENT_SERVER || USE_DATA_ASYNCH_CLIENT_SERVER_ERROR)) &&({ecuc(Dcm/?DcmConfigSet/?DcmDsp/?DcmDspDid/?DcmDspDidInfoRef->DcmDspDidInfo/?DcmDspDidControl/?DcmDspDidControlMask)} == DCM_CONTROLMASK_EXTERNAL) &&({ecuc(Dcm/?DcmConfigSet/?DcmDsp/?DcmDspDid/?DcmDspDidInfoRef->DcmDspDidInfo/?DcmDspDidControl/?DcmDspDidControlEnableMask)} == NULL) &&({ecuc(Dcm/DcmConfigSet/DcmDsp/DcmDspDid/DcmDspDidInfoRef->DcmDspDidInfo/DcmDspDidControl/DcmDspDidControlMaskSize)} >= 0x05)
      element Dcm_ControlMask_ArrayType: array-size=undefined, array-size-semantics=FIXED-SIZE, implementation-data-type=uint8
    Dcm_DID_Struct_DataType: category=STRUCTURE, variation-point=blueprint-condition=p=l-1=({ecuc(Dcm/DcmConfigSet/DcmDsp/DcmDspDid/DcmDspDidUsePort)} == ((USE_ATOMIC_SENDER_RECEIVER_INTERFACE|| USE_ATOMIC_SENDER_RECEIVER_INTERFACE_AS_SERVICE) || USE_ATOMIC_NV_DATA_INTERFACE))
    Dcm_DataArrayTypeUint8Type: category=ARRAY, variation-point=blueprint-condition=p=l-1=(( {ecuc(Dcm/DcmConfigSet/DcmDsp/DcmDspDid/DcmDspDidUsePort)} == USE_DATA_ELEMENT_SPECIFIC_INTERFACES) && (({ecuc(Dcm/DcmConfigSet/DcmDsp/DcmDspData.DcmDspDataType)} == UINT8_N) ||({ecuc(Dcm/DcmConfigSet/DcmDsp/DcmDspData.DcmDspDataType)} == UINT8_DYN) ||({ecuc(Dcm/DcmConfigSet/DcmDsp/DcmDspPid/DcmDspPidData/DcmDspPidService01.DcmDspPidDataType)} == UINT8_N))
      element Dcm_DataArrayTypeUint8Type: array-size=undefined, array-size-semantics=FIXED-SIZE, implementation-data-type=uint8
    Dcm_DataElementType:
      variation-point=blueprint-condition=p=l-1=(({Dcm/DcmConfigSet/DcmDsp/DcmDspDid/DcmDspDidUsePort == USE_DATA_ELEMENT_SPECIFIC_INTERFACES}) && (({ecuc(Dcm/DcmConfigSet/DcmDsp/DcmDspData/DcmDspDataUsePort)} == USE_DATA_SENDER_RECEIVER) || ({ecuc(Dcm/DcmConfigSet/DcmDsp/DcmDspPid/DcmDspPidData/DcmDspPidService01/DcmDspPidDataUsePort)} == USE_DATA_SENDER_RECEIVER) || ({ecuc(Dcm/DcmConfigSet/DcmDsp/DcmDspPid/DcmDspPidData/DcmDspPidService01/DcmDspPidDataUsePort)} == USE_DATA_SENDER_RECEIVER_AS_SERVICE) || ({ecuc(Dcm/DcmConfigSet/DcmDsp/DcmDspData/DcmDspDataUsePort)} == USE_DATA_SENDER_RECEIVER_AS_SERVICE) ({ecuc(Dcm/DcmConfigSet/DcmDsp/DcmDspData.DcmDspDataUsePort)} == USE_DATA_SYNCH_CLIENT_SERVER) || ({ecuc(Dcm/DcmConfigSet/DcmDsp/DcmDspData.DcmDspDataUsePort)} == USE_DATA_ASYNCH_CLIENT_SERVER) || ({ecuc(Dcm/DcmConfigSet/DcmDsp/DcmDspData.DcmDspDataUsePort)} == USE_DATA_ASYNCH_CLIENT_SERVER_ERROR) || ({ecuc(Dcm/DcmConfigSet/DcmDsp/DcmDspPid/DcmDspPidData/DcmDspPidService01.DcmDspPidDataUsePort)} == USE_DATA_SYNCH_CLIENT_SERVER) ))
      range raw undefined
      implementation-data-type=Dcm_DataElement_ArrayType
      variation-point=blueprint-condition=verbatim=l-5=(({ecuc(Dcm/?DcmConfigSet/?DcmDsp/?DcmDspData.?DcmDspDataType)} == [S|U]INT[8|16|32]_N) || ({ecuc(Dcm/?DcmConfigSet/?DcmDsp/?DcmDspPid/?DcmDspPidData/?DcmDspPidService01.?DcmDspPidDataType)} == [S|U]INT[8|16|32]_N))
      range raw undefined
      implementation-data-type=Dcm_DataElement_PrimitiveType
      variation-point=blueprint-condition=verbatim=l-5=(({ecuc(Dcm/?DcmConfigSet/?DcmDsp/?DcmDspData.?DcmDspDataType)} == (BOOLEAN|[S|U]INT[8|16|32])) || ({ecuc(Dcm/?DcmConfigSet/?DcmDsp/?DcmDspPid/?DcmDspPidData/?DcmDspPidService01.?DcmDspPidDataType)} == (BOOLEAN|[S|U]INT[8|16|32])))
    Dcm_DataElement_ArrayType: category=ARRAY, variation-point=blueprint-condition=p=l-1=((({ecuc(Dcm/?DcmConfigSet/?DcmDsp/?DcmDspData.?DcmDspDataType)} == [S|U]INT[8|16|32]_N) || ({ecuc(Dcm/?DcmConfigSet/?DcmDsp/?DcmDspPid/?DcmDspPidData/?DcmDspPidService01.?DcmDspPidDataType)} == [S|U]INT[8|16|32]_N)) &&({Dcm/DcmConfigSet/DcmDsp/DcmDspDid/DcmDspDidUsePort == USE_DATA_ELEMENT_SPECIFIC_INTERFACES}) && (({ecuc(Dcm/DcmConfigSet/DcmDsp/DcmDspData/DcmDspDataUsePort)} == USE_DATA_SENDER_RECEIVER) || ({ecuc(Dcm/DcmConfigSet/DcmDsp/DcmDspPid/DcmDspPidData/DcmDspPidService01/DcmDspPidDataUsePort)} == USE_DATA_SENDER_RECEIVER) ||({ecuc(Dcm/DcmConfigSet/DcmDsp/DcmDspPid/DcmDspPidData/DcmDspPidService01/DcmDspPidDataUsePort)} == USE_DATA_SENDER_RECEIVER_AS_SERVICE) || ({ecuc(Dcm/DcmConfigSet/DcmDsp/DcmDspData/DcmDspDataUsePort)} == USE_DATA_SENDER_RECEIVER_AS_SERVICE) ||({ecuc(Dcm/DcmConfigSet/DcmDsp/DcmDspData.DcmDspDataUsePort)} == USE_DATA_SYNCH_CLIENT_SERVER) || ({ecuc(Dcm/DcmConfigSet/DcmDsp/DcmDspData.DcmDspDataUsePort)} == USE_DATA_ASYNCH_CLIENT_SERVER) || ({ecuc(Dcm/DcmConfigSet/DcmDsp/DcmDspData.DcmDspDataUsePort)} == USE_DATA_ASYNCH_CLIENT_SERVER_ERROR) || ({ecuc(Dcm/DcmConfigSet/DcmDsp/DcmDspPid/DcmDspPidData/DcmDspPidService01.DcmDspPidDataUsePort)} == USE_DATA_SYNCH_CLIENT_SERVER)))
      element Dcm_DataElement_ArrayType:
        array-size=undefined
        array-size-semantics=FIXED-SIZE
        implementation-data-type=uint16
        variation-point=blueprint-condition=verbatim=l-5=(({ecuc(Dcm/?DcmConfigSet/?DcmDsp/?DcmDspData.?DcmDspDataType)} == UINT16_N) || ({ecuc(Dcm/?DcmConfigSet/?DcmDsp/?DcmDspPid/?DcmDspPidData/?DcmDspPidService01.?DcmDspPidDataType)} == UINT16_N))
        implementation-data-type=uint8
        variation-point=blueprint-condition=verbatim=l-5=(({ecuc(Dcm/?DcmConfigSet/?DcmDsp/?DcmDspData.?DcmDspDataType)} == UINT8_N) || ({ecuc(Dcm/?DcmConfigSet/?DcmDsp/?DcmDspPid/?DcmDspPidData/?DcmDspPidService01.?DcmDspPidDataType)} == UINT8_N))
        implementation-data-type=uint32
        variation-point=blueprint-condition=verbatim=l-5=(({ecuc(Dcm/?DcmConfigSet/?DcmDsp/?DcmDspData.?DcmDspDataType)} == UINT32_N) || ({ecuc(Dcm/?DcmConfigSet/?DcmDsp/?DcmDspPid/?DcmDspPidData/?DcmDspPidService01.?DcmDspPidDataType)} == UINT32_N))
        implementation-data-type=sint16
        variation-point=blueprint-condition=verbatim=l-5=(({ecuc(Dcm/?DcmConfigSet/?DcmDsp/?DcmDspData.?DcmDspDataType)} == SINT16_N) || ({ecuc(Dcm/?DcmConfigSet/?DcmDsp/?DcmDspPid/?DcmDspPidData/?DcmDspPidService01.?DcmDspPidDataType)} == SINT16_N))
        implementation-data-type=sint32
        variation-point=blueprint-condition=verbatim=l-5=(({ecuc(Dcm/?DcmConfigSet/?DcmDsp/?DcmDspData.?DcmDspDataType)} == SINT32_N) || ({ecuc(Dcm/?DcmConfigSet/?DcmDsp/?DcmDspPid/?DcmDspPidData/?DcmDspPidService01.?DcmDspPidDataType)} == SINT32_N))
        implementation-data-type=sint8
        variation-point=blueprint-condition=verbatim=l-5=(({ecuc(Dcm/?DcmConfigSet/?DcmDsp/?DcmDspData.?DcmDspDataType)} == SINT8_N) || ({ecuc(Dcm/?DcmConfigSet/?DcmDsp/?DcmDspPid/?DcmDspPidData/?DcmDspPidService01.?DcmDspPidDataType)} == SINT8_N))
    Dcm_DataElement_PrimitiveType:
      variation-point=blueprint-condition=p=l-1=((({ecuc(Dcm/?DcmConfigSet/?DcmDsp/?DcmDspData.?DcmDspDataType)} == (BOOLEAN|[S|U]INT[8|16|32])) || ({ecuc(Dcm/?DcmConfigSet/?DcmDsp/?DcmDspPid/?DcmDspPidData/?DcmDspPidService01.?DcmDspPidDataType)} == (BOOLEAN|[S|U]INT[8|16|32]))) &&({Dcm/DcmConfigSet/DcmDsp/DcmDspDid/DcmDspDidUsePort == USE_DATA_ELEMENT_SPECIFIC_INTERFACES}) && (({ecuc(Dcm/DcmConfigSet/DcmDsp/DcmDspData/DcmDspDataUsePort)} == USE_DATA_SENDER_RECEIVER) || ({ecuc(Dcm/DcmConfigSet/DcmDsp/DcmDspPid/DcmDspPidData/DcmDspPidService01/DcmDspPidDataUsePort)} == USE_DATA_SENDER_RECEIVER) || ({ecuc(Dcm/DcmConfigSet/DcmDsp/DcmDspPid/DcmDspPidData/DcmDspPidService01/DcmDspPidDataUsePort)} == USE_DATA_SENDER_RECEIVER_AS_SERVICE) || ({ecuc(Dcm/DcmConfigSet/DcmDsp/DcmDspData/DcmDspDataUsePort)} == USE_DATA_SENDER_RECEIVER_AS_SERVICE) ||({ecuc(Dcm/DcmConfigSet/DcmDsp/DcmDspData.DcmDspDataUsePort)} == USE_DATA_SYNCH_CLIENT_SERVER) || ({ecuc(Dcm/DcmConfigSet/DcmDsp/DcmDspData.DcmDspDataUsePort)} == USE_DATA_ASYNCH_CLIENT_SERVER) || ({ecuc(Dcm/DcmConfigSet/DcmDsp/DcmDspData.DcmDspDataUsePort)} == USE_DATA_ASYNCH_CLIENT_SERVER_ERROR) || ({ecuc(Dcm/DcmConfigSet/DcmDsp/DcmDspPid/DcmDspPidData/DcmDspPidService01.DcmDspPidDataUsePort)} == USE_DATA_SYNCH_CLIENT_SERVER)))
      range raw undefined
      implementation-data-type=sint16
      variation-point=blueprint-condition=verbatim=l-5=(({ecuc(Dcm/?DcmConfigSet/?DcmDsp/?DcmDspData.?DcmDspDataType)} == SINT16) || ({ecuc(Dcm/?DcmConfigSet/?DcmDsp/?DcmDspPid/?DcmDspPidData/?DcmDspPidService01.?DcmDspPidDataType)} == SINT16))
      range raw undefined
      implementation-data-type=sint32
      variation-point=blueprint-condition=verbatim=l-5=(({ecuc(Dcm/?DcmConfigSet/?DcmDsp/?DcmDspData.?DcmDspDataType)} == SINT32) || ({ecuc(Dcm/?DcmConfigSet/?DcmDsp/?DcmDspPid/?DcmDspPidData/?DcmDspPidService01.?DcmDspPidDataType)} == SINT32))
      range raw undefined
      implementation-data-type=boolean
      variation-point=blueprint-condition=verbatim=l-5=(({ecuc(Dcm/?DcmConfigSet/?DcmDsp/?DcmDspData.?DcmDspDataType)} == BOOLEAN) || ({ecuc(Dcm/?DcmConfigSet/?DcmDsp/?DcmDspPid/?DcmDspPidData/?DcmDspPidService01.?DcmDspPidDataType)} == BOOLEAN))
      range raw undefined
      implementation-data-type=uint16
      variation-point=blueprint-condition=verbatim=l-5=(({ecuc(Dcm/?DcmConfigSet/?DcmDsp/?DcmDspData.?DcmDspDataType)} == UINT16) || ({ecuc(Dcm/?DcmConfigSet/?DcmDsp/?DcmDspPid/?DcmDspPidData/?DcmDspPidService01.?DcmDspPidDataType)} == UINT16))
      range raw undefined
      implementation-data-type=uint32
      variation-point=blueprint-condition=verbatim=l-5=(({ecuc(Dcm/?DcmConfigSet/?DcmDsp/?DcmDspData.?DcmDspDataType)} == UINT32) || ({ecuc(Dcm/?DcmConfigSet/?DcmDsp/?DcmDspPid/?DcmDspPidData/?DcmDspPidService01.?DcmDspPidDataType)} == UINT32))
      range raw undefined
      implementation-data-type=uint8
      variation-point=blueprint-condition=verbatim=l-5=(({ecuc(Dcm/?DcmConfigSet/?DcmDsp/?DcmDspData.?DcmDspDataType)} == UINT8) || ({ecuc(Dcm/?DcmConfigSet/?DcmDsp/?DcmDspPid/?DcmDspPidData/?DcmDspPidService01.?DcmDspPidDataType)} == UINT8))
      range raw undefined
      implementation-data-type=sint8
      variation-point=blueprint-condition=verbatim=l-5=(({ecuc(Dcm/?DcmConfigSet/?DcmDsp/?DcmDspData.?DcmDspDataType)} == SINT8) || ({ecuc(Dcm/?DcmConfigSet/?DcmDsp/?DcmDspPid/?DcmDspPidData/?DcmDspPidService01.?DcmDspPidDataType)} == SINT8))
    Dcm_DidSupportedType: compu {0x00=DCM_DID_SUPPORTED, 0x01=DCM_DID_NOT_SUPPORTED}, range raw 0x00..0x01, implementation-data-type=uint8
    Dcm_FileAndDirNameType: category=ARRAY, variation-point=blueprint-condition=p=l-1=({ecuc(Dcm/DcmConfigSet/DcmDsp/DcmDspRequestFileTransfer/DcmRequestFileTransferUsePort)} == TRUE)
      element Dcm_FileAndDirNameType: array-size=undefined, array-size-semantics=FIXED-SIZE, implementation-data-type=uint8
    Dcm_IOOperationRequestType: category=STRUCTURE, variation-point=blueprint-condition=p=l-1=({ecuc(Dcm/DcmConfigSet/DcmDsp/DcmDspDid/DcmDspDidUsePort)} == (USE_ATOMIC_SENDER_RECEIVER_INTERFACE )) ||({ecuc(Dcm/DcmConfigSet/DcmDsp/DcmDspDid/DcmDspDidUsePort)} == (USE_ATOMIC_SENDER_RECEIVER_INTERFACE_AS_SERVICE ))&&({ecuc(Dcm/DcmConfigSet/DcmDsp/DcmDspDid/DcmDspDidInfoRef-> DcmDspDidInfo/DcmDspDidControl)} != NULL)
      element inputOutputControlParameter: implementation-data-type=Dcm_InputOutputControlParameterType
      element controlEnableMask:
        implementation-data-type=Dcm_ControlMask_8Type
        variation-point=blueprint-condition=p=l-1=({ecuc(Dcm/DcmConfigSet/DcmDsp/DcmDspDid/DcmDspDidInfoRef->DcmDspDidInfo/DcmDspDidControl/DcmDspDidControlMaskSize)} == 0x01)
        implementation-data-type=Dcm_ControlMask_16Type
        variation-point=blueprint-condition=p=l-1=({ecuc(Dcm/DcmConfigSet/DcmDsp/DcmDspDid/DcmDspDidInfoRef->DcmDspDidInfo/DcmDspDidControl/DcmDspDidControlMaskSize)} == 0x02)
        implementation-data-type=Dcm_ControlMask_32Type
        variation-point=blueprint-condition=p=l-1=({ecuc(Dcm/DcmConfigSet/DcmDsp/DcmDspDid/DcmDspDidInfoRef->DcmDspDidInfo/DcmDspDidControl/DcmDspDidControlMaskSize)} >= 0x03)
    Dcm_IOOperationResponseType: compu {0x00=DCM_POSITIVE_RESPONSE, 0x10=DCM_GENERAL_REJECT, 0x21=DCM_BUSY_REPEAT_REQUEST, 0x22=DCM_CONDITIONS_NOT_CORRECT, 0x26=DCM_FAILURE_PREVENTS_EXECUTION, 0x31=DCM_REQUEST_OUT_OF_RANGE, 0x78=DCM_RESPONSE_PENDING}, range raw 0x00..0x78, implementation-data-type=uint8
    Dcm_InfoTypeServicesArrayType: category=ARRAY, variation-point=blueprint-condition=p=l-1={ecuc(Dcm/DcmConfigSet/DcmDsp/DcmDspVehInfo/DcmDspVehInfoData/DcmDspVehInfoDataUsePort)} == TRUE
      element Dcm_InfoTypeServicesArrayType: array-size=undefined, array-size-semantics=FIXED-SIZE, implementation-data-type=uint8
    Dcm_InputOutputControlParameterType: compu {0x00=DCM_RETURN_CONTROL_TO_ECU, 0x01=DCM_RESET_TO_DEFAULT, 0x02=DCM_FREEZE_CURRENT_STATE, 0x03=DCM_SHORT_TERM_ADJUSTMENT, 0xff=DCM_IDLE}, range raw 0x00..0xff, implementation-data-type=uint8
    Dcm_KeyArrayType: category=ARRAY, variation-point=blueprint-condition=p=l-1={ecuc(Dcm/DcmConfigSet/DcmDsp/DcmDspSecurity/DcmDspSecurityRow.DcmDspSecurityUsePort)} == USE_ASYNCH_CLIENT_SERVER
      element Dcm_KeyArrayType: array-size=undefined, array-size-semantics=FIXED-SIZE, implementation-data-type=uint8
    Dcm_NegativeResponseCodeType:
      compu {0x8F=DCM_E_BRAKESWITCH_NOTCLOSED, 0x21=DCM_E_BUSYREPEATREQUEST, 0x22=DCM_E_CONDITIONSNOTCORRECT, 0x84=DCM_E_ENGINEISNOTRUNNING, 0x83=DCM_E_ENGINEISRUNNING, 0x85=DCM_E_ENGINERUNTIMETOOLOW, 0x36=DCM_E_EXCEEDNUMBEROFATTEMPTS, 0x26=DCM_E_FAILUREPREVENTSEXECUTIONOFREQUESTEDACTION, 0x72=DCM_E_GENERALPROGRAMMINGFAILURE, 0x10=DCM_E_GENERALREJECT, 0x13=DCM_E_INCORRECTMESSAGELENGTHORINVALIDFORMAT, 0x35=DCM_E_INVALIDKEY, 0x25=DCM_E_NORESPONSEFROMSUBNETCOMPONENT, 0x31=DCM_E_REQUESTOUTOFRANGE, 0x24=DCM_E_REQUESTSEQUENCEERROR, 0x37=DCM_E_REQUIREDTIMEDELAYNOTEXPIRED, 0x14=DCM_E_RESPONSETOOLONG, 0x81=DCM_E_RPMTOOHIGH, 0x82=DCM_E_RPMTOOLOW, 0x33=DCM_E_SECURITYACCESSDENIED, 0x11=DCM_E_SERVICENOTSUPPORTED, 0x7F=DCM_E_SERVICENOTSUPPORTEDINACTIVESESSION, 0x90=DCM_E_SHIFTERLEVERNOTINPARK, 0x12=DCM_E_SUBFUNCTIONNOTSUPPORTED, 0x7E=DCM_E_SUBFUNCTIONNOTSUPPORTEDINACTIVESESSION, 0x86=DCM_E_TEMPERATURETOOHIGH, 0x87=DCM_E_TEMPERATURETOOLOW, 0x8A=DCM_E_THROTTLE_PEDALTOOHIGH, 0x8B=DCM_E_THROTTLE_PEDALTOOLOW, 0x91=DCM_E_TORQUECONVERTERCLUTCHLOCKED, 0x71=DCM_E_TRANSFERDATASUSPENDED, 0x8D=DCM_E_TRANSMISSIONRANGENOTINGEAR, 0x8C=DCM_E_TRANSMISSIONRANGENOTINNEUTRAL, 0x70=DCM_E_UPLOADDOWNLOADNOTACCEPTED, 0x88=DCM_E_VEHICLESPEEDTOOHIGH, 0x89=DCM_E_VEHICLESPEEDTOOLOW, 0x92=DCM_E_VOLTAGETOOHIGH, 0x93=DCM_E_VOLTAGETOOLOW, 0x73=DCM_E_WRONGBLOCKSEQUENCECOUNTER, 0xF0=DCM_E_VMSCNC_0, 0xF1=DCM_E_VMSCNC_1, 0xF2=DCM_E_VMSCNC_2, 0xF3=DCM_E_VMSCNC_3, 0xF4=DCM_E_VMSCNC_4, 0xF5=DCM_E_VMSCNC_5, 0xF6=DCM_E_VMSCNC_6, 0xF7=DCM_E_VMSCNC_7, 0xF8=DCM_E_VMSCNC_8, 0xF9=DCM_E_VMSCNC_9, 0xFA=DCM_E_VMSCNC_A, 0xFB=DCM_E_VMSCNC_B, 0xFC=DCM_E_VMSCNC_C, 0xFD=DCM_E_VMSCNC_D, 0xFE=DCM_E_VMSCNC_E, 0x00=DCM_POS_RESP}
      range raw 0x00..0xFE
      implementation-data-type=uint8
    Dcm_OpStatusType: compu {0x00=DCM_INITIAL, 0x01=DCM_PENDING, 0x02=DCM_CANCEL, 0x03=DCM_FORCE_RCRRP_OK}, range raw 0x00..0x03, implementation-data-type=uint8
    Dcm_ProtocolType:
      compu {0x00=DCM_OBD_ON_CAN, 0x01=DCM_OBD_ON_FLEXRAY, 0x02=DCM_OBD_ON_IP, 0x03=DCM_UDS_ON_CAN, 0x04=DCM_UDS_ON_FLEXRAY, 0x05=DCM_UDS_ON_IP, 0x06=DCM_ROE_ON_CAN, 0x07=DCM_ROE_ON_FLEXRAY, 0x08=DCM_ROE_ON_IP, 0x09=DCM_PERIODICTRANS_ON_CAN, 0x0A=DCM_PERIODICTRANS_ON_FLEXRAY, 0x0B=DCM_PERIODICTRANS_ON_IP, 0x0C=DCM_NO_ACTIVE_PROTOCOL, 0x0D=DCM_UDS_ON_LIN, 0xF0=DCM_SUPPLIER_1, 0xF1=DCM_SUPPLIER_2, 0xF2=DCM_SUPPLIER_3, 0xF3=DCM_SUPPLIER_4, 0xF4=DCM_SUPPLIER_5, 0xF5=DCM_SUPPLIER_6, 0xF6=DCM_SUPPLIER_7, 0xF7=DCM_SUPPLIER_8, 0xF8=DCM_SUPPLIER_9, 0xF9=DCM_SUPPLIER_10, 0xFA=DCM_SUPPLIER_11, 0xFB=DCM_SUPPLIER_12, 0xFC=DCM_SUPPLIER_13, 0xFD=DCM_SUPPLIER_14, 0xFE=DCM_SUPPLIER_15}
      range raw 0x00..0xFE
      implementation-data-type=uint8
    Dcm_RangeArrayType: category=ARRAY, variation-point=blueprint-condition=p=l-1={ecuc(Dcm/DcmConfigSet/DcmDsp/DcmDspDidRange.DcmDspDidRangeUsePort)} == TRUE
      element Dcm_RangeArrayType: array-size=undefined, array-size-semantics=FIXED-SIZE, implementation-data-type=uint8
    Dcm_RequestControlServicesInArrayType: category=ARRAY
      element Dcm_RequestControlServicesInArrayType: array-size=undefined, array-size-semantics=FIXED-SIZE, implementation-data-type=uint8
    Dcm_RequestControlServicesOutArrayType: category=ARRAY
      element Dcm_RequestControlServicesOutArrayType: array-size=undefined, array-size-semantics=FIXED-SIZE, implementation-data-type=uint8
    Dcm_RequestDataArrayType: category=ARRAY
      element Dcm_RequestDataArrayType: array-size=undefined, array-size-semantics=FIXED-SIZE, implementation-data-type=uint8
    Dcm_RequestDataInPrimitiveType:
      variation-point=blueprint-condition=p=l-1=({ecuc(Dcm/DcmConfigSet/DcmDsp/DcmDspRoutine/DcmDspRequestRoutineResults/DcmDspRequestRoutineResultsIn/DcmDspRequestRoutineResultsInSignal.DcmDspRoutineSignalType)} == [U|S]INT[8|16|32])&& ({ecuc(Dcm/DcmConfigSet/DcmDsp/DcmDspRoutine/DcmDspRoutineUsePort)} == TRUE)
      range raw undefined
      implementation-data-type=uint16
      variation-point=blueprint-condition=verbatim=l-5={ecuc(Dcm/DcmConfigSet/DcmDsp/DcmDspRoutine/DcmDspRequestRoutineResults/DcmDspRequestRoutineResultsIn/DcmDspRequestRoutineResultsInSignal.DcmDspRoutineSignalType)} == UINT16
      range raw undefined
      implementation-data-type=sint8
      variation-point=blueprint-condition=verbatim=l-5={ecuc(Dcm/DcmConfigSet/DcmDsp/DcmDspRoutine/DcmDspRequestRoutineResults/DcmDspRequestRoutineResultsIn/DcmDspRequestRoutineResultsInSignal.DcmDspRoutineSignalType)} == SINT8
      range raw undefined
      implementation-data-type=uint8
      variation-point=blueprint-condition=verbatim=l-5={ecuc(Dcm/DcmConfigSet/DcmDsp/DcmDspRoutine/DcmDspRequestRoutineResults/DcmDspRequestRoutineResultsIn/DcmDspRequestRoutineResultsInSignal.DcmDspRoutineSignalType)} == UINT8
      range raw undefined
      implementation-data-type=sint32
      variation-point=blueprint-condition=verbatim=l-5={ecuc(Dcm/DcmConfigSet/DcmDsp/DcmDspRoutine/DcmDspRequestRoutineResults/DcmDspRequestRoutineResultsIn/DcmDspRequestRoutineResultsInSignal.DcmDspRoutineSignalType)} == SINT32
      range raw undefined
      implementation-data-type=uint32
      variation-point=blueprint-condition=verbatim=l-5={ecuc(Dcm/DcmConfigSet/DcmDsp/DcmDspRoutine/DcmDspRequestRoutineResults/DcmDspRequestRoutineResultsIn/DcmDspRequestRoutineResultsInSignal.DcmDspRoutineSignalType)} == UINT32
      range raw undefined
      implementation-data-type=sint16
      variation-point=blueprint-condition=verbatim=l-5={ecuc(Dcm/DcmConfigSet/DcmDsp/DcmDspRoutine/DcmDspRequestRoutineResults/DcmDspRequestRoutineResultsIn/DcmDspRequestRoutineResultsInSignal.DcmDspRoutineSignalType)} == SINT16
    Dcm_RequestDataInType:
      variation-point=blueprint-condition=p=l-1=({ecuc(Dcm/DcmConfigSet/DcmDsp/DcmDspRoutine/DcmDspRoutineUsePort)} == TRUE)
      range raw undefined
      implementation-data-type=Dcm_RequestDataIn_ArrayType
      variation-point=blueprint-condition=verbatim=l-5=({ecuc(Dcm/DcmConfigSet/DcmDsp/DcmDspRoutine/DcmDspRequestRoutineResults/DcmDspRequestRoutineResultsIn/DcmDspRequestRoutineResultsInSignal.DcmDspRoutineSignalType)} == [U|S]INT[8|16|32]_N)
      range raw undefined
      implementation-data-type=Dcm_RequestDataInPrimitiveType
      variation-point=blueprint-condition=verbatim=l-5=({ecuc(Dcm/DcmConfigSet/DcmDsp/DcmDspRoutine/DcmDspRequestRoutineResults/DcmDspRequestRoutineResultsIn/DcmDspRequestRoutineResultsInSignal.DcmDspRoutineSignalType)} == [U|S]INT[8|16|32])
    Dcm_RequestDataIn_ArrayType: category=ARRAY, variation-point=blueprint-condition=p=l-1=({ecuc(Dcm/DcmConfigSet/DcmDsp/DcmDspRoutine/DcmDspRequestRoutineResults/DcmDspRequestRoutineResultsIn/DcmDspRequestRoutineResultsInSignal.DcmDspRoutineSignalType)} == [U|S]INT[8|16|32]_N)&& ({ecuc(Dcm/DcmConfigSet/DcmDsp/DcmDspRoutine/DcmDspRoutineUsePort)} == TRUE)
      element Dcm_RequestDataIn_ArrayType:
        array-size=undefined
        array-size-semantics=FIXED-SIZE
        implementation-data-type=uint8
        variation-point=blueprint-condition=verbatim=l-5={ecuc(Dcm/DcmConfigSet/DcmDsp/DcmDspRoutine/DcmDspRequestRoutineResults/DcmDspRequestRoutineResultsIn/DcmDspRequestRoutineResultsInSignal.DcmDspRoutineSignalType)} == UINT8_N
        implementation-data-type=sint32
        variation-point=blueprint-condition=verbatim=l-5={ecuc(Dcm/DcmConfigSet/DcmDsp/DcmDspRoutine/DcmDspRequestRoutineResults/DcmDspRequestRoutineResultsIn/DcmDspRequestRoutineResultsInSignal.DcmDspRoutineSignalType)} == SINT32_N
        implementation-data-type=sint8
        variation-point=blueprint-condition=verbatim=l-5={ecuc(Dcm/DcmConfigSet/DcmDsp/DcmDspRoutine/DcmDspRequestRoutineResults/DcmDspRequestRoutineResultsIn/DcmDspRequestRoutineResultsInSignal.DcmDspRoutineSignalType)} == SINT8_N
        implementation-data-type=uint32
        variation-point=blueprint-condition=verbatim=l-5={ecuc(Dcm/DcmConfigSet/DcmDsp/DcmDspRoutine/DcmDspRequestRoutineResults/DcmDspRequestRoutineResultsIn/DcmDspRequestRoutineResultsInSignal.DcmDspRoutineSignalType)} == UINT32_N
        implementation-data-type=sint16
        variation-point=blueprint-condition=verbatim=l-5={ecuc(Dcm/DcmConfigSet/DcmDsp/DcmDspRoutine/DcmDspRequestRoutineResults/DcmDspRequestRoutineResultsIn/DcmDspRequestRoutineResultsInSignal.DcmDspRoutineSignalType)} == SINT16_N
        implementation-data-type=uint16
        variation-point=blueprint-condition=verbatim=l-5={ecuc(Dcm/DcmConfigSet/DcmDsp/DcmDspRoutine/DcmDspRequestRoutineResults/DcmDspRequestRoutineResultsIn/DcmDspRequestRoutineResultsInSignal.DcmDspRoutineSignalType)} == UINT16_N
    Dcm_RequestDataOutPrimitivType:
      variation-point=blueprint-condition=p=l-1=({ecuc(Dcm/DcmConfigSet/DcmDsp/DcmDspRoutine/DcmDspRequestRoutineResults/DcmDspRequestRoutineResultsOut/DcmDspRequestRoutineResultsOutSignal.DcmDspRoutineSignalType)} == [U|S]INT[8|16|32]) && ({ecuc(Dcm/DcmConfigSet/DcmDsp/DcmDspRoutine/DcmDspRoutineUsePort)} == TRUE)
      range raw undefined
      implementation-data-type=sint32
      variation-point=blueprint-condition=verbatim=l-5={ecuc(Dcm/DcmConfigSet/DcmDsp/DcmDspRoutine/DcmDspRequestRoutineResults/DcmDspRequestRoutineResultsOut/DcmDspRequestRoutineResultsOutSignal.DcmDspRoutineSignalType)} == SINT32
      range raw undefined
      implementation-data-type=uint16
      variation-point=blueprint-condition=verbatim=l-5={ecuc(Dcm/DcmConfigSet/DcmDsp/DcmDspRoutine/DcmDspRequestRoutineResults/DcmDspRequestRoutineResultsOut/DcmDspRequestRoutineResultsOutSignal.DcmDspRoutineSignalType)} == UINT16
      range raw undefined
      implementation-data-type=uint8
      variation-point=blueprint-condition=verbatim=l-5={ecuc(Dcm/DcmConfigSet/DcmDsp/DcmDspRoutine/DcmDspRequestRoutineResults/DcmDspRequestRoutineResultsOut/DcmDspRequestRoutineResultsOutSignal.DcmDspRoutineSignalType)} == UINT8
      range raw undefined
      implementation-data-type=uint32
      variation-point=blueprint-condition=verbatim=l-5={ecuc(Dcm/DcmConfigSet/DcmDsp/DcmDspRoutine/DcmDspRequestRoutineResults/DcmDspRequestRoutineResultsOut/DcmDspRequestRoutineResultsOutSignal.DcmDspRoutineSignalType)} == UINT32
      range raw undefined
      implementation-data-type=sint8
      variation-point=blueprint-condition=verbatim=l-5={ecuc(Dcm/DcmConfigSet/DcmDsp/DcmDspRoutine/DcmDspRequestRoutineResults/DcmDspRequestRoutineResultsOut/DcmDspRequestRoutineResultsOutSignal.DcmDspRoutineSignalType)} == SINT8
      range raw undefined
      implementation-data-type=sint16
      variation-point=blueprint-condition=verbatim=l-5={ecuc(Dcm/DcmConfigSet/DcmDsp/DcmDspRoutine/DcmDspRequestRoutineResults/DcmDspRequestRoutineResultsOut/DcmDspRequestRoutineResultsOutSignal.DcmDspRoutineSignalType)} == SINT16
    Dcm_RequestDataOutType:
      variation-point=blueprint-condition=p=l-1=({ecuc(Dcm/DcmConfigSet/DcmDsp/DcmDspRoutine/DcmDspRoutineUsePort)} == TRUE)
      range raw undefined
      implementation-data-type=Dcm_RequestDataOut_ArrayType
      variation-point=blueprint-condition=verbatim=l-5=({ecuc(Dcm/DcmConfigSet/DcmDsp/DcmDspRoutine/DcmDspRequestRoutineResults/DcmDspRequestRoutineResultsOut/DcmDspRequestRoutineResultsOutSignal.DcmDspRoutineSignalType)} == [U|S]INT[8|16|32]_N)
      range raw undefined
      implementation-data-type=Dcm_RequestDataOutPrimitivType
      variation-point=blueprint-condition=verbatim=l-5=({ecuc(Dcm/DcmConfigSet/DcmDsp/DcmDspRoutine/DcmDspRequestRoutineResults/DcmDspRequestRoutineResultsOut/DcmDspRequestRoutineResultsOutSignal.DcmDspRoutineSignalType)} == [U|S]INT[8|16|32])
    Dcm_RequestDataOut_ArrayType: category=ARRAY, variation-point=blueprint-condition=p=l-1=({ecuc(Dcm/DcmConfigSet/DcmDsp/DcmDspRoutine/DcmDspRequestRoutineResults/DcmDspRequestRoutineResultsOut/DcmDspRequestRoutineResultsOutSignal.DcmDspRoutineSignalType)} == [U|S]INT[8|16|32]_N) && ({ecuc(Dcm/DcmConfigSet/DcmDsp/DcmDspRoutine/DcmDspRoutineUsePort)} == TRUE)
      element Dcm_RequestDataOut_ArrayType:
        array-size=undefined
        array-size-semantics=FIXED-SIZE
        implementation-data-type=sint16
        variation-point=blueprint-condition=verbatim=l-5=({ecuc(Dcm/DcmConfigSet/DcmDsp/DcmDspRoutine/DcmDspRequestRoutineResults/DcmDspRequestRoutineResultsOut/DcmDspRequestRoutineResultsOutSignal.DcmDspRoutineSignalType)} == SINT16_N)
        implementation-data-type=sint8
        variation-point=blueprint-condition=verbatim=l-5=({ecuc(Dcm/DcmConfigSet/DcmDsp/DcmDspRoutine/DcmDspRequestRoutineResults/DcmDspRequestRoutineResultsOut/DcmDspRequestRoutineResultsOutSignal.DcmDspRoutineSignalType)} == SINT8_N)
        implementation-data-type=sint32
        variation-point=blueprint-condition=verbatim=l-5=({ecuc(Dcm/DcmConfigSet/DcmDsp/DcmDspRoutine/DcmDspRequestRoutineResults/DcmDspRequestRoutineResultsOut/DcmDspRequestRoutineResultsOutSignal.DcmDspRoutineSignalType)} == SINT32_N)
        implementation-data-type=uint32
        variation-point=blueprint-condition=verbatim=l-5=({ecuc(Dcm/DcmConfigSet/DcmDsp/DcmDspRoutine/DcmDspRequestRoutineResults/DcmDspRequestRoutineResultsOut/DcmDspRequestRoutineResultsOutSignal.DcmDspRoutineSignalType)} == UINT32_N)
        implementation-data-type=uint8
        variation-point=blueprint-condition=verbatim=l-5=({ecuc(Dcm/DcmConfigSet/DcmDsp/DcmDspRoutine/DcmDspRequestRoutineResults/DcmDspRequestRoutineResultsOut/DcmDspRequestRoutineResultsOutSignal.DcmDspRoutineSignalType)} == UINT8_N)
        implementation-data-type=uint16
        variation-point=blueprint-condition=verbatim=l-5=({ecuc(Dcm/DcmConfigSet/DcmDsp/DcmDspRoutine/DcmDspRequestRoutineResults/DcmDspRequestRoutineResultsOut/DcmDspRequestRoutineResultsOutSignal.DcmDspRoutineSignalType)} == UINT16_N)
    Dcm_RequestFlexibleInArrayDataType: category=ARRAY, variation-point=blueprint-condition=[l-1=({ecuc(Dcm/DcmConfigSet/DcmDsp/DcmDspRoutine/DcmDspRequestRoutineResults/DcmDspRequestRoutineResultsIn/DcmDspRequestRoutineResultsInSignal.DcmDspRoutineSignalType)} == VARIABLE_LENGTH), l-1=&& ({ecuc(Dcm/DcmConfigSet/DcmDsp/DcmDspRoutine/DcmDspRoutineUsePort)} == TRUE)]
      element Dcm_RequestFlexibleInArrayDataType: array-size=undefined, array-size-semantics=FIXED-SIZE, implementation-data-type=uint8
    Dcm_RequestFlexibleOutArrayDataType: category=ARRAY, variation-point=blueprint-condition=[l-1=({ecuc(Dcm/DcmConfigSet/DcmDsp/DcmDspRoutine/DcmDspRequestRoutineResults/DcmDspRequestRoutineResultsOut/DcmDspRequestRoutineResultsOutSignal.DcmDspRoutineSignalType)} == VARIABLE_LENGTH), l-1=&& ({ecuc(Dcm/DcmConfigSet/DcmDsp/DcmDspRoutine/DcmDspRoutineUsePort)} == TRUE)]
      element Dcm_RequestFlexibleOutArrayDataType: array-size=undefined, array-size-semantics=FIXED-SIZE, implementation-data-type=uint8
    Dcm_ResponseDataArrayType: category=ARRAY, variation-point=blueprint-condition=p=l-1=({ecuc(Dcm/DcmConfigSet/DcmDsp/DcmDspRequestFileTransfer/DcmRequestFileTransferUsePort)} == TRUE)
      element Dcm_ResponseDataArrayType: array-size=undefined, array-size-semantics=FIXED-SIZE, implementation-data-type=uint8
    Dcm_ScalingInfoArrayType: category=ARRAY, variation-point=blueprint-condition=p=l-1=(({ecuc(Dcm/DcmConfigSet/DcmDsp/DcmDspData.DcmDspDataUsePort)} == USE_DATA_ASYNCH_CLIENT_SERVER) || ({ecuc(Dcm/DcmConfigSet/DcmDsp/DcmDspData.DcmDspDataUsePort)} == USE_DATA_SYNCH_CLIENT_SERVER) || ({ecuc(Dcm/DcmConfigSet/DcmDsp/DcmDspData.DcmDspDataUsePort)} == USE_DATA_ASYNCH_CLIENT_SERVER_ERROR)) && ({ecuc(Dcm/DcmConfigSet/DcmDsp/DcmDspData->DcmDspDataInfoRef.DcmDspDataScalingInfoSize)} != NULL)
      element Dcm_ScalingInfoArrayType: array-size=undefined, array-size-semantics=FIXED-SIZE, implementation-data-type=uint8
    Dcm_SecLevelType: compu {0x00=DCM_SEC_LEV_LOCKED}, range raw 0x00..undefined, implementation-data-type=uint8
    Dcm_SecurityAccessDataRecordType: category=ARRAY, variation-point=blueprint-condition=p=l-1=({ecuc(Dcm/DcmConfigSet/DcmDsp/DcmDspSecurity/DcmDspSecurityRow.DcmDspSecurityUsePort)} == USE_ASYNCH_CLIENT_SERVER) && ({ecuc(Dcm/DcmConfigSet/DcmDsp/DcmDspSecurity/DcmDspSecurityRow.DcmDspSecurityADRSize)} != NULL)
      element Dcm_SecurityAccessDataRecordType: array-size=undefined, array-size-semantics=FIXED-SIZE, implementation-data-type=uint8
    Dcm_SeedArrayType: category=ARRAY, variation-point=blueprint-condition=p=l-1={ecuc(Dcm/DcmConfigSet/DcmDsp/DcmDspSecurity/DcmDspSecurityRow.DcmDspSecurityUsePort)} == USE_ASYNCH_CLIENT_SERVER
      element Dcm_SeedArrayType: array-size=undefined, array-size-semantics=FIXED-SIZE, implementation-data-type=uint8
    Dcm_SesCtrlType: compu {0x01=DCM_DEFAULT_SESSION, 0x02=DCM_PROGRAMMING_SESSION, 0x03=DCM_EXTENDED_DIAGNOSTIC_SESSION, 0x04=DCM_SAFETY_SYSTEM_DIAGNOSTIC_SESSION}, range raw 0x01..undefined, implementation-data-type=uint8
    Dcm_StartDataInPrimitivType:
      variation-point=blueprint-condition=p=l-1=({ecuc(Dcm/DcmConfigSet/DcmDsp/DcmDspRoutine/DcmDspStartRoutine/DcmDspStartRoutineIn/DcmDspStartRoutineInSignal.DcmDspRoutineSignalType)} == [U|S]INT[8|16|32]) && ({ecuc(Dcm/DcmConfigSet/DcmDsp/DcmDspRoutine/DcmDspRoutineUsePort)} == TRUE)
      range raw undefined
      implementation-data-type=uint8
      variation-point=blueprint-condition=verbatim=l-5={ecuc(Dcm/DcmConfigSet/DcmDsp/DcmDspRoutine/DcmDspStartRoutine/DcmDspStartRoutineIn/DcmDspStartRoutineInSignal.DcmDspRoutineSignalType)} == UINT8
      range raw undefined
      implementation-data-type=sint32
      variation-point=blueprint-condition=verbatim=l-5={ecuc(Dcm/DcmConfigSet/DcmDsp/DcmDspRoutine/DcmDspStartRoutine/DcmDspStartRoutineIn/DcmDspStartRoutineInSignal.DcmDspRoutineSignalType)} == SINT32
      range raw undefined
      implementation-data-type=sint8
      variation-point=blueprint-condition=verbatim=l-5={ecuc(Dcm/DcmConfigSet/DcmDsp/DcmDspRoutine/DcmDspStartRoutine/DcmDspStartRoutineIn/DcmDspStartRoutineInSignal.DcmDspRoutineSignalType)} == SINT8
      range raw undefined
      implementation-data-type=uint16
      variation-point=blueprint-condition=verbatim=l-5={ecuc(Dcm/DcmConfigSet/DcmDsp/DcmDspRoutine/DcmDspStartRoutine/DcmDspStartRoutineIn/DcmDspStartRoutineInSignal.DcmDspRoutineSignalType)} == UINT16
      range raw undefined
      implementation-data-type=sint16
      variation-point=blueprint-condition=verbatim=l-5={ecuc(Dcm/DcmConfigSet/DcmDsp/DcmDspRoutine/DcmDspStartRoutine/DcmDspStartRoutineIn/DcmDspStartRoutineInSignal.DcmDspRoutineSignalType)} == SINT16
      range raw undefined
      implementation-data-type=uint32
      variation-point=blueprint-condition=verbatim=l-5={ecuc(Dcm/DcmConfigSet/DcmDsp/DcmDspRoutine/DcmDspStartRoutine/DcmDspStartRoutineIn/DcmDspStartRoutineInSignal.DcmDspRoutineSignalType)} == UINT32
    Dcm_StartDataInType:
      variation-point=blueprint-condition=p=l-1=({ecuc(Dcm/DcmConfigSet/DcmDsp/DcmDspRoutine/DcmDspRoutineUsePort)} == TRUE)
      range raw undefined
      implementation-data-type=Dcm_StartDataIn_ArrayType
      variation-point=blueprint-condition=verbatim=l-5=({ecuc(Dcm/DcmConfigSet/DcmDsp/DcmDspRoutine/DcmDspStartRoutine/DcmDspStartRoutineIn/DcmDspStartRoutineInSignal.DcmDspRoutineSignalType)} == [U|S]INT[8|16|32]_N)
      range raw undefined
      implementation-data-type=Dcm_StartDataInPrimitivType
      variation-point=blueprint-condition=verbatim=l-5=({ecuc(Dcm/DcmConfigSet/DcmDsp/DcmDspRoutine/DcmDspStartRoutine/DcmDspStartRoutineIn/DcmDspStartRoutineInSignal.DcmDspRoutineSignalType)} == [U|S]INT[8|16|32])
    Dcm_StartDataIn_ArrayType: category=ARRAY, variation-point=blueprint-condition=p=l-1=({ecuc(Dcm/DcmConfigSet/DcmDsp/DcmDspRoutine/DcmDspStartRoutine/DcmDspStartRoutineIn/DcmDspStartRoutineInSignal.DcmDspRoutineSignalType)} == [U|S]INT[8|16|32]_N) && ({ecuc(Dcm/DcmConfigSet/DcmDsp/DcmDspRoutine/DcmDspRoutineUsePort)} == TRUE)
      element Dcm_StartDataIn_ArrayType:
        array-size=undefined
        array-size-semantics=FIXED-SIZE
        implementation-data-type=sint32
        variation-point=blueprint-condition=verbatim=l-5=({ecuc(Dcm/DcmConfigSet/DcmDsp/DcmDspRoutine/DcmDspStartRoutine/DcmDspStartRoutineIn/DcmDspStartRoutineInSignal.DcmDspRoutineSignalType)} == SINT32_N)
        implementation-data-type=uint8
        variation-point=blueprint-condition=verbatim=l-5=({ecuc(Dcm/DcmConfigSet/DcmDsp/DcmDspRoutine/DcmDspStartRoutine/DcmDspStartRoutineIn/DcmDspStartRoutineInSignal.DcmDspRoutineSignalType)} == UINT8_N)
        implementation-data-type=uint32
        variation-point=blueprint-condition=verbatim=l-5=({ecuc(Dcm/DcmConfigSet/DcmDsp/DcmDspRoutine/DcmDspStartRoutine/DcmDspStartRoutineIn/DcmDspStartRoutineInSignal.DcmDspRoutineSignalType)} == UINT32_N)
        implementation-data-type=sint8
        variation-point=blueprint-condition=verbatim=l-5=({ecuc(Dcm/DcmConfigSet/DcmDsp/DcmDspRoutine/DcmDspStartRoutine/DcmDspStartRoutineIn/DcmDspStartRoutineInSignal.DcmDspRoutineSignalType)} == SINT8_N)
        implementation-data-type=sint16
        variation-point=blueprint-condition=verbatim=l-5=({ecuc(Dcm/DcmConfigSet/DcmDsp/DcmDspRoutine/DcmDspStartRoutine/DcmDspStartRoutineIn/DcmDspStartRoutineInSignal.DcmDspRoutineSignalType)} == SINT16_N)
        implementation-data-type=uint16
        variation-point=blueprint-condition=verbatim=l-5=({ecuc(Dcm/DcmConfigSet/DcmDsp/DcmDspRoutine/DcmDspStartRoutine/DcmDspStartRoutineIn/DcmDspStartRoutineInSignal.DcmDspRoutineSignalType)} == UINT16_N)
    Dcm_StartDataOutPrimitivType:
      variation-point=blueprint-condition=p=l-1=({ecuc(Dcm/DcmConfigSet/DcmDsp/DcmDspRoutine/DcmDspStartRoutine/DcmDspStartRoutineOut/DcmDspStartRoutineOutSignal.DcmDspRoutineSignalType)} == [U|S]INT[8|16|32]) && ({ecuc(Dcm/DcmConfigSet/DcmDsp/DcmDspRoutine/DcmDspRoutineUsePort)} == TRUE)
      range raw undefined
      implementation-data-type=sint32
      variation-point=blueprint-condition=verbatim=l-5={ecuc(Dcm/DcmConfigSet/DcmDsp/DcmDspRoutine/DcmDspStartRoutine/DcmDspStartRoutineOut/DcmDspStartRoutineOutSignal.DcmDspRoutineSignalType)} == SINT32
      range raw undefined
      implementation-data-type=sint8
      variation-point=blueprint-condition=verbatim=l-5={ecuc(Dcm/DcmConfigSet/DcmDsp/DcmDspRoutine/DcmDspStartRoutine/DcmDspStartRoutineOut/DcmDspStartRoutineOutSignal.DcmDspRoutineSignalType)} == SINT8
      range raw undefined
      implementation-data-type=sint16
      variation-point=blueprint-condition=verbatim=l-5={ecuc(Dcm/DcmConfigSet/DcmDsp/DcmDspRoutine/DcmDspStartRoutine/DcmDspStartRoutineOut/DcmDspStartRoutineOutSignal.DcmDspRoutineSignalType)} == SINT16
      range raw undefined
      implementation-data-type=uint8
      variation-point=blueprint-condition=verbatim=l-5={ecuc(Dcm/DcmConfigSet/DcmDsp/DcmDspRoutine/DcmDspStartRoutine/DcmDspStartRoutineOut/DcmDspStartRoutineOutSignal.DcmDspRoutineSignalType)} == UINT8
      range raw undefined
      implementation-data-type=uint32
      variation-point=blueprint-condition=verbatim=l-5={ecuc(Dcm/DcmConfigSet/DcmDsp/DcmDspRoutine/DcmDspStartRoutine/DcmDspStartRoutineOut/DcmDspStartRoutineOutSignal.DcmDspRoutineSignalType)} == UINT32
      range raw undefined
      implementation-data-type=uint16
      variation-point=blueprint-condition=verbatim=l-5={ecuc(Dcm/DcmConfigSet/DcmDsp/DcmDspRoutine/DcmDspStartRoutine/DcmDspStartRoutineOut/DcmDspStartRoutineOutSignal.DcmDspRoutineSignalType)} == UINT16
    Dcm_StartDataOutType:
      variation-point=blueprint-condition=p=l-1=({ecuc(Dcm/DcmConfigSet/DcmDsp/DcmDspRoutine/DcmDspRoutineUsePort)} == TRUE)
      range raw undefined
      implementation-data-type=Dcm_StartDataOut_ArrayType
      variation-point=blueprint-condition=verbatim=l-5=({ecuc(Dcm/DcmConfigSet/DcmDsp/DcmDspRoutine/DcmDspStartRoutine/DcmDspStartRoutineOut/DcmDspStartRoutineOutSignal.DcmDspRoutineSignalType)} == [U|S]INT[8|16|32]_N)
      range raw undefined
      implementation-data-type=Dcm_StartDataOutPrimitivType
      variation-point=blueprint-condition=verbatim=l-5=({ecuc(Dcm/DcmConfigSet/DcmDsp/DcmDspRoutine/DcmDspStartRoutine/DcmDspStartRoutineOut/DcmDspStartRoutineOutSignal.DcmDspRoutineSignalType)} == [U|S]INT[8|16|32])
    Dcm_StartDataOut_ArrayType: category=ARRAY, variation-point=blueprint-condition=p=l-1=({ecuc(Dcm/DcmConfigSet/DcmDsp/DcmDspRoutine/DcmDspStartRoutine/DcmDspStartRoutineOut/DcmDspStartRoutineOutSignal.DcmDspRoutineSignalType)} == [U|S]INT[8|16|32]_N) && ({ecuc(Dcm/DcmConfigSet/DcmDsp/DcmDspRoutine/DcmDspRoutineUsePort)} == TRUE)
      element Dcm_StartDataOut_ArrayType:
        array-size=undefined
        array-size-semantics=FIXED-SIZE
        implementation-data-type=uint32
        variation-point=blueprint-condition=verbatim=l-5=({ecuc(Dcm/DcmConfigSet/DcmDsp/DcmDspRoutine/DcmDspStartRoutine/DcmDspStartRoutineOut/DcmDspStartRoutineOutSignal.DcmDspRoutineSignalType)} == UINT32_N)
        implementation-data-type=sint16
        variation-point=blueprint-condition=verbatim=l-5=({ecuc(Dcm/DcmConfigSet/DcmDsp/DcmDspRoutine/DcmDspStartRoutine/DcmDspStartRoutineOut/DcmDspStartRoutineOutSignal.DcmDspRoutineSignalType)} == SINT16_N)
        implementation-data-type=uint8
        variation-point=blueprint-condition=verbatim=l-5=({ecuc(Dcm/DcmConfigSet/DcmDsp/DcmDspRoutine/DcmDspStartRoutine/DcmDspStartRoutineOut/DcmDspStartRoutineOutSignal.DcmDspRoutineSignalType)} == UINT8_N)
        implementation-data-type=uint16
        variation-point=blueprint-condition=verbatim=l-5=({ecuc(Dcm/DcmConfigSet/DcmDsp/DcmDspRoutine/DcmDspStartRoutine/DcmDspStartRoutineOut/DcmDspStartRoutineOutSignal.DcmDspRoutineSignalType)} == UINT16_N)
        implementation-data-type=sint32
        variation-point=blueprint-condition=verbatim=l-5=({ecuc(Dcm/DcmConfigSet/DcmDsp/DcmDspRoutine/DcmDspStartRoutine/DcmDspStartRoutineOut/DcmDspStartRoutineOutSignal.DcmDspRoutineSignalType)} == SINT32_N)
        implementation-data-type=sint8
        variation-point=blueprint-condition=verbatim=l-5=({ecuc(Dcm/DcmConfigSet/DcmDsp/DcmDspRoutine/DcmDspStartRoutine/DcmDspStartRoutineOut/DcmDspStartRoutineOutSignal.DcmDspRoutineSignalType)} == SINT8_N)
    Dcm_StartFlexibleInArrayDataType: category=ARRAY, variation-point=blueprint-condition=[l-1=({ecuc(Dcm/DcmConfigSet/DcmDsp/DcmDspRoutine/DcmDspStartRoutine/DcmDspStartRoutineIn/DcmDspStartRoutineInSignal.DcmDspRoutineSignalType)} == VARIABLE_LENGTH), l-1=&& ({ecuc(Dcm/DcmConfigSet/DcmDsp/DcmDspRoutine/DcmDspRoutineUsePort)} == TRUE)]
      element Dcm_StartFlexibleInArrayDataType: array-size=undefined, array-size-semantics=FIXED-SIZE, implementation-data-type=uint8
    Dcm_StartFlexibleOutArrayDataType: category=ARRAY, variation-point=blueprint-condition=[l-1=({ecuc(Dcm/DcmConfigSet/DcmDsp/DcmDspRoutine/DcmDspStartRoutine/DcmDspStartRoutineOut/DcmDspStartRoutineOutSignal.DcmDspRoutineSignalType)} == VARIABLE_LENGTH), l-1=&& ({ecuc(Dcm/DcmConfigSet/DcmDsp/DcmDspRoutine/DcmDspRoutineUsePort)} == TRUE)]
      element Dcm_StartFlexibleOutArrayDataType: array-size=undefined, array-size-semantics=FIXED-SIZE, implementation-data-type=uint8
    Dcm_StopDataInPrimitivType:
      variation-point=blueprint-condition=p=l-1=({ecuc(Dcm/DcmConfigSet/DcmDsp/DcmDspRoutine/DcmDspStopRoutine/DcmDspStopRoutineIn/DcmDspStopRoutineInSignal.DcmDspRoutineSignalType)} == [U|S]INT[8|16|32]) && ({ecuc(Dcm/DcmConfigSet/DcmDsp/DcmDspRoutine/DcmDspRoutineUsePort)} == TRUE)
      range raw undefined
      implementation-data-type=sint16
      variation-point=blueprint-condition=verbatim=l-5={ecuc(Dcm/DcmConfigSet/DcmDsp/DcmDspRoutine/DcmDspStopRoutine/DcmDspStopRoutineIn/DcmDspStopRoutineInSignal.DcmDspRoutineSignalType)} == SINT16
      range raw undefined
      implementation-data-type=uint32
      variation-point=blueprint-condition=verbatim=l-5={ecuc(Dcm/DcmConfigSet/DcmDsp/DcmDspRoutine/DcmDspStopRoutine/DcmDspStopRoutineIn/DcmDspStopRoutineInSignal.DcmDspRoutineSignalType)} == UINT32
      range raw undefined
      implementation-data-type=sint8
      variation-point=blueprint-condition=verbatim=l-5={ecuc(Dcm/DcmConfigSet/DcmDsp/DcmDspRoutine/DcmDspStopRoutine/DcmDspStopRoutineIn/DcmDspStopRoutineInSignal.DcmDspRoutineSignalType)} == SINT8
      range raw undefined
      implementation-data-type=uint8
      variation-point=blueprint-condition=verbatim=l-5={ecuc(Dcm/DcmConfigSet/DcmDsp/DcmDspRoutine/DcmDspStopRoutine/DcmDspStopRoutineIn/DcmDspStopRoutineInSignal.DcmDspRoutineSignalType)} == UINT8
      range raw undefined
      implementation-data-type=sint32
      variation-point=blueprint-condition=verbatim=l-5={ecuc(Dcm/DcmConfigSet/DcmDsp/DcmDspRoutine/DcmDspStopRoutine/DcmDspStopRoutineIn/DcmDspStopRoutineInSignal.DcmDspRoutineSignalType)} == SINT32
      range raw undefined
      implementation-data-type=uint16
      variation-point=blueprint-condition=verbatim=l-5={ecuc(Dcm/DcmConfigSet/DcmDsp/DcmDspRoutine/DcmDspStopRoutine/DcmDspStopRoutineIn/DcmDspStopRoutineInSignal.DcmDspRoutineSignalType)} == UINT16
    Dcm_StopDataInType:
      variation-point=blueprint-condition=p=l-1=({ecuc(Dcm/DcmConfigSet/DcmDsp/DcmDspRoutine/DcmDspRoutineUsePort)} == TRUE)
      range raw undefined
      implementation-data-type=Dcm_StopDataIn_ArrayType
      variation-point=blueprint-condition=verbatim=l-5=({ecuc(Dcm/DcmConfigSet/DcmDsp/DcmDspRoutine/DcmDspStopRoutine/DcmDspStopRoutineIn/DcmDspStopRoutineInSignal.DcmDspRoutineSignalType)} == [U|S]INT[8|16|32]_N)
      range raw undefined
      implementation-data-type=Dcm_StopDataInPrimitivType
      variation-point=blueprint-condition=verbatim=l-5=({ecuc(Dcm/DcmConfigSet/DcmDsp/DcmDspRoutine/DcmDspStopRoutine/DcmDspStopRoutineIn/DcmDspStopRoutineInSignal.DcmDspRoutineSignalType)} == [U|S]INT[8|16|32])
    Dcm_StopDataIn_ArrayType: category=ARRAY, variation-point=blueprint-condition=p=l-1=({ecuc(Dcm/DcmConfigSet/DcmDsp/DcmDspRoutine/DcmDspStopRoutine/DcmDspStopRoutineIn/DcmDspStopRoutineInSignal.DcmDspRoutineSignalType)} == [U|S]INT[8|16|32]_N) && ({ecuc(Dcm/DcmConfigSet/DcmDsp/DcmDspRoutine/DcmDspRoutineUsePort)} == TRUE)
      element Dcm_StopDataIn_ArrayType:
        array-size=undefined
        array-size-semantics=FIXED-SIZE
        implementation-data-type=uint32
        variation-point=blueprint-condition=verbatim=l-5=({ecuc(Dcm/DcmConfigSet/DcmDsp/DcmDspRoutine/DcmDspStopRoutine/DcmDspStopRoutineIn/DcmDspStopRoutineInSignal.DcmDspRoutineSignalType)} == UINT32_N)
        implementation-data-type=uint8
        variation-point=blueprint-condition=verbatim=l-5=({ecuc(Dcm/DcmConfigSet/DcmDsp/DcmDspRoutine/DcmDspStopRoutine/DcmDspStopRoutineIn/DcmDspStopRoutineInSignal.DcmDspRoutineSignalType)} == UINT8_N)
        implementation-data-type=uint16
        variation-point=blueprint-condition=verbatim=l-5=({ecuc(Dcm/DcmConfigSet/DcmDsp/DcmDspRoutine/DcmDspStopRoutine/DcmDspStopRoutineIn/DcmDspStopRoutineInSignal.DcmDspRoutineSignalType)} == UINT16_N)
        implementation-data-type=sint32
        variation-point=blueprint-condition=verbatim=l-5=({ecuc(Dcm/DcmConfigSet/DcmDsp/DcmDspRoutine/DcmDspStopRoutine/DcmDspStopRoutineIn/DcmDspStopRoutineInSignal.DcmDspRoutineSignalType)} == SINT32_N)
        implementation-data-type=sint8
        variation-point=blueprint-condition=verbatim=l-5=({ecuc(Dcm/DcmConfigSet/DcmDsp/DcmDspRoutine/DcmDspStopRoutine/DcmDspStopRoutineIn/DcmDspStopRoutineInSignal.DcmDspRoutineSignalType)} == SINT8_N)
        implementation-data-type=sint16
        variation-point=blueprint-condition=verbatim=l-5=({ecuc(Dcm/DcmConfigSet/DcmDsp/DcmDspRoutine/DcmDspStopRoutine/DcmDspStopRoutineIn/DcmDspStopRoutineInSignal.DcmDspRoutineSignalType)} == SINT16_N)
    Dcm_StopDataOutPrimitivType:
      variation-point=blueprint-condition=p=l-1=({ecuc(Dcm/DcmConfigSet/DcmDsp/DcmDspRoutine/DcmDspStopRoutine/DcmDspStopRoutineOut/DcmDspStopRoutineOutSignal.DcmDspRoutineSignalType)} == [U|S]INT[8|16|32]) && ({ecuc(Dcm/DcmConfigSet/DcmDsp/DcmDspRoutine/DcmDspRoutineUsePort)} == TRUE)
      range raw undefined
      implementation-data-type=sint8
      variation-point=blueprint-condition=verbatim=l-5={ecuc(Dcm/DcmConfigSet/DcmDsp/DcmDspRoutine/DcmDspStopRoutine/DcmDspStopRoutineOut/DcmDspStopRoutineOutSignal.DcmDspRoutineSignalType)} == SINT8
      range raw undefined
      implementation-data-type=sint32
      variation-point=blueprint-condition=verbatim=l-5={ecuc(Dcm/DcmConfigSet/DcmDsp/DcmDspRoutine/DcmDspStopRoutine/DcmDspStopRoutineOut/DcmDspStopRoutineOutSignal.DcmDspRoutineSignalType)} == SINT32
      range raw undefined
      implementation-data-type=uint16
      variation-point=blueprint-condition=verbatim=l-5={ecuc(Dcm/DcmConfigSet/DcmDsp/DcmDspRoutine/DcmDspStopRoutine/DcmDspStopRoutineOut/DcmDspStopRoutineOutSignal.DcmDspRoutineSignalType)} == UINT16
      range raw undefined
      implementation-data-type=uint8
      variation-point=blueprint-condition=verbatim=l-5={ecuc(Dcm/DcmConfigSet/DcmDsp/DcmDspRoutine/DcmDspStopRoutine/DcmDspStopRoutineOut/DcmDspStopRoutineOutSignal.DcmDspRoutineSignalType)} == UINT8
      range raw undefined
      implementation-data-type=sint16
      variation-point=blueprint-condition=verbatim=l-5={ecuc(Dcm/DcmConfigSet/DcmDsp/DcmDspRoutine/DcmDspStopRoutine/DcmDspStopRoutineOut/DcmDspStopRoutineOutSignal.DcmDspRoutineSignalType)} == SINT16
      range raw undefined
      implementation-data-type=uint32
      variation-point=blueprint-condition=verbatim=l-5={ecuc(Dcm/DcmConfigSet/DcmDsp/DcmDspRoutine/DcmDspStopRoutine/DcmDspStopRoutineOut/DcmDspStopRoutineOutSignal.DcmDspRoutineSignalType)} == UINT32
    Dcm_StopDataOutType:
      variation-point=blueprint-condition=p=l-1=({ecuc(Dcm/DcmConfigSet/DcmDsp/DcmDspRoutine/DcmDspRoutineUsePort)} == TRUE)
      range raw undefined
      implementation-data-type=Dcm_StopDataOut_ArrayType
      variation-point=blueprint-condition=verbatim=l-5=({ecuc(Dcm/DcmConfigSet/DcmDsp/DcmDspRoutine/DcmDspStopRoutine/DcmDspStopRoutineOut/DcmDspStopRoutineOutSignal.DcmDspRoutineSignalType)} == [U|S]INT[8|16|32]_N)
      range raw undefined
      implementation-data-type=Dcm_StopDataOutPrimitivType
      variation-point=blueprint-condition=verbatim=l-5=({ecuc(Dcm/DcmConfigSet/DcmDsp/DcmDspRoutine/DcmDspStopRoutine/DcmDspStopRoutineOut/DcmDspStopRoutineOutSignal.DcmDspRoutineSignalType)} == [U|S]INT[8|16|32])
    Dcm_StopDataOut_ArrayType: category=ARRAY, variation-point=blueprint-condition=p=l-1=({ecuc(Dcm/DcmConfigSet/DcmDsp/DcmDspRoutine/DcmDspStopRoutine/DcmDspStopRoutineOut/DcmDspStopRoutineOutSignal.DcmDspRoutineSignalType)} == [U|S]INT[8|16|32]_N) && ({ecuc(Dcm/DcmConfigSet/DcmDsp/DcmDspRoutine/DcmDspRoutineUsePort)} == TRUE)
      element Dcm_StopDataOut_ArrayType:
        array-size=undefined
        array-size-semantics=FIXED-SIZE
        implementation-data-type=uint8
        variation-point=blueprint-condition=verbatim=l-5=({ecuc(Dcm/DcmConfigSet/DcmDsp/DcmDspRoutine/DcmDspStopRoutine/DcmDspStopRoutineOut/DcmDspStopRoutineOutSignal.DcmDspRoutineSignalType)} == UINT8_N)
        implementation-data-type=uint16
        variation-point=blueprint-condition=verbatim=l-5=({ecuc(Dcm/DcmConfigSet/DcmDsp/DcmDspRoutine/DcmDspStopRoutine/DcmDspStopRoutineOut/DcmDspStopRoutineOutSignal.DcmDspRoutineSignalType)} == UINT16_N)
        implementation-data-type=sint8
        variation-point=blueprint-condition=verbatim=l-5=({ecuc(Dcm/DcmConfigSet/DcmDsp/DcmDspRoutine/DcmDspStopRoutine/DcmDspStopRoutineOut/DcmDspStopRoutineOutSignal.DcmDspRoutineSignalType)} == SINT8_N)
        implementation-data-type=sint16
        variation-point=blueprint-condition=verbatim=l-5=({ecuc(Dcm/DcmConfigSet/DcmDsp/DcmDspRoutine/DcmDspStopRoutine/DcmDspStopRoutineOut/DcmDspStopRoutineOutSignal.DcmDspRoutineSignalType)} == SINT16_N)
        implementation-data-type=uint32
        variation-point=blueprint-condition=verbatim=l-5=({ecuc(Dcm/DcmConfigSet/DcmDsp/DcmDspRoutine/DcmDspStopRoutine/DcmDspStopRoutineOut/DcmDspStopRoutineOutSignal.DcmDspRoutineSignalType)} == UINT32_N)
        implementation-data-type=sint32
        variation-point=blueprint-condition=verbatim=l-5=({ecuc(Dcm/DcmConfigSet/DcmDsp/DcmDspRoutine/DcmDspStopRoutine/DcmDspStopRoutineOut/DcmDspStopRoutineOutSignal.DcmDspRoutineSignalType)} == SINT32_N)
    Dcm_StopFlexibleInArrayDataType: category=ARRAY, variation-point=blueprint-condition=[l-1=({ecuc(Dcm/DcmConfigSet/DcmDsp/DcmDspRoutine/DcmDspStopRoutine/DcmDspStopRoutineIn/DcmDspStopRoutineInSignal.DcmDspRoutineSignalType)} == VARIABLE_LENGTH), l-1=&& ({ecuc(Dcm/DcmConfigSet/DcmDsp/DcmDspRoutine/DcmDspRoutineUsePort)} == TRUE)]
      element Dcm_StopFlexibleInArrayDataType: array-size=undefined, array-size-semantics=FIXED-SIZE, implementation-data-type=uint8
    Dcm_StopFlexibleOutArrayDataType: category=ARRAY, variation-point=blueprint-condition=[l-1=({ecuc(Dcm/DcmConfigSet/DcmDsp/DcmDspRoutine/DcmDspStopRoutine/DcmDspStopRoutineOut/DcmDspStopRoutineOutSignal.DcmDspRoutineSignalType)} == VARIABLE_LENGTH), l-1=&& ({ecuc(Dcm/DcmConfigSet/DcmDsp/DcmDspRoutine/DcmDspRoutineUsePort)} == TRUE)]
      element Dcm_StopFlexibleOutArrayDataType: array-size=undefined, array-size-semantics=FIXED-SIZE, implementation-data-type=uint8
package /AUTOSAR/Dem/ImplementationDataTypes_Blueprint
  23 x impl type:
    Dem_DTCFormatType: compu {0=DEM_DTC_FORMAT_OBD, 1=DEM_DTC_FORMAT_UDS, 2=DEM_DTC_FORMAT_J1939}, range raw 0..2, implementation-data-type=uint8
    Dem_DTCOriginType: compu {0x0001=DEM_DTC_ORIGIN_PRIMARY_MEMORY, 0x0002=DEM_DTC_ORIGIN_MIRROR_MEMORY, 0x0003=DEM_DTC_ORIGIN_PERMANENT_MEMORY, 0x0004=DEM_DTC_ORIGIN_OBD_RELEVANT_MEMORY}, range raw 0x01..undefined, implementation-data-type=uint16
    Dem_DTRControlType: compu {0x00=DEM_DTR_CTL_NORMAL, 0x01=DEM_DTR_CTL_NO_MAX, 0x02=DEM DTR_CTL_NO_MIN, 0x03=DEM_DTR_CTL_RESET, 0x04=DEM DTR_CTL_INVISIBLE}, range raw 0x00..0x04, implementation-data-type=uint8
    Dem_DataArrayType: category=ARRAY, variation-point=blueprint-condition=p=l-1={(ecuc((Dem/DemGeneral/DemDataElementClass/DemExternalCSDataElementClass/DemDataElementDataType) == [S|U]INT[8|16|32]_N) || ((Dem/DemGeneral/DemDataElementClass/DemExternalSRDataElementClass/DemDataElementDataType) == [S|U]INT[8|16|32]_N))}
      element Dem_DataArrayType:
        array-size=undefined
        array-size-semantics=FIXED-SIZE
        implementation-data-type=sint32
        variation-point=blueprint-condition=verbatim=l-5={(ecuc((Dem/DemGeneral/DemDataElementClass/DemExternalCSDataElementClass/DemDataElementDataType) == SINT32_N) || ((Dem/DemGeneral/DemDataElementClass/DemExternalSRDataElementClass/DemDataElementDataType) == SINT32_N))}
        implementation-data-type=uint16
        variation-point=blueprint-condition=verbatim=l-5={(ecuc((Dem/DemGeneral/DemDataElementClass/DemExternalCSDataElementClass/DemDataElementDataType) == UINT16_N) || ((Dem/DemGeneral/DemDataElementClass/DemExternalSRDataElementClass/DemDataElementDataType) == UINT16_N))}
        implementation-data-type=uint8
        variation-point=blueprint-condition=verbatim=l-5={(ecuc((Dem/DemGeneral/DemDataElementClass/DemExternalCSDataElementClass/DemDataElementDataType) == UINT8_N) || ((Dem/DemGeneral/DemDataElementClass/DemExternalSRDataElementClass/DemDataElementDataType) == UINT8_N))}
        implementation-data-type=sint8
        variation-point=blueprint-condition=verbatim=l-5={(ecuc((Dem/DemGeneral/DemDataElementClass/DemExternalCSDataElementClass/DemDataElementDataType) == SINT8_N) || ((Dem/DemGeneral/DemDataElementClass/DemExternalSRDataElementClass/DemDataElementDataType) == SINT8_N))}
        implementation-data-type=uint32
        variation-point=blueprint-condition=verbatim=l-5={(ecuc((Dem/DemGeneral/DemDataElementClass/DemExternalCSDataElementClass/DemDataElementDataType) == UINT32_N) || ((Dem/DemGeneral/DemDataElementClass/DemExternalSRDataElementClass/DemDataElementDataType) == UINT32_N))}
        implementation-data-type=sint16
        variation-point=blueprint-condition=verbatim=l-5={(ecuc((Dem/DemGeneral/DemDataElementClass/DemExternalCSDataElementClass/DemDataElementDataType) == SINT16_N) || ((Dem/DemGeneral/DemDataElementClass/DemExternalSRDataElementClass/DemDataElementDataType) == SINT16_N))}
    Dem_DataPrimitiveType:
      variation-point=blueprint-condition=p=l-1={(ecuc((Dem/DemGeneral/DemDataElementClass/DemExternalCSDataElementClass/DemDataElementDataType) == (BOOLEAN|[S|U]INT[8|16|32]) || ((Dem/DemGeneral/DemDataElementClass/DemExternalSRDataElementClass/DemDataElementDataType) == (BOOLEAN|[S|U]INT[8|16|32]))))}
      range raw undefined
      implementation-data-type=sint8
      variation-point=blueprint-condition=verbatim=l-5={(ecuc((Dem/DemGeneral/DemDataElementClass/DemExternalCSDataElementClass/DemDataElementDataType) == SINT8) || ((Dem/DemGeneral/DemDataElementClass/DemExternalSRDataElementClass/DemDataElementDataType) == SINT8)}
      range raw undefined
      implementation-data-type=uint32
      variation-point=blueprint-condition=verbatim=l-5={(ecuc((Dem/DemGeneral/DemDataElementClass/DemExternalCSDataElementClass/DemDataElementDataType) == UINT32) || ((Dem/DemGeneral/DemDataElementClass/DemExternalSRDataElementClass/DemDataElementDataType) == UINT32)}
      range raw undefined
      implementation-data-type=boolean
      variation-point=blueprint-condition=verbatim=l-5={(ecuc((Dem/DemGeneral/DemDataElementClass/DemExternalCSDataElementClass/DemDataElementDataType) == BOOLEAN) || ((Dem/DemGeneral/DemDataElementClass/DemExternalSRDataElementClass/DemDataElementDataType) == BOOLEAN)}
      range raw undefined
      implementation-data-type=sint16
      variation-point=blueprint-condition=verbatim=l-5={(ecuc((Dem/DemGeneral/DemDataElementClass/DemExternalCSDataElementClass/DemDataElementDataType) == SINT16) || ((Dem/DemGeneral/DemDataElementClass/DemExternalSRDataElementClass/DemDataElementDataType) == SINT16)}
      range raw undefined
      implementation-data-type=sint32
      variation-point=blueprint-condition=verbatim=l-5={(ecuc((Dem/DemGeneral/DemDataElementClass/DemExternalCSDataElementClass/DemDataElementDataType) == SINT32) || ((Dem/DemGeneral/DemDataElementClass/DemExternalSRDataElementClass/DemDataElementDataType) == SINT32)}
      range raw undefined
      implementation-data-type=uint8
      variation-point=blueprint-condition=verbatim=l-5={(ecuc((Dem/DemGeneral/DemDataElementClass/DemExternalCSDataElementClass/DemDataElementDataType) == UINT8) || ((Dem/DemGeneral/DemDataElementClass/DemExternalSRDataElementClass/DemDataElementDataType) == UINT8)}
      range raw undefined
      implementation-data-type=uint16
      variation-point=blueprint-condition=verbatim=l-5={(ecuc((Dem/DemGeneral/DemDataElementClass/DemExternalCSDataElementClass/DemDataElementDataType) == UINT16) || ((Dem/DemGeneral/DemDataElementClass/DemExternalSRDataElementClass/DemDataElementDataType) == UINT16)}
    Dem_DataType:
      variation-point=blueprint-condition=p=l-1=((({ecuc(Dem/DemGeneral/DemDataElementClass)} instanceof {ecuc(Dem/DemGeneral/DemDataElementClass/DemExternalCSDataElementClass)}) && ({ecuc(Dem/DemGeneral/DemDataElementClass/DemExternalCSDataElementClass/DemDataElementUsePort)} == true)) || ({ecuc(Dem/DemGeneral/DemDataElementClass)} instanceof {ecuc(Dem/DemGeneral/DemDataElementClass/DemExternalSRDataElementClass)}))
      range raw undefined
      implementation-data-type=Dem_DataArrayType
      variation-point=blueprint-condition=verbatim=l-5={(ecuc((Dem/DemGeneral/DemDataElementClass/DemExternalCSDataElementClass/DemDataElementDataType) == [S|U]INT[8|16|32]_N) || ((Dem/DemGeneral/DemDataElementClass/DemExternalSRDataElementClass/DemDataElementDataType) == [S|U]INT[8|16|32]_N))}
      range raw undefined
      implementation-data-type=Dem_DataPrimitiveType
      variation-point=blueprint-condition=verbatim=l-5={(ecuc((Dem/DemGeneral/DemDataElementClass/DemExternalCSDataElementClass/DemDataElementDataType) == (BOOLEAN|[S|U]INT[8|16|32]) || ((Dem/DemGeneral/DemDataElementClass/DemExternalSRDataElementClass/DemDataElementDataType) == (BOOLEAN|[S|U]INT[8|16|32]))))}
    Dem_DebounceResetStatusType: compu {0x00=DEM_DEBOUNCE_STATUS_FREEZE, 0x01=DEM_DEBOUNCE_STATUS_RESET}, range raw 0x00..0x01, implementation-data-type=uint8
    Dem_DebouncingStateType:
      compu {mask 0x01: 0=FALSE (DEM_TEMPORARILY_DEFECTIVE__FALSE) (Bit 0: Temporarily Defective (corresponds to 0 < FDC < 127)), mask 0x01: 1=TRUE (DEM_TEMPORARILY_DEFECTIVE) (Bit 0: Temporarily Defective (corresponds to 0 < FDC < 127)), mask 0x02: 0=FALSE (DEM_FINALLY_DEFECTIVE__FALSE) (Bit 1: finally Defective (corresponds to FDC = 127)), mask 0x02: 2=TRUE (DEM_FINALLY_DEFECTIVE) (Bit 1: finally Defective (corresponds to FDC = 127)), mask 0x04: 0=FALSE (DEM_TEMPORARILY_HEALED__FALSE) (Bit 2: temporarily healed (corresponds to -128 < FDC < 0)), mask 0x04: 4=TRUE (DEM_TEMPORARILY_HEALED) (Bit 2: temporarily healed (corresponds to -128 < FDC < 0)), mask 0x08: 0=FALSE (DEM_TEST_COMPLETE__FALSE) (Bit 3: Test complete (corresponds to FDC = -128 or FDC = 127)), mask 0x08: 8=TRUE (DEM_TEST_COMPLETE) (Bit 3: Test complete (corresponds to FDC = -128 or FDC = 127)), mask 0x10: 0=FALSE (DEM_DTR_UPDATE__FALSE) (Bit 4: DTR Update (= Test complete && Debouncing complete && enable conditions / storage conditions fulfilled)), mask 0x10: 16=TRUE (DEM_DTR_UPDATE) (Bit 4: DTR Update (= Test complete && Debouncing complete && enable conditions / storage conditions fulfilled))}
      range raw 0x00..0x1F
      implementation-data-type=uint8
    Dem_EventIdType: range raw undefined, implementation-data-type=uint16
    Dem_EventStatusType: compu {0x00=DEM_EVENT_STATUS_PASSED, 0x01=DEM_EVENT_STATUS_FAILED, 0x02=DEM_EVENT_STATUS_PREPASSED, 0x03=DEM_EVENT_STATUS_PREFAILED, 0x04=DEM_EVENT_STATUS_FDC_THRESHOLD_REACHED}, range raw 0x00..0x04, implementation-data-type=uint8
    Dem_IndicatorStatusType: compu {0x00=DEM_INDICATOR_OFF, 0x01=DEM_INDICATOR_CONTINUOUS, 0x02=DEM_INDICATOR_BLINKING, 0x03=DEM_INDICATOR_BLINK_CONT, 0x04=DEM_INDICATOR_SLOW_FLASH, 0x05=DEM_INDICATOR_FAST_FLASH, 0x06=DEM_INDICATOR_ON_DEMAND, 0x07=DEM_INDICATOR_SHORT}, range raw 0x00..0x07, implementation-data-type=uint8
    Dem_InitMonitorReasonType: compu {0x01=DEM_INIT_MONITOR_CLEAR, 0x02=DEM_INIT_MONITOR_RESTART, 0x03=DEM_INIT_MONITOR_REENABLED, 0x04=DEM_INIT_MONITOR_STORAGE_REENABLED}, range raw 0x01..0x04, implementation-data-type=uint8
    Dem_IumprDenomCondIdType: compu {0x02=DEM_IUMPR_DEN_COND_COLDSTART, 0x03=DEM_IUMPR_DEN_COND_EVAP, 0x04=DEM_IUMPR_DEN_COND_500MI, 0x05=DEM_IUMPR_GENERAL_INDIVIDUAL_DENOMINATOR, 0x06=DEM_IUMPR_GENERAL_OBDCOND}, range raw 0x02..0x06, implementation-data-type=uint8
    Dem_IumprDenomCondStatusType: compu {0x00=DEM_IUMPR_DEN_STATUS_NOT_REACHED, 0x01=DEM_IUMPR_DEN_STATUS_REACHED, 0x02=DEM_IUMPR_DEN_STATUS_INHIBITED}, range raw 0x00..0x02, implementation-data-type=uint8
    Dem_MaxDataValueType: category=ARRAY
      element Dem_MaxDataValueType: array-size=undefined, array-size-semantics=FIXED-SIZE, implementation-data-type=uint8
    Dem_MonitorDataType: range raw undefined, implementation-data-type=uint32
    Dem_MonitorStatusType: compu {mask 0x01: 0=FALSE (DEM_MONITOR_STATUS_TF__FALSE) (Bit0: TestFailed), mask 0x01: 1=TRUE (DEM_MONITOR_STATUS_TF) (Bit0: TestFailed), mask 0x02: 0=FALSE (DEM_MONITOR_STATUS_TNCTOC__FALSE) (Bit1: TestNotCompletedThisOperationCycle), mask 0x02: 2=TRUE (DEM_MONITOR_STATUS_TNCTOC) (Bit1: TestNotCompletedThisOperationCycle)}, range raw 0x00..0x03, implementation-data-type=uint8
    Dem_PID21valueType: category=ARRAY
      element Dem_PID21valueType: array-size=undefined, array-size-semantics=FIXED-SIZE, implementation-data-type=uint8
    Dem_PID31valueType: category=ARRAY
      element Dem_PID31valueType: array-size=undefined, array-size-semantics=FIXED-SIZE, implementation-data-type=uint8
    Dem_PID4DvalueType: category=ARRAY, variation-point=blueprint-condition=p=l-1=({ecuc(Dem/DemGeneral.DemOBDSupport)} == DEM_OBD_MASTER_ECU)
      element Dem_PID4DvalueType: array-size=undefined, array-size-semantics=FIXED-SIZE, implementation-data-type=uint8
    Dem_PID4EvalueType: category=ARRAY, variation-point=blueprint-condition=p=l-1=({ecuc(Dem/DemGeneral.DemOBDSupport)} == DEM_OBD_MASTER_ECU)
      element Dem_PID4EvalueType: array-size=undefined, array-size-semantics=FIXED-SIZE, implementation-data-type=uint8
    Dem_RatioIdType:
      range raw undefined
      implementation-data-type=uint16
      variation-point=blueprint-condition=verbatim=l-5=Configurable, size depends on system complexity (refer to range of configuration parameter DemRatioId)
      range raw undefined
      implementation-data-type=uint8
      variation-point=blueprint-condition=verbatim=l-5=Configurable, size depends on system complexity (refer to range of configuration parameter DemRatioId)
    Dem_UdsStatusByteType:
      compu {mask 0x01: 0=FALSE (DEM_UDS_STATUS_TF__FALSE) (bit 0: TestFailed), mask 0x01: 1=TRUE (DEM_UDS_STATUS_TF) (bit 0: TestFailed), mask 0x02: 0=FALSE (DEM_UDS_STATUS_TFTOC__FALSE) (bit 1: TestFailedThisOperationCycle), mask 0x02: 2=TRUE (DEM_UDS_STATUS_TFTOC) (bit 1: TestFailedThisOperationCycle), mask 0x04: 0=FALSE (DEM_UDS_STATUS_PDTC__FALSE) (bit 2: PendingDTC), mask 0x04: 4=TRUE (DEM_UDS_STATUS_PDTC) (bit 2: PendingDTC), mask 0x08: 0=FALSE (DEM_UDS_STATUS_CDTC__FALSE) (bit 3: ConfirmedDTC), mask 0x08: 8=TRUE (DEM_UDS_STATUS_CDTC) (bit 3: ConfirmedDTC), mask 0x10: 0=FALSE (DEM_UDS_STATUS_TNCSLC__FALSE) (bit 4: TestNotCompletedSinceLastClear), mask 0x10: 16=TRUE (DEM_UDS_STATUS_TNCSLC) (bit 4: TestNotCompletedSinceLastClear), mask 0x20: 0=FALSE (DEM_UDS_STATUS_TFSLC__FALSE) (bit 5: TestFailedSinceLastClear), mask 0x20: 32=TRUE (DEM_UDS_STATUS_TFSLC) (bit 5: TestFailedSinceLastClear), mask 0x40: 0=FALSE (DEM_UDS_STATUS_TNCTOC__FALSE) (bit 6: TestNotCompletedThisOperationCycle), mask 0x40: 64=TRUE (DEM_UDS_STATUS_TNCTOC) (bit 6: TestNotCompletedThisOperationCycle), mask 0x80: 0=FALSE (DEM_UDS_STATUS_WIR__FALSE) (bit 7: WarningIndicatorRequested), mask 0x80: 128=TRUE (DEM_UDS_STATUS_WIR) (bit 7: WarningIndicatorRequested)}
      range raw 0x00..0xFF
      implementation-data-type=uint8
package /AUTOSAR/Dlt/ImplementationDataTypes_Blueprint
  15 x impl type:
    Dlt_ApplicationIDType: category=ARRAY
      element Dlt_ApplicationIDType: array-size=undefined, array-size-semantics=FIXED-SIZE, implementation-data-type=uint8
    Dlt_ApplicationIdInfoType: category=STRUCTURE
      5 x element, all with category=TYPE_REFERENCE:
        appId: implementation-data-type=Dlt_ApplicationIDType
        contextIdCount: implementation-data-type=uint16
        contextInfoList: implementation-data-type=Dlt_ContextIdInfoType
        appDescLen: implementation-data-type=uint16
        appDesc: implementation-data-type=uint8
    Dlt_AssignmentOperation: compu {0x01=DLT_ASSIGN_ADD, 0x02=DLT_ASSIGN_REMOVE}, range raw 0x01..0x02
    Dlt_ContextIDType: category=ARRAY
      element Dlt_ContextIDType: array-size=undefined, array-size-semantics=FIXED-SIZE, implementation-data-type=uint8
    Dlt_ContextIdInfoType: category=STRUCTURE
      5 x element:
        contextId: implementation-data-type=Dlt_ContextIDType
        logLevel: implementation-data-type=Dlt_MessageLogLevelType
        traceStatus: implementation-data-type=uint8
        lenContextDescription: implementation-data-type=uint16
        contextDesc: category=ARRAY, array-size-semantics=FIXED-SIZE
          element contextDesc: array-size=undefined, array-size-semantics=FIXED-SIZE, implementation-data-type=uint8
    Dlt_LogChannelNameType: category=ARRAY
      element Dlt_LogChannelNameType: array-size=undefined, array-size-semantics=FIXED-SIZE, implementation-data-type=uint8
    Dlt_LogInfoType: category=STRUCTURE
      element appIdCount: implementation-data-type=uint16
      element appIdInfo: implementation-data-type=Dlt_ApplicationIdInfoType
    Dlt_MessageArgumentCount: range raw undefined, implementation-data-type=uint16
    Dlt_MessageLogInfoType: category=STRUCTURE
      5 x element, all with category=TYPE_REFERENCE:
        argCount: implementation-data-type=Dlt_MessageArgumentCount
        logLevel: implementation-data-type=Dlt_MessageLogLevelType
        options: implementation-data-type=Dlt_MessageOptionsType
        contextId: implementation-data-type=Dlt_ContextIDType
        appId: implementation-data-type=Dlt_ApplicationIDType
    Dlt_MessageLogLevelType: compu {0x00=DLT_LOG_OFF, 0x01=DLT_LOG_FATAL, 0x02=DLT_LOG_ERROR, 0x03=DLT_LOG_WARN, 0x04=DLT_LOG_INFO, 0x05=DLT_LOG_DEBUG, 0x06=DLT_LOG_VERBOSE}, range raw 0x00..0x06
    Dlt_MessageOptionsType: range raw 0x00..0x0F, implementation-data-type=uint8
    Dlt_MessageTraceInfoType: category=STRUCTURE
      4 x element, all with category=TYPE_REFERENCE:
        traceInfo: implementation-data-type=Dlt_MessageTraceType
        options: implementation-data-type=Dlt_MessageOptionsType
        context: implementation-data-type=Dlt_ContextIDType
        appId: implementation-data-type=Dlt_ApplicationIDType
    Dlt_MessageTraceType: compu {0x01=DLT_TRACE_VARIABLE, 0x02=DLT_TRACE_FUNCTION_IN, 0x03=DLT_TRACE_FUNCTION_OUT, 0x04=DLT_TRACE_STATE, 0x05=DLT_TRACE_VFB}, range raw 0x01..0x05
    Dlt_SessionIDType: range raw undefined, implementation-data-type=uint32, variation-point=blueprint-condition=verbatim=l-5=platform depended
    Dlt_uint8Ptr: category=DATA_REFERENCE, sw-pointer-target-props={target-category=TYPE_REFERENCE, implementation-data-type=uint8}
package /AUTOSAR/DoIP/ImplementationDataTypes_Blueprint
  6 x impl type:
    AuthenticationReqDataType: category=ARRAY
      element AuthenticationReqDataType: array-size=undefined, array-size-semantics=FIXED-SIZE, implementation-data-type=uint8
    AuthenticationResDataType: category=ARRAY
      element AuthenticationResDataType: array-size=undefined, array-size-semantics=FIXED-SIZE, implementation-data-type=uint8
    ConfirmationReqDataType: category=ARRAY
      element ConfirmationReqDataType: array-size=undefined, array-size-semantics=FIXED-SIZE, implementation-data-type=uint8
    ConfirmationResDataType: category=ARRAY
      element ConfirmationResDataType: array-size=undefined, array-size-semantics=FIXED-SIZE, implementation-data-type=uint8
    DoIP_FurtherActionByteType: compu {undefined=0x11..0xFF}, range raw undefined, implementation-data-type=uint8
    DoIP_PowerStateType: compu {0x00=DOIP_NOT_READY, 0x01=DOIP_READY, 0x02=DOIP_NOT_SUPPORTED}, range raw 0x00..0x02, implementation-data-type=uint8
package /AUTOSAR/EcuM/ImplementationDataTypes_Blueprint
  impl type EcuM_BootTargetType: compu {0=ECUM_BOOT_TARGET_APP, 1=ECUM_BOOT_TARGET_OEM_BOOTLOADER, 2=ECUM_BOOT_TARGET_SYS_BOOTLOADER}, range raw 0..2, implementation-data-type=uint8
  impl type EcuM_UserType: range raw undefined, implementation-data-type=uint8
package /AUTOSAR/EcuM_flex/ImplementationDataTypes_Blueprint
  6 x impl type, all with category=TYPE_REFERENCE:
    EcuM_BootTargetType: compu {0=ECUM_BOOT_TARGET_APP, 1=ECUM_BOOT_TARGET_OEM_BOOTLOADER, 2=ECUM_BOOT_TARGET_SYS_BOOTLOADER}, range raw 0..2, implementation-data-type=uint8
    EcuM_ShutdownCauseType: compu {0=ECUM_CAUSE_UNKNOWN, 1=ECUM_CAUSE_ECU_STATE, 2=ECUM_CAUSE_WDGM, 3=ECUM_CAUSE_DCM}, range raw 0..3, implementation-data-type=uint8
    EcuM_ShutdownModeType: compu {SleepModeId={SleepMode} (SleepMode), ResetModeId={ResetMode} (ResetMode)}, range raw undefined, implementation-data-type=uint16
    EcuM_ShutdownTargetType: compu {0x0=ECUM_SHUTDOWN_TARGET_SLEEP, 0x1=ECUM_SHUTDOWN_TARGET_RESET, 0x2=ECUM_SHUTDOWN_TARGET_OFF}, range raw 0x0..0x2, implementation-data-type=uint8
    EcuM_TimeType: range raw undefined, implementation-data-type=uint32
    EcuM_UserType: range raw undefined, implementation-data-type=uint8
package /AUTOSAR/FiM/ImplementationDataTypes_Blueprint
  impl type FiM_FunctionIdType: range raw undefined, implementation-data-type=uint8, variation-point=blueprint-condition=verbatim=l-5=platform depended, range raw undefined, implementation-data-type=uint16, variation-point=blueprint-condition=verbatim=l-5=platform depended
package /AUTOSAR/J1939Dcm/ImplementationDataTypes_Blueprint
  impl type CalibrationIDArrayType: category=ARRAY
    element CalibrationIDArrayType: array-size=undefined, array-size-semantics=FIXED-SIZE, implementation-data-type=uint8
package /AUTOSAR/J1939Rm/ImplementationDataTypes_Blueprint
  impl type J1939Rm_AckCode: compu {0x00=J1939RM_ACK_POSITIVE, 0x01=J1939RM_ACK_NEGATIVE, 0x02=J1939RM_ACK_ACCESS_DENIED, 0x03=J1939RM_ACK_CANNOT_RESPOND}, range raw 0x00..0x03
  impl type J1939Rm_ExtIdInfoType: category=STRUCTURE
    4 x element, all with category=TYPE_REFERENCE:
      extIdType: implementation-data-type=J1939Rm_ExtIdType
      extId{1..3}: implementation-data-type=uint8
  impl type J1939Rm_ExtIdType: compu {0x00=J1939RM_EXTID_NONE, 0x01=J1939RM_EXTID_ONE, 0x02=J1939RM_EXTID_TWO, 0x03=J1939RM_EXTID_THREE, 0x04=J1939RM_EXTID_GF}, range raw 0x00..0x04
package /AUTOSAR/KeyM/ImplementationDataTypes_Blueprint
  12 x impl type:
    KeyM_CertElementIdType: range raw undefined, implementation-data-type=uint16
    KeyM_CertificateDataType: category=ARRAY
      element KeyM_CertificateDataType: array-size=undefined, array-size-semantics=FIXED-SIZE, implementation-data-type=uint8
    KeyM_CertificateElementType: category=ARRAY
      element KeyM_CertificateElementType: array-size=undefined, array-size-semantics=FIXED-SIZE, implementation-data-type=uint8
    KeyM_CertificateIdType: range raw undefined, implementation-data-type=uint16
    KeyM_CertificateStatusType: compu {0x01=KEYM_CERTIFICATE_INVALID, 0x04=KEYM_CERTIFICATE_NOT_AVAILABLE, 0x02=KEYM_CERTIFICATE_NOT_PARSED, 0x03=KEYM_CERTIFICATE_PARSED_NOT_VALIDATED, 0x00=KEYM_CERTIFICATE_VALID, 0x07=KEYM_E_CERTIFICATE_INVALID_CHAIN_OF_TRUST, 0x0A=KEYM_E_CERTIFICATE_INVALID_CONTENT, 0x09=KEYM_E_CERTIFICATE_INVALID_FORMAT, 0x08=KEYM_E_CERTIFICATE_INVALID_TYPE, 0x06=KEYM_E_CERTIFICATE_SIGNATURE_FAIL, 0x05=KEYM_E_CERTIFICATE_VALIDITY_PERIOD_FAIL, 0x0B=KEYM_E_CERTIFICATE_REVOKED}, range raw 0x00..0x0B
    KeyM_CertificateType: category=STRUCTURE
      element certDataLength: implementation-data-type=uint32
      element certData: implementation-data-type=KeyM_CertificateDataType
    KeyM_CryptoKeyDataType: category=DATA_REFERENCE, sw-pointer-target-props={target-category=TYPE_REFERENCE, implementation-data-type=uint8}
    KeyM_DataPtr: category=DATA_REFERENCE, sw-pointer-target-props={target-category=TYPE_REFERENCE, implementation-data-type=uint8, sw-impl-policy=CONST}
    KeyM_KeyCertNameDataType: category=ARRAY
      element KeyM_KeyCertNameDataType: array-size=undefined, array-size-semantics=FIXED-SIZE, implementation-data-type=uint8
    KeyM_ResultType: compu {0x05=KEYM_RT_CERT_INVALID_CHAIN_OF_TRUST, 0x02=KEYM_RT_KEY_CERT_INVALID, 0x04=KEYM_RT_KEY_CERT_UPDATE_FAIL, 0x03=KEYM_RT_KEY_CERT_WRITE_FAIL, 0x01=KEYM_RT_NOT_OK, 0x00=KEYM_RT_OK}, range raw 0x00..0x05
    KeyM_ServiceCertificateType: compu {0x01=KEYM_SERVICE_CERT_REQUEST_CSR, 0x05=KEYM_SERVICE_CERT_SET_INTERMEDIATE, 0x03=KEYM_SERVICE_CERT_SET_ROOT, 0x07=KEYM_SERVICE_CERT_UPDATE_CRL, 0x06=KEYM_SERVICE_CERT_UPDATE_INTERMEDIATE, 0x04=KEYM_SERVICE_CERT_UPDATE_ROOT, 0x02=KEYM_SERVICE_CERT_UPDATE_SIGNED_CSR, 7=reserved}, range raw 0x01..0x07
    KeyM_StartType: compu {0x01=KEYM_START_OEM_PRODUCTIONMODE, 0x02=KEYM_START_WORKSHOPMODE, 2=reserved}, range raw 0x01..0x02
package /AUTOSAR/Mirror/ImplementationDataTypes_Blueprint
  5 x impl type:
    Mirror_CanIdType: range raw undefined
    Mirror_FlexRayChannelType: compu {0x01=MIRROR_FR_CHANNEL_A, 0x02=MIRROR_FR_CHANNEL_B, 0x03=MIRROR_FR_CHANNEL_AB}, range raw 0x01..0x03
    Mirror_NetworkType: compu {0x01=MIRROR_NT_CAN, 0x02=MIRROR_NT_LIN, 0x03=MIRROR_NT_FLEXRAY, 0x04=MIRROR_NT_ETHERNET, 0x00=MIRROR_NT_INVALID, 0x05=MIRROR_NT_PROPRIETARY}, range raw 0x00..0x05
    Mirror_booleanPtr: category=DATA_REFERENCE, sw-pointer-target-props={target-category=TYPE_REFERENCE, implementation-data-type=boolean}
    Mirror_uint8Ptr: category=DATA_REFERENCE, sw-pointer-target-props={target-category=TYPE_REFERENCE, implementation-data-type=uint8}
package /AUTOSAR/NvM/ImplementationDataTypes_Blueprint
  4 x impl type, all with category=TYPE_REFERENCE:
    NvM_BlockIdType: range raw undefined, implementation-data-type=uint16
    NvM_BlockRequestType: compu {0x00=NVM_READ_BLOCK, 0x01=NVM_WRITE_BLOCK, 0x02=NVM_RESTORE_BLOCK_DEFAULTS, 0x03=NVM_ERASE_NV_BLOCK, 0x04=NVM_INVALIDATE_NV_BLOCK, 0x05=NVM_READ_ALL_BLOCK}, range raw 0x00..0x05, implementation-data-type=uint8
    NvM_InitBlockRequestType: compu {0x00=NVM_INIT_READ_BLOCK, 0x01=NVM_INIT_RESTORE_BLOCK_DEFAULTS, 0x02=NVM_INIT_READ_ALL_BLOCK, 0x03=NVM_INIT_FIRST_INIT_ALL}, range raw 0x00..0x03, implementation-data-type=uint8
    NvM_RequestResultType: compu {0x00=NVM_REQ_OK, 0x01=NVM_REQ_NOT_OK, 0x02=NVM_REQ_PENDING, 0x03=NVM_REQ_INTEGRITY_FAILED, 0x04=NVM_REQ_BLOCK_SKIPPED, 0x05=NVM_REQ_NV_INVALIDATED, 0x06=NVM_REQ_CANCELED, 0x08=NVM_REQ_RESTORED_FROM_ROM}, range raw 0x00..0x08, implementation-data-type=uint8
package /AUTOSAR/Os/ImplementationDataTypes_Blueprint
  impl type CounterType: range raw undefined, implementation-data-type=uint32
  impl type TimeInMicrosecondsType: range raw undefined, implementation-data-type=uint64
package /AUTOSAR/SecOC/ImplementationDataTypes_Blueprint
  4 x impl type:
    SecOC_FreshnessArrayType: category=ARRAY
      element SecOC_FreshnessArrayType: array-size=undefined, array-size-semantics=FIXED-SIZE, implementation-data-type=uint8
    SecOC_OverrideStatusType: compu {0x00=SECOC_OVERRIDE_DROP_UNTIL_NOTICE, 0x01=SECOC_OVERRIDE_DROP_UNTIL_LIMIT, 0x02=SECOC_OVERRIDE_CANCEL, 0x40=SECOC_OVERRIDE_PASS_UNTIL_NOTICE, 0x41=SECOC_OVERRIDE_SKIP_UNTIL_LIMIT, 0x42=SECOC_OVERRIDE_PASS_UNTIL_LIMIT}, range raw 0x00..0x42
    SecOC_VerificationResultType: compu {0x00=SECOC_VERIFICATIONSUCCESS, 0x01=SECOC_VERIFICATIONFAILURE, 0x02=SECOC_FRESHNESSFAILURE, 0x03=SECOC_AUTHENTICATIONBUILDFAILURE, 0x04=SECOC_NO_VERIFICATION, 0x05=SECOC_VERIFICATIONFAILURE_OVERWRITTEN}, range raw 0x00..0x05
    SecOC_VerificationStatusType: category=STRUCTURE
      element freshnessValueID: implementation-data-type=uint16
      element verificationStatus: implementation-data-type=SecOC_VerificationResultType
      element secOCDataId: implementation-data-type=uint16
package /AUTOSAR/StbM/ImplementationDataTypes_Blueprint
  14 x impl type:
    StbM_CustomerIdType: range raw undefined, implementation-data-type=uint16
    StbM_MasterConfigType: compu {0x00=STBM_SYSTEM_WIDE_MASTER_DISABLED, 0x01=STBM_SYSTEM_WIDE_MASTER_ENABLED}, range raw 0x00..0x01, implementation-data-type=uint8
    StbM_OffsetRecordTableBlockType: category=STRUCTURE
      element GlbSeconds: implementation-data-type=uint32
      element GlbNanoSeconds: implementation-data-type=uint32
      element TimeBaseStatus: implementation-data-type=StbM_TimeBaseStatusType
    StbM_OffsetRecordTableHeadType: category=STRUCTURE
      element OffsetTimeDomain: implementation-data-type=uint8
    StbM_RateDeviationType: range raw undefined, implementation-data-type=sint16
    StbM_SyncRecordTableBlockType: category=STRUCTURE
      8 x element, all with category=TYPE_REFERENCE:
        GlbSeconds: implementation-data-type=uint32
        GlbNanoSeconds: implementation-data-type=uint32
        TimeBaseStatus: implementation-data-type=StbM_TimeBaseStatusType
        VirtualLocalTimeLow: implementation-data-type=uint32
        RateDeviation: implementation-data-type=StbM_RateDeviationType
        LocSeconds: implementation-data-type=uint32
        LocNanoSeconds: implementation-data-type=uint32
        PathDelay: implementation-data-type=uint32
    StbM_SyncRecordTableHeadType: category=STRUCTURE
      element SynchronizedTimeDomain: implementation-data-type=uint8
      element HWfrequency: implementation-data-type=uint32
      element HWprescaler: implementation-data-type=uint32
    StbM_SynchronizedTimeBaseType: range raw 0..65535, implementation-data-type=uint16
    StbM_TimeBaseNotificationType:
      compu {mask 0x01: 0=FALSE (EV_GLOBAL_TIME__FALSE) (Bit 0 (LSB): 0: synchronization to global time master not changed 1: GLOBAL_TIME_BASE in StbM_TimeBaseStatusType has changed from 0 to 1), mask 0x01: 1=TRUE (EV_GLOBAL_TIME) (Bit 0 (LSB): 0: synchronization to global time master not changed 1: GLOBAL_TIME_BASE in StbM_TimeBaseStatusType has changed from 0 to 1), mask 0x02: 0=FALSE (EV_TIMEOUT_OCCURRED__FALSE) (Bit 1: 1: TIMEOUT bit in timeBaseStatus has changed from 0 to 1 0: otherwise), mask 0x02: 2=TRUE (EV_TIMEOUT_OCCURRED) (Bit 1: 1: TIMEOUT bit in timeBaseStatus has changed from 0 to 1 0: otherwise), mask 0x04: 0=FALSE (EV_TIMEOUT_REMOVED__FALSE) (Bit 2 1: TIMEOUT bit in timeBaseStatus has changed from 1 to 0 0: otherwise), mask 0x04: 4=TRUE (EV_TIMEOUT_REMOVED) (Bit 2 1: TIMEOUT bit in timeBaseStatus has changed from 1 to 0 0: otherwise), mask 0x08: 0=FALSE (EV_TIMELEAP_FUTURE__FALSE) (Bit 3 1: TIMELEAP_FUTURE bit in timeBaseStatus has changed from 0 to 1 0: otherwise), mask 0x08: 8=TRUE (EV_TIMELEAP_FUTURE) (Bit 3 1: TIMELEAP_FUTURE bit in timeBaseStatus has changed from 0 to 1 0: otherwise), mask 0x10: 0=FALSE (EV_TIMELEAP_FUTURE_REMOVED__FALSE) (Bit 4 1: TIMELEAP_FUTURE bit in timeBaseStatus has changed from 1 to 0 0: otherwise), mask 0x10: 16=TRUE (EV_TIMELEAP_FUTURE_REMOVED) (Bit 4 1: TIMELEAP_FUTURE bit in timeBaseStatus has changed from 1 to 0 0: otherwise), mask 0x20: 0=FALSE (EV_TIMELEAP_PAST__FALSE) (Bit 5 1: TIMELEAP_PAST bit in timeBaseStatus has changed from 0 to 1 0: otherwise), mask 0x20: 32=TRUE (EV_TIMELEAP_PAST) (Bit 5 1: TIMELEAP_PAST bit in timeBaseStatus has changed from 0 to 1 0: otherwise), mask 0x40: 0=FALSE (EV_TIMELEAP_PAST_REMOVED__FALSE) (Bit 6 1: TIMELEAP_PAST bit in timeBaseStatus has changed from 1 to 0 0: otherwise), mask 0x40: 64=TRUE (EV_TIMELEAP_PAST_REMOVED) (Bit 6 1: TIMELEAP_PAST bit in timeBaseStatus has changed from 1 to 0 0: otherwise), mask 0x80: 0=FALSE (EV_SYNC_TO_SUBDOMAIN__FALSE) (Bit 7 1: SYNC_TO_GATEWAY bit in timeBaseStatus has changed from 0 to 1 0: otherwise), mask 0x80: 128=TRUE (EV_SYNC_TO_SUBDOMAIN) (Bit 7 1: SYNC_TO_GATEWAY bit in timeBaseStatus has changed from 0 to 1 0: otherwise), mask 0x100: 0=FALSE (EV_SYNC_TO_GLOBAL_MASTER__FALSE) (Bit 8 1: SYNC_TO_GATEWAY bit of Time Domain changes from 1 to 0 0: otherwise), mask 0x100: 256=TRUE (EV_SYNC_TO_GLOBAL_MASTER) (Bit 8 1: SYNC_TO_GATEWAY bit of Time Domain changes from 1 to 0 0: otherwise), mask 0x0200: 0=FALSE (EV_RESYNC__FALSE) (Bit 9: 1: A synchronization of the local time to the valid Global Time value has occured 0: No resynchronization event occured), mask 0x0200: 512=TRUE (EV_RESYNC) (Bit 9: 1: A synchronization of the local time to the valid Global Time value has occured 0: No resynchronization event occured), mask 0x0400: 0=FALSE (EV_RATECORRECTION__FALSE) (Bit 10 1: a valid rate correction has been calculated (not beyond limits) 0: No rate correction calculated), mask 0x0400: 1024=TRUE (EV_RATECORRECTION) (Bit 10 1: a valid rate correction has been calculated (not beyond limits) 0: No rate correction calculated)}
      range raw 0x00..0x7FF
      implementation-data-type=uint32
    StbM_TimeBaseStatusType:
      compu {mask 0x01: 0=FALSE (TIMEOUT__FALSE) (Bit 0 (LSB): 0x00: No Timeout on receiving Synchronisation Messages 0x01: Timeout on receiving Synchronisation Messages), mask 0x01: 1=TRUE (TIMEOUT) (Bit 0 (LSB): 0x00: No Timeout on receiving Synchronisation Messages 0x01: Timeout on receiving Synchronisation Messages), mask 0x04: 0=FALSE (SYNC_TO_GATEWAY__FALSE) (Bit 2 0x00: Local Time Base is synchronous to Global Time Master 0x04: Local Time Base updates are based on a Time Gateway below the Global Time Master), mask 0x04: 4=TRUE (SYNC_TO_GATEWAY) (Bit 2 0x00: Local Time Base is synchronous to Global Time Master 0x04: Local Time Base updates are based on a Time Gateway below the Global Time Master), mask 0x08: 0=FALSE (GLOBAL_TIME_BASE__FALSE) (Bit 3 0x00: Local Time Base is based on Local Time Base reference clock only (never synchronized with Global Time Base) 0x08: Local Time Base was at least synchronized with Global Time Base one time), mask 0x08: 8=TRUE (GLOBAL_TIME_BASE) (Bit 3 0x00: Local Time Base is based on Local Time Base reference clock only (never synchronized with Global Time Base) 0x08: Local Time Base was at least synchronized with Global Time Base one time), mask 0x10: 0=FALSE (TIMELEAP_FUTURE__FALSE) (Bit 4 0x00: No leap into the future within the received time for Time Base 0x10: Leap into the future within the received time for Time Base exceeds a configured threshold), mask 0x10: 16=TRUE (TIMELEAP_FUTURE) (Bit 4 0x00: No leap into the future within the received time for Time Base 0x10: Leap into the future within the received time for Time Base exceeds a configured threshold), mask 0x20: 0=FALSE (TIMELEAP_PAST__FALSE) (Bit 5 0x00: No leap into the past within the received time for Time Base 0x20: Leap into the past within the received time for Time Base exceeds a configured threshold), mask 0x20: 32=TRUE (TIMELEAP_PAST) (Bit 5 0x00: No leap into the past within the received time for Time Base 0x20: Leap into the past within the received time for Time Base exceeds a configured threshold)}
      range raw 0x00..0x3D
      implementation-data-type=uint8
    StbM_TimeDiffType: range raw undefined, implementation-data-type=sint32
    StbM_TimeStampExtendedType: category=STRUCTURE
      element timeBaseStatus: implementation-data-type=StbM_TimeBaseStatusType
      element nanoseconds: implementation-data-type=uint32
      element seconds: implementation-data-type=uint64
    StbM_TimeStampType: category=STRUCTURE
      4 x element, all with category=TYPE_REFERENCE:
        timeBaseStatus: implementation-data-type=StbM_TimeBaseStatusType
        nanoseconds: implementation-data-type=uint32
        seconds: implementation-data-type=uint32
        secondsHi: implementation-data-type=uint16
    StbM_UserDataType: category=STRUCTURE
      4 x element, all with category=TYPE_REFERENCE, implementation-data-type=uint8:
        userDataLength
        userByte{0..2}
