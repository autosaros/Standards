AUTOSAR XML (schema 00046)
package /AUTOSAR/Adc/ImplementationDataTypes_Blueprint
  24 x impl type:
    Adc_ChannelRangeSelectType: compu {0=ADC_RANGE_UNDER_LOW, 1=ADC_RANGE_BETWEEN, 2=ADC_RANGE_OVER_HIGH, 3=ADC_RANGE_ALWAYS, 4=ADC_RANGE_NOT_UNDER_LOW, 5=ADC_RANGE_NOT_BETWEEN, 6=ADC_RANGE_NOT_OVER_HIGH}, range raw 0..6
    Adc_ChannelType: range raw undefined
    Adc_ConfigType: category=STRUCTURE
    Adc_ConversionTimeType: range raw undefined
    Adc_GroupAccessModeType: compu {0=ADC_ACCESS_MODE_SINGLE, 1=ADC_ACCESS_MODE_STREAMING}, range raw 0..1
    Adc_GroupConvModeType: compu {0=ADC_CONV_MODE_ONESHOT, 1=ADC_CONV_MODE_CONTINUOUS}, range raw 0..1
    Adc_GroupDefType: range raw undefined, implementation-data-type=implementation_specific
    Adc_GroupPriorityType: range raw undefined, implementation-data-type=uint8
    Adc_GroupReplacementType: compu {0=ADC_GROUP_REPL_ABORT_RESTART, 1=ADC_GROUP_REPL_SUSPEND_RESUME}, range raw 0..1
    Adc_GroupType: compu {undefined=--}, range raw undefined
    Adc_HwTriggerSignalType: compu {0=ADC_HW_TRIG_RISING_EDGE, 1=ADC_HW_TRIG_FALLING_EDGE, 2=ADC_HW_TRIG_BOTH_EDGES}, range raw 0..2
    Adc_HwTriggerTimerType: range raw undefined
    Adc_PowerStateRequestResultType: compu {0=ADC_SERVICE_ACCEPTED, 1=ADC_NOT_INIT, 2=ADC_SEQUENCE_ERROR, 3=ADC_HW_FAILURE, 4=ADC_POWER_STATE_NOT_SUPP, 5=ADC_TRANS_NOT_POSSIBLE}, range raw 0..5
    Adc_PowerStateType: compu {0=ADC_FULL_POWER, 1=1..255}, range raw 0..1
    Adc_PrescaleType: range raw undefined
    Adc_PriorityImplementationType: compu {0=ADC_PRIORITY_NONE, 1=ADC_PRIORITY_HW, 2=ADC_PRIORITY_HW_SW}, range raw 0..2
    Adc_ResolutionType: range raw undefined, implementation-data-type=uint8
    Adc_ResultAlignmentType: compu {0=ADC_ALIGN_LEFT, 1=ADC_ALIGN_RIGHT}, range raw 0..1
    Adc_SamplingTimeType: range raw undefined
    Adc_StatusType: compu {0=ADC_IDLE, 1=ADC_BUSY, 2=ADC_COMPLETED, 3=ADC_STREAM_COMPLETED}, range raw 0..3
    Adc_StreamBufferModeType: compu {0=ADC_STREAM_BUFFER_LINEAR, 1=ADC_STREAM_BUFFER_CIRCULAR}, range raw 0..1
    Adc_StreamNumSampleType: range raw undefined
    Adc_TriggerSourceType: compu {0=ADC_TRIGG_SRC_SW, 1=ADC_TRIGG_SRC_HW}, range raw 0..1
    Adc_ValueGroupType: compu {undefined=--}, range raw undefined
package /AUTOSAR/Bfx/ImplementationDataTypes_Blueprint
  impl type InType
  impl type InTypeMn
  impl type Type
package /AUTOSAR/BswM/ImplementationDataTypes_Blueprint
  impl type BswM_ConfigType: category=STRUCTURE
  impl type BswM_ModeType: range raw undefined, implementation-data-type=uint16, variation-point=blueprint-condition=verbatim=l-5=The range of valid IDs depends on configuration and on the chosen platform type.
  impl type BswM_UserType: range raw undefined, implementation-data-type=uint16, variation-point=blueprint-condition=verbatim=l-5=The range of valid IDs depends on configuration and on the chosen platform type.
package /AUTOSAR/Can/ImplementationDataTypes_Blueprint
  9 x impl type:
    Can_ConfigType: category=STRUCTURE
    Can_TTErrorLevelEnumType: compu {0..3=CAN_TT_ERROR_S0..CAN_TT_ERROR_S3}, range raw 0..3
    Can_TTErrorLevelType: category=STRUCTURE
      element errorLevel: implementation-data-type=Can_TTErrorLevelEnumType
      element maxMessageStatusCount: implementation-data-type=uint8
      element minMessageStatusCount: implementation-data-type=uint8
    Can_TTMasterSlaveModeType: compu {0=CAN_TT_BACKUP_MASTER, 1=CAN_TT_CURRENT_MASTER, 2=CAN_TT_MASTER_OFF, 3=CAN_TT_SLAVE}, range raw 0..3
    Can_TTMasterStateType: category=STRUCTURE
      element masterSlaveMode: implementation-data-type=Can_TTMasterSlaveModeType
      element refTriggerOffset: implementation-data-type=uint8
      element syncMode: implementation-data-type=Can_TTSyncModeEnumType
    Can_TTSyncModeEnumType: compu {0=CAN_TT_IN_GAP, 1=CAN_TT_IN_SCHEDULE, 2=CAN_TT_SYNC_OFF, 3=CAN_TT_SYNCHRONIZING}, range raw 0..3
    Can_TTTURType: range raw undefined, implementation-data-type=uint16
    Can_TTTimeSourceType: compu {0=CAN_TT_CYCLE_TIME, 1=CAN_TT_GLOBAL_TIME, 2=CAN_TT_LOCAL_TIME, 3=CAN_TT_UNDEFINED}, range raw 0..3
    Can_TTTimeType: range raw undefined, implementation-data-type=uint16
package /AUTOSAR/CanIf/ImplementationDataTypes_Blueprint
  14 x impl type:
    CanIf_ConfigType: category=STRUCTURE
    CanIf_NotifStatusType: compu {0x00=CANIF_NO_NOTIFICATION, 1=CANIF_TX_RX_NOTIFICATION}, range raw 0x00..1
    CanIf_PduModeType: compu {0x00=CANIF_OFFLINE, 0x01=CANIF_TX_OFFLINE, 0x02=CANIF_TX_OFFLINE_ACTIVE, 0x03=CANIF_ONLINE}, range raw 0x00..0x03
    CanIf_TTErrorLevelEnumType: compu {0..3=CANIF_TT_ERROR_S0..CANIF_TT_ERROR_S3}, range raw 0..3
    CanIf_TTErrorLevelType: category=STRUCTURE
      element errorLevel: implementation-data-type=CanIf_TTErrorLevelEnumType
      element maxMessageStatusCount: implementation-data-type=uint8
      element minMessageStatusCount: implementation-data-type=uint8
    CanIf_TTEventEnumType: compu {0=CANIF_TT_ERROR_LEVEL_CHANGED, 1=CANIF_TT_INIT_WATCH_TRIGGER, 2=CANIF_TT_NO_ERROR, 3=CANIF_TT_SYNC_FAILED, 4=CANIF_TT_TX_OVERFLOW, 5=CANIF_TT_TX_UNDERFLOW}, range raw 0..5
    CanIf_TTMasterSlaveModeType: compu {0=CANIF_TT_BACKUP_MASTER, 1=CANIF_TT_CURRENT_MASTER, 2=CANIF_TT_MASTER_OFF, 3=CANIF_TT_SLAVE}, range raw 0..3
    CanIf_TTMasterStateType: category=STRUCTURE
      element masterSlaveMode: implementation-data-type=CanIf_TTMasterSlaveModeType
      element refTriggerOffset: implementation-data-type=uint8
      element syncMode: implementation-data-type=CanIf_TTSyncModeEnumType
    CanIf_TTSevereErrorEnumType: compu {0=CANIF_TT_CONFIG_ERROR, 1=CANIF_TT_WATCH_TRIGGER_REACHED, 2=CANIF_TT_APPL_WATCHDOG}, range raw 0..2
    CanIf_TTSyncModeEnumType: compu {0=CANIF_TT_IN_GAP, 1=CANIF_TT_IN_SCHEDULE, 2=CANIF_TT_SYNC_OFF, 3=CANIF_TT_SYNCHRONIZING}, range raw 0..3
    CanIf_TTTURType: range raw undefined, implementation-data-type=uint16
    CanIf_TTTimeSourceType: compu {0=CANIF_TT_CYCLE_TIME, 1=CANIF_TT_GLOBAL_TIME, 2=CANIF_TT_LOCAL_TIME, 3=CANIF_TT_UNDEFINED}, range raw 0..3
    CanIf_TTTimeType: range raw undefined, implementation-data-type=uint16
    CanIf_TTTimingErrorIRQType: category=STRUCTURE
      element errorLevel: implementation-data-type=CanIf_TTErrorLevelType
      element event: implementation-data-type=CanIf_TTEventEnumType
package /AUTOSAR/CanNm/ImplementationDataTypes_Blueprint
  impl type CanNm_ConfigType: category=STRUCTURE
package /AUTOSAR/CanSM/ImplementationDataTypes_Blueprint
  impl type CanSM_BswMCurrentStateType: compu {0=CANSM_BSWM_NO_COMMUNICATION, 1=CANSM_BSWM_SILENT_COMMUNICATION, 2=CANSM_BSWM_FULL_COMMUNICATION, 3=CANSM_BSWM_BUS_OFF, 4=CANSM_BSWM_CHANGE_BAUDRATE}, range raw 0..4
  impl type CanSM_ConfigType: category=STRUCTURE
  impl type CanSM_StateType: compu {0=CANSM_INITED, 1=CANSM_UNINITED}, range raw 0..1
package /AUTOSAR/CanTSyn/ImplementationDataTypes_Blueprint
  impl type CanTSyn_ConfigType: category=STRUCTURE
  impl type CanTSyn_TransmissionModeType: compu {0=CANTSYN_TX_OFF, 1=CANTSYN_TX_ON}, range raw 0..1
package /AUTOSAR/CanTp/ImplementationDataTypes_Blueprint
  impl type CanTp_ConfigType: category=STRUCTURE
package /AUTOSAR/CanTrcv/ImplementationDataTypes_Blueprint
  impl type CanTrcv_ConfigType: category=STRUCTURE
  impl type CanTrcv_PNActivationType: compu {0=PN_ENABLED, 1=PN_DISABLED}, range raw 0..1
  impl type CanTrcv_TrcvFlagStateType: compu {0=CANTRCV_FLAG_SET, 1=CANTRCV_FLAG_CLEARED}, range raw 0..1
package /AUTOSAR/Can_GeneralTypes/ImplementationDataTypes_Blueprint
  9 x impl type:
    CanTrcv_TrcvModeType: compu {0x00=CANTRCV_TRCVMODE_NORMAL, 1=CANTRCV_TRCVMODE_SLEEP, 2=CANTRCV_TRCVMODE_STANDBY}, range raw 0x00..2
    CanTrcv_TrcvWakeupModeType: compu {0x00=CANTRCV_WUMODE_ENABLE, 0x01=CANTRCV_WUMODE_DISABLE, 0x02=CANTRCV_WUMODE_CLEAR}, range raw 0x00..0x02
    CanTrcv_TrcvWakeupReasonType: compu {0x00=CANTRCV_WU_ERROR, 0x01=CANTRCV_WU_NOT_SUPPORTED, 0x02=CANTRCV_WU_BY_BUS, 0x03=CANTRCV_WU_INTERNALLY, 0x04=CANTRCV_WU_RESET, 0x05=CANTRCV_WU_POWER_ON, 0x06=CANTRCV_WU_BY_PIN, 0x07=CANTRCV_WU_BY_SYSERR}, range raw 0x00..0x07
    Can_ControllerStateType: compu {0x00=CAN_CS_UNINIT, 0x01=CAN_CS_STARTED, 0x02=CAN_CS_STOPPED, 0x03=CAN_CS_SLEEP}, range raw 0x00..0x03
    Can_ErrorStateType: compu {0=CAN_ERRORSTATE_ACTIVE, 1=CAN_ERRORSTATE_PASSIVE, 2=CAN_ERRORSTATE_BUSOFF}, range raw 0..2
    Can_HwHandleType: range raw undefined, implementation-data-type=uint16, range raw undefined, implementation-data-type=uint8
    Can_HwType: category=STRUCTURE
      element CanId: implementation-data-type=Can_IdType
      element Hoh: implementation-data-type=Can_HwHandleType
      element ControllerId: implementation-data-type=uint8
    Can_IdType: range raw undefined, implementation-data-type=uint32
    Can_PduType: category=STRUCTURE
      4 x element:
        swPduHandle: implementation-data-type=PduIdType
        length: implementation-data-type=uint8
        id: implementation-data-type=Can_IdType
        sdu: category=DATA_REFERENCE, sw-pointer-target-props={target-category=TYPE_REFERENCE, implementation-data-type=uint8}
package /AUTOSAR/Com/ImplementationDataTypes_Blueprint
  5 x impl type:
    Com_ConfigType: category=STRUCTURE
    Com_IpduGroupIdType: range raw undefined, implementation-data-type=uint16
    Com_SignalGroupIdType: range raw undefined, implementation-data-type=uint16
    Com_SignalIdType: range raw undefined, implementation-data-type=uint16
    Com_StatusType: compu {0x00=COM_UNINIT, 1=COM_INIT}, range raw 0x00..1
package /AUTOSAR/ComM/ImplementationDataTypes_Blueprint
  4 x impl type:
    ComM_ConfigType: category=STRUCTURE
    ComM_InitStatusType: compu {0x00=COMM_UNINIT, 0x01=COMM_INIT}, range raw 0x00..0x01
    ComM_PncModeType: compu {0x00=COMM_PNC_REQUESTED, 0x01=COMM_PNC_READY_SLEEP, 0x02=COMM_PNC_PREPARE_SLEEP, 0x03=COMM_PNC_NO_COMMUNICATION}, range raw 0x00..0x03
    ComM_StateType: compu {2=COMM_FULL_COM_NETWORK_REQUESTED, 3=COMM_FULL_COM_READY_SLEEP, 0=COMM_NO_COM_NO_PENDING_REQUEST, 1=COMM_NO_COM_REQUEST_PENDING, 4=COMM_SILENT_COM}, range raw 0..4, implementation-data-type=uint8
package /AUTOSAR/ComStack_Types/ImplementationDataTypes_Blueprint
  10 x impl type:
    BufReq_ReturnType: compu {0x00=BUFREQ_OK, 0x01=BUFREQ_E_NOT_OK, 0x02=BUFREQ_E_BUSY, 0x03=BUFREQ_E_OVFL}, range raw 0x00..0x03
    IcomConfigIdType: range raw 0x00..undefined, implementation-data-type=uint8
    IcomSwitch_ErrorType: compu {0x00=ICOM_SWITCH_E_OK, 0x01=ICOM_SWITCH_E_FAILED}, range raw 0x00..0x01
    PNCHandleType: range raw 0..undefined, implementation-data-type=uint8
    PduIdType:
      range raw 0..undefined
      implementation-data-type=uint16
      variation-point=blueprint-condition=verbatim=l-5=The size of this global type depends on the maximum number of PDUs used within one software module.
      range raw 0..undefined
      implementation-data-type=uint8
      variation-point=blueprint-condition=verbatim=l-5=The size of this global type depends on the maximum number of PDUs used within one software module.
    PduInfoType: category=STRUCTURE
      element SduDataPtr: category=DATA_REFERENCE, sw-pointer-target-props={target-category=TYPE_REFERENCE, implementation-data-type=uint8}
      element MetaDataPtr: category=DATA_REFERENCE, sw-pointer-target-props={target-category=TYPE_REFERENCE, implementation-data-type=uint8}
      element SduLength: implementation-data-type=PduLengthType
    PduLengthType:
      range raw 0..undefined
      implementation-data-type=uint32
      variation-point=blueprint-condition=verbatim=l-5=The size of this global type depends on the maximum length of PDUs to be sent by an ECU.
      range raw 0..undefined
      implementation-data-type=uint16
      variation-point=blueprint-condition=verbatim=l-5=The size of this global type depends on the maximum length of PDUs to be sent by an ECU.
      range raw 0..undefined
      implementation-data-type=uint8
      variation-point=blueprint-condition=verbatim=l-5=The size of this global type depends on the maximum length of PDUs to be sent by an ECU.
    RetryInfoType: category=STRUCTURE
      element TpDataState: implementation-data-type=TpDataStateType
      element TxTpDataCnt: implementation-data-type=PduLengthType
    TPParameterType: compu {0x00=TP_STMIN, 0x01=TP_BS, 0x02=TP_BC}, range raw 0x00..0x02
    TpDataStateType: compu {0x00=TP_DATACONF, 0x01=TP_DATARETRY, 0x02=TP_CONFPENDING}, range raw 0x00..0x02
package /AUTOSAR/ComXf/ImplementationDataTypes_Blueprint
  impl type paramtype
  impl type type
  impl type ComXf_ConfigType: category=STRUCTURE
package /AUTOSAR/CorTst/ImplementationDataTypes_Blueprint
  7 x impl type:
    CorTst_ConfigType: category=STRUCTURE
    CorTst_CsumSignatureBgndType: category=STRUCTURE
    CorTst_CsumSignatureType: range raw undefined, implementation-data-type=uint16, range raw undefined, implementation-data-type=uint32
    CorTst_ErrOkType: category=STRUCTURE
      element returnvalue: implementation-data-type=CorTst_ResultType
    CorTst_ResultType: compu {0x00=CORTST_E_NOT_OK, 0x01=CORTST_E_OKAY, 0x02=CORTST_E_NOT_TESTED}, range raw 0x00..0x02
    CorTst_StateType: compu {0x00=CORTST_ABORT, 0x01=CORTST_INIT, 0x02=CORTST_UNINIT, 0x03=CORTST_RUNNING_BGND}, range raw 0x00..0x03
    CorTst_TestIdFgndType: range raw undefined, implementation-data-type=uint8, range raw undefined, implementation-data-type=uint32, range raw undefined, implementation-data-type=uint16
package /AUTOSAR/Cry/ImplementationDataTypes_Blueprint
  impl type type
  impl type Cry_PrimitiveConfigType: category=STRUCTURE
package /AUTOSAR/CryIf/ImplementationDataTypes_Blueprint
  impl type CryIf_ConfigType: category=STRUCTURE
package /AUTOSAR/Crypto/ImplementationDataTypes_Blueprint
  impl type Crypto_ConfigType: category=STRUCTURE
package /AUTOSAR/Csm/ImplementationDataTypes_Blueprint
  18 x impl type:
    Crypto_AlgorithmFamilyType: compu {0x00=CRYPTO_ALGOFAM_NOT_SET, 0x01=CRYPTO_ALGOFAM_SHA1, 0x02=CRYPTO_ALGOFAM_SHA2_224, 0x03=CRYPTO_ALGOFAM_SHA2_256, 0x04=CRYPTO_ALGOFAM_SHA2_384, 0x05=CRYPTO_ALGOFAM_SHA2_512, 0x06=CRYPTO_ALGOFAM_SHA2_512_224, 0x07=CRYPTO_ALGOFAM_SHA2_512_256, 0x08=CRYPTO_ALGOFAM_SHA3_224, 0x09=CRYPTO_ALGOFAM_SHA3_256, 0x0a=CRYPTO_ALGOFAM_SHA3_384, 0x0b=CRYPTO_ALGOFAM_SHA3_512, 0x0c=CRYPTO_ALGOFAM_SHAKE128, 0x0d=CRYPTO_ALGOFAM_SHAKE256, 0x0e=CRYPTO_ALGOFAM_RIPEMD160, 0x0f=CRYPTO_ALGOFAM_BLAKE_1_256, 0x10=CRYPTO_ALGOFAM_BLAKE_1_512, 0x11=CRYPTO_ALGOFAM_BLAKE_2s_256, 0x12=CRYPTO_ALGOFAM_BLAKE_2s_512, 0x13=CRYPTO_ALGOFAM_3DES, 0x14=CRYPTO_ALGOFAM_AES, 0x15=CRYPTO_ALGOFAM_CHACHA, 0x16=CRYPTO_ALGOFAM_RSA, 0x17=CRYPTO_ALGOFAM_ED25519, 0x18=CRYPTO_ALGOFAM_BRAINPOOL, 0x19=CRYPTO_ALGOFAM_ECCNIST, 0x1b=CRYPTO_ALGOFAM_RNG, 0x1c=CRYPTO_ALGOFAM_SIPHASH, 0x1d=CRYPTO_ALGOFAM_ECIES, 0xff=CRYPTO_ALGOFAM_CUSTOM, 0x1e=CRYPTO_ALGOFAM_ECCANSI, 0x1f=CRYPTO_ALGOFAM_ECCSEC, 0x20=CRYPTO_ALGOFAM_DRBG, 0x21=CRYPTO_ALGOFAM_FIPS186, 0x22=CRYPTO_ALGOFAM_PADDING_PKCS7, 0x23=CRYPTO_ALGOFAM_PADDING_ONEWITHZEROS, 0x24=CRYPTO_ALGOFAM_PBKDF2, 0x25=CRYPTO_ALGOFAM_KDFX963, 0x26=CRYPTO_ALGOFAM_DH}, range raw 0x00..0xff
    Crypto_AlgorithmInfoType: category=STRUCTURE
      4 x element, all with category=TYPE_REFERENCE:
        family: implementation-data-type=Crypto_AlgorithmFamilyType
        secondaryFamily: implementation-data-type=Crypto_AlgorithmFamilyType
        keyLength: implementation-data-type=uint32
        mode: implementation-data-type=Crypto_AlgorithmModeType
    Crypto_AlgorithmModeType: compu {0x00=CRYPTO_ALGOMODE_NOT_SET, 0x01=CRYPTO_ALGOMODE_ECB, 0x02=CRYPTO_ALGOMODE_CBC, 0x03=CRYPTO_ALGOMODE_CFB, 0x05=CRYPTO_ALGOMODE_CTR, 0x04=CRYPTO_ALGOMODE_OFB, 0x06=CRYPTO_ALGOMODE_GCM, 0x07=CRYPTO_ALGOMODE_XTS, 0x08=CRYPTO_ALGOMODE_RSAES_OAEP, 0x09=CRYPTO_ALGOMODE_RSAES_PKCS1_v1_5, 0x0a=CRYPTO_ALGOMODE_RSASSA_PSS, 0x0b=CRYPTO_ALGOMODE_RSASSA_PKCS1_v1_5, 0x0c=CRYPTO_ALGOMODE_8ROUNDS, 0x0d=CRYPTO_ALGOMODE_12ROUNDS, 0x0e=CRYPTO_ALGOMODE_20ROUNDS, 0x0f=CRYPTO_ALGOMODE_HMAC, 0x10=CRYPTO_ALGOMODE_CMAC, 0x11=CRYPTO_ALGOMODE_GMAC, 0x12=CRYPTO_ALGOMODE_CTRDRBG, 0x13=CRYPTO_ALGOMODE_SIPHASH_2_4, 0x14=CRYPTO_ALGOMODE_SIPHASH_4_8, 0xff=CRYPTO_ALGOMODE_CUSTOM, 0x15=CRYPTO_ALGOMODE_PXXXR1}, range raw 0x00..0xff
    Crypto_InputOutputRedirectionConfigType: compu {0x01=CRYPTO_REDIRECT_CONFIG_PRIMARY_INPUT, 0x02=CRYPTO_REDIRECT_CONFIG_SECONDARY_INPUT, 0x04=CRYPTO_REDIRECT_CONFIG_TERTIARY_INPUT, 0x10=CRYPTO_REDIRECT_CONFIG_PRIMARY_OUTPUT, 0x20=CRYPTO_REDIRECT_CONFIG_SECONDARY_OUTPUT}, range raw 0x01..0x20
    Crypto_JobInfoType: category=STRUCTURE
      element jobId: implementation-data-type=uint32
      element jobPriority: implementation-data-type=uint32
    Crypto_JobPrimitiveInfoType: category=STRUCTURE
      5 x element:
        callbackId: implementation-data-type=uint32
        primitiveInfo: category=DATA_REFERENCE, sw-pointer-target-props={target-category=TYPE_REFERENCE, implementation-data-type=Crypto_PrimitiveInfoType}
        cryIfKeyId: implementation-data-type=uint32
        processingType: implementation-data-type=Crypto_ProcessingType
        callbackUpdateNotification: implementation-data-type=boolean
    Crypto_JobPrimitiveInputOutputType: category=STRUCTURE
      16 x element:
        inputPtr: category=DATA_REFERENCE, sw-pointer-target-props={target-category=TYPE_REFERENCE, implementation-data-type=uint8}
        inputLength: implementation-data-type=uint32
        secondaryInputPtr: category=DATA_REFERENCE, sw-pointer-target-props={target-category=TYPE_REFERENCE, implementation-data-type=uint8}
        secondaryInputLength: implementation-data-type=uint32
        tertiaryInputPtr: category=DATA_REFERENCE, sw-pointer-target-props={target-category=TYPE_REFERENCE, implementation-data-type=uint8}
        tertiaryInputLength: implementation-data-type=uint32
        outputPtr: category=DATA_REFERENCE, sw-pointer-target-props={target-category=TYPE_REFERENCE, implementation-data-type=uint8}
        outputLengthPtr: category=DATA_REFERENCE, sw-pointer-target-props={target-category=TYPE_REFERENCE, implementation-data-type=uint32}
        secondaryOutputPtr: category=DATA_REFERENCE, sw-pointer-target-props={target-category=TYPE_REFERENCE, implementation-data-type=uint8}
        secondaryOutputLengthPtr: category=DATA_REFERENCE, sw-pointer-target-props={target-category=TYPE_REFERENCE, implementation-data-type=uint32}
        input64: implementation-data-type=uint64
        verifyPtr: category=DATA_REFERENCE, sw-pointer-target-props={target-category=TYPE_REFERENCE, implementation-data-type=Crypto_VerifyResultType}
        output64Ptr: category=DATA_REFERENCE, sw-pointer-target-props={target-category=TYPE_REFERENCE, implementation-data-type=uint64}
        mode: implementation-data-type=Crypto_OperationModeType
        cryIfKeyId: implementation-data-type=uint32
        targetCryIfKeyId: implementation-data-type=uint32
    Crypto_JobRedirectionInfoType: category=STRUCTURE
      11 x element, all with category=TYPE_REFERENCE:
        redirectionConfig: implementation-data-type=uint8
        inputKeyId: implementation-data-type=uint32
        inputKeyElementId: implementation-data-type=uint32
        secondaryInputKeyId: implementation-data-type=uint32
        secondaryInputKeyElementId: implementation-data-type=uint32
        tertiaryInputKeyId: implementation-data-type=uint32
        tertiaryInputKeyElementId: implementation-data-type=uint32
        outputKeyId: implementation-data-type=uint32
        outputKeyElementId: implementation-data-type=uint32
        secondaryOutputKeyId: implementation-data-type=uint32
        secondaryOutputKeyElementId: implementation-data-type=uint32
    Crypto_JobStateType: compu {0x00=CRYPTO_JOBSTATE_IDLE, 0x01=CRYPTO_JOBSTATE_ACTIVE}, range raw 0x00..0x01
    Crypto_JobType: category=STRUCTURE
      6 x element:
        jobId: implementation-data-type=uint32
        jobState: implementation-data-type=Crypto_JobStateType
        jobPrimitiveInputOutput: implementation-data-type=Crypto_JobPrimitiveInputOutputType
        jobPrimitiveInfo: category=DATA_REFERENCE, sw-pointer-target-props={target-category=TYPE_REFERENCE, implementation-data-type=Crypto_JobPrimitiveInfoType}
        jobInfo: category=DATA_REFERENCE, sw-pointer-target-props={target-category=TYPE_REFERENCE, implementation-data-type=Crypto_JobInfoType}
        jobRedirectionInfoRef: category=DATA_REFERENCE, sw-pointer-target-props={target-category=TYPE_REFERENCE, implementation-data-type=Crypto_JobRedirectionInfoType}
    Crypto_PrimitiveInfoType: category=STRUCTURE
      element resultLength: implementation-data-type=uint32
      element service: implementation-data-type=Crypto_ServiceInfoType
      element algorithm: implementation-data-type=Crypto_AlgorithmInfoType
    Crypto_ProcessingType: compu {0x00=CRYPTO_PROCESSING_ASYNC, 0x01=CRYPTO_PROCESSING_SYNC}, range raw 0x00..0x01
    Crypto_ServiceInfoType: compu {0x00=CRYPTO_HASH, 0x01=CRYPTO_MACGENERATE, 0x02=CRYPTO_MACVERIFY, 0x03=CRYPTO_ENCRYPT, 0x04=CRYPTO_DECRYPT, 0x05=CRYPTO_AEADENCRYPT, 0x06=CRYPTO_AEADDECRYPT, 0x07=CRYPTO_SIGNATUREGENERATE, 0x08=CRYPTO_SIGNATUREVERIFY, 0x0C=CRYPTO_RANDOMSEED, 0x0D=CRYPTO_KEYGENERATE, 0x0B=CRYPTO_RANDOMGENERATE, 0x0E=CRYPTO_KEYDERIVE, 0x0F=CRYPTO_KEYEXCHANGECALCPUBVAL, 0x10=CRYPTO_KEYEXCHANGECALCSECRET, 0x11=CRYPTO_CERTIFICATEPARSE, 0x12=CRYPTO_CERTIFICATEVERIFY, 0x13=CRYPTO_KEYSETVALID}, range raw 0x00..0x13
    Csm_ServiceConfigType: category=STRUCTURE
    Csm_AlignType: range raw undefined
    Csm_CallbackType: range raw undefined
    Csm_ConfigIdType: compu {texttable}, range raw 0..undefined, implementation-data-type=uint16
    Csm_ConfigType: category=STRUCTURE
package /AUTOSAR/Dcm/ImplementationDataTypes_Blueprint
  15 x impl type:
    Dcm_CommunicationModeType:
      compu {0x00=DCM_ENABLE_RX_TX_NORM, 0x01=DCM_ENABLE_RX_DISABLE_TX_NORM, 0x02=DCM_DISABLE_RX_ENABLE_TX_NORM, 0x03=DCM_DISABLE_RX_TX_NORMAL, 0x04=DCM_ENABLE_RX_TX_NM, 0x05=DCM_ENABLE_RX_DISABLE_TX_NM, 0x06=DCM_DISABLE_RX_ENABLE_TX_NM, 0x07=DCM_DISABLE_RX_TX_NM, 0x08=DCM_ENABLE_RX_TX_NORM_NM, 0x09=DCM_ENABLE_RX_DISABLE_TX_NORM_NM, 0x0A=DCM_DISABLE_RX_ENABLE_TX_NORM_NM, 0x0B=DCM_DISABLE_RX_TX_NORM_NM}
      range raw 0x00..0x0B
      implementation-data-type=uint8
    Dcm_ConfigType: category=STRUCTURE
    Dcm_EcuStartModeType: compu {0x00=DCM_COLD_START, 0x01=DCM_WARM_START}, range raw 0x00..0x01, implementation-data-type=uint8
    Dcm_ExtendedOpStatusType: compu {0x00=DCM_INITIAL, 0x01=DCM_PENDING, 0x02=DCM_CANCEL, 0x03=DCM_FORCE_RCRRP_OK, 0x04=DCM_POS_RESPONSE_SENT, 0x05=DCM_POS_RESPONSE_FAILED, 0x06=DCM_NEG_RESPONSE_SENT, 0x07=DCM_NEG_RESPONSE_FAILED}, range raw 0x00..0x07, implementation-data-type=uint8
    Dcm_IdContextType: range raw undefined, implementation-data-type=uint8
    Dcm_MsgAddInfoType: category=STRUCTURE
    Dcm_MsgContextType: category=STRUCTURE
      8 x element, all with category=TYPE_REFERENCE:
        reqData: implementation-data-type=Dcm_MsgType
        reqDataLen: implementation-data-type=Dcm_MsgLenType
        resData: implementation-data-type=Dcm_MsgType
        resDataLen: implementation-data-type=Dcm_MsgLenType
        msgAddInfo: implementation-data-type=Dcm_MsgAddInfoType
        resMaxDataLen: implementation-data-type=Dcm_MsgLenType
        idContext: implementation-data-type=Dcm_IdContextType
        dcmRxPduId: implementation-data-type=PduIdType
    Dcm_MsgItemType: range raw undefined, implementation-data-type=uint8
    Dcm_MsgLenType: range raw undefined, implementation-data-type=uint32
    Dcm_MsgType: range raw undefined, implementation-data-type=Dcm_MsgItemType
    Dcm_ProgConditionsType: category=STRUCTURE
      7 x element, all with category=TYPE_REFERENCE:
        ConnectionId: implementation-data-type=uint16
        TesterAddress: implementation-data-type=uint16
        Sid: implementation-data-type=uint8
        SubFncId: implementation-data-type=uint8
        ReprogramingRequest: implementation-data-type=boolean
        ApplUpdated: implementation-data-type=boolean
        ResponseRequired: implementation-data-type=boolean
    Dcm_ReturnReadMemoryType: compu {0x02=DCM_READ_FAILED, 0x03=DCM_READ_FORCE_RCRRP, 0x00=DCM_READ_OK, 0x01=DCM_READ_PENDING}, range raw 0x00..0x03, implementation-data-type=uint8
    Dcm_ReturnWriteMemoryType: compu {0x02=DCM_WRITE_FAILED, 0x03=DCM_WRITE_FORCE_RCRRP, 0x00=DCM_WRITE_OK, 0x01=DCM_WRITE_PENDING}, range raw 0x00..0x03, implementation-data-type=uint8
    Dcm_RoeStateType: compu {0x00=DCM_ROE_ACTIVE, 0x01=DCM_ROE_UNACTIVE}, range raw 0x00..0x01, implementation-data-type=uint8
    Dcm_StatusType: compu {0x00=DCM_E_OK, 0x07=DCM_E_PERIODICID_NOT_ACCEPTED, 0x06=DCM_E_ROE_NOT_ACCEPTED}, range raw 0x00..0x07, implementation-data-type=uint8
package /AUTOSAR/Dem/ImplementationDataTypes_Blueprint
  14 x impl type:
    Dem_ComponentIdType: range raw undefined, implementation-data-type=uint16
    Dem_ConfigType: category=STRUCTURE
    Dem_DTCKindType: compu {0x01=DEM_DTC_KIND_ALL_DTCS, 0x02=DEM_DTC_KIND_EMISSION_REL_DTCS}, range raw 0x01..0x02, implementation-data-type=uint8
    Dem_DTCRequestType: compu {0x01=DEM_FIRST_FAILED_DTC, 0x02=DEM_MOST_RECENT_FAILED_DTC, 0x03=DEM_FIRST_DET_CONFIRMED_DTC, 0x04=DEM_MOST_REC_DET_CONFIRMED_DTC}, range raw 0x01..0x04, implementation-data-type=uint8
    Dem_DTCSeverityType:
      compu {mask 0x20: 0=FALSE (DEM_SEVERITY_MAINTENANCE_ONLY__FALSE) (maintenance required), mask 0x20: 32=TRUE (DEM_SEVERITY_MAINTENANCE_ONLY) (maintenance required), mask 0x40: 0=FALSE (DEM_SEVERITY_CHECK_AT_NEXT_HALT__FALSE) (check at next halt), mask 0x40: 64=TRUE (DEM_SEVERITY_CHECK_AT_NEXT_HALT) (check at next halt), mask 0x80: 0=FALSE (DEM_SEVERITY_CHECK_IMMEDIATELY__FALSE) (Check immediately), mask 0x80: 128=TRUE (DEM_SEVERITY_CHECK_IMMEDIATELY) (Check immediately), mask 0x1f: 0=DEM_SEVERITY_NO_SEVERITY (DTC_CLASS) (No severity information available), mask 0x1f: 1=DEM_SEVERITY_WWHOBD_CLASS_NO_CLASS (DTC_CLASS) (No class information), mask 0x1f: 2=DEM_SEVERITY_WWHOBD_CLASS_A (DTC_CLASS) (WWH-OBD Class A), mask 0x1f: 4=DEM_SEVERITY_WWHOBD_CLASS_B1 (DTC_CLASS) (WWH-OBD Class B1), mask 0x1f: 8=DEM_SEVERITY_WWHOBD_CLASS_B2 (DTC_CLASS) (WWH-OBD Class B2), mask 0x1f: 16=DEM_SEVERITY_WWHOBD_CLASS_C (DTC_CLASS) (WWH-OBD Class C)}
      range raw 0x00..0xFF
      implementation-data-type=uint8
    Dem_DTCTranslationFormatType: compu {0x00=DEM_DTC_TRANSLATION_ISO15031_6, 0x01=DEM_DTC_TRANSLATION_ISO14229_1, 0x02=DEM_DTC_TRANSLATION_SAEJ1939_73, 0x03=DEM_DTC_TRANSLATION_ISO11992_4, 0x04=DEM_DTC_TRANSLATION_J2012DA_FORMAT_04}, range raw 0x00..0x04, implementation-data-type=uint8
    Dem_J1939DcmDTCStatusFilterType: compu {0=DEM_J1939DTC_ACTIVE, 1=DEM_J1939DTC_PREVIOUSLY_ACTIVE, 2=DEM_J1939DTC_PENDING, 3=DEM_J1939DTC_PERMANENT, 4=DEM_J1939DTC_CURRENTLY_ACTIVE}, range raw 0..4, implementation-data-type=uint8
    Dem_J1939DcmDiagnosticReadiness1Type: category=STRUCTURE
      8 x element, all with category=TYPE_REFERENCE, implementation-data-type=uint8:
        ActiveTroubleCodes
        PreviouslyActiveDiagnosticTroubleCodes
        OBDCompliance
        ContinuouslyMonitoredSystemsSupport_Status
        NonContinuouslyMonitoredSystemsSupport5
        NonContinuouslyMonitoredSystemsSupport6
        NonContinuouslyMonitoredSystemsStatus7
        NonContinuouslyMonitoredSystemsStatus8
    Dem_J1939DcmDiagnosticReadiness2Type: category=STRUCTURE
      4 x element, all with category=TYPE_REFERENCE, implementation-data-type=uint16:
        DistanceTraveledWhileMILisActivated
        DistanceSinceDTCsCleared
        MinutesRunbyEngineWhileMILisActivated
        TimeSinceDiagnosticTroubleCodesCleared
    Dem_J1939DcmDiagnosticReadiness3Type: category=STRUCTURE
      7 x element, all with category=TYPE_REFERENCE:
        TimeSinceEngineStart: implementation-data-type=uint16
        NumberofWarmupsSinceDTCsCleared: implementation-data-type=uint8
        ContinuouslyMonitoredSystemsEnableCompletedStatus: implementation-data-type=uint8
        NonContinuouslyMonitoredSystemsEnableStatus5: implementation-data-type=uint8
        NonContinuouslyMonitoredSystemsEnableStatus6: implementation-data-type=uint8
        NonContinuouslyMonitoredSystems7: implementation-data-type=uint8
        NonContinuouslyMonitoredSystems8: implementation-data-type=uint8
    Dem_J1939DcmLampStatusType: category=STRUCTURE
      element LampStatus: implementation-data-type=uint8
      element FlashLampStatus: implementation-data-type=uint8
    Dem_J1939DcmSetClearFilterType: compu {0=DEM_J1939DTC_CLEAR_ACTIVE, 1=DEM_J1939DTC_CLEAR_PREVIOUSLY_ACTIVE, 2=DEM_J1939DTC_CLEAR_ACTIVE_AND_PREVIOUSLY_ACTIVE}, range raw 0..2, implementation-data-type=uint8
    Dem_J1939DcmSetFreezeFrameFilterType: compu {0=DEM_J1939DCM_FREEZEFRAME, 1=DEM_J1939DCM_EXPANDED_FREEZEFRAME, 2=DEM_J1939DCM_SPNS_IN_EXPANDED_FREEZEFRAME}, range raw 0..2, implementation-data-type=uint8
    Dem_ReturnDisableDTCRecordUpdateType: compu {0x00=DEM_DISABLE_DTCRECUP_OK, 0x01=DEM_DISABLE_DTCRECUP_WRONG_DTC, 0x02=DEM_DISABLE_DTCRECUP_WRONG_DTCORIGIN, 0x03=DEM_DISABLE_DTCRECUP_PENDING}, range raw 0x00..0x03, implementation-data-type=uint8
package /AUTOSAR/Det/ImplementationDataTypes_Blueprint
  impl type Det_ConfigType: category=STRUCTURE
package /AUTOSAR/Dio/ImplementationDataTypes_Blueprint
  5 x impl type:
    Dio_ChannelGroupType: category=STRUCTURE
      element offset: implementation-data-type=uint8
      element port: implementation-data-type=Dio_PortType
    Dio_ChannelType: range raw undefined
    Dio_LevelType: compu {0x00=STD_LOW, 0x01=STD_HIGH}, range raw 0x00..0x01, implementation-data-type=uint8
    Dio_PortLevelType: range raw undefined
    Dio_PortType: range raw undefined
package /AUTOSAR/Dlt/ImplementationDataTypes_Blueprint
  4 x impl type:
    Dlt_ConfigType: category=STRUCTURE
    Dlt_MessageIDType: category=ARRAY
      element Dlt_MessageIDType: array-size=undefined, array-size-semantics=FIXED-SIZE, implementation-data-type=uint8
    Dlt_MessageNetworkTraceInfoType: compu {0x01=DLT_NW_TRACE_IPC, 0x02=DLT_NW_TRACE_CAN, 0x03=DLT_NW_TRACE_FLEXRAY, 0x04=DLT_NW_TRACE_MOST, 0x05=DLT_NW_TRACE_ETHERNET, 0x06=DLT_NW_TRACE_SOMEIP}, range raw 0x01..0x06
    Dlt_MessageType: compu {0x00=DLT_TYPE_LOG, 0x01=DLT_TYPE_APP_TRACE, 0x02=DLT_TYPE_NW_TRACE, 0x03=DLT_TYPE_CONTROL}, range raw 0x00..0x03
package /AUTOSAR/DoIP/ImplementationDataTypes_Blueprint
  impl type DoIP_ConfigType: category=STRUCTURE
package /AUTOSAR/E2E/ImplementationDataTypes_Blueprint
  38 x impl type:
    E2E_P01CheckStateType: category=STRUCTURE
      8 x element, all with category=TYPE_REFERENCE:
        LastValidCounter: implementation-data-type=uint8
        MaxDeltaCounter: implementation-data-type=uint8
        WaitForFirstData: implementation-data-type=boolean
        NewDataAvailable: implementation-data-type=boolean
        LostData: implementation-data-type=uint8
        Status: implementation-data-type=E2E_P01CheckStatusType
        SyncCounter: implementation-data-type=uint8
        NoNewOrRepeatedDataCounter: implementation-data-type=uint8
    E2E_P01CheckStatusType: compu {0x00=E2E_P01STATUS_OK, 0x01=E2E_P01STATUS_NONEWDATA, 0x02=E2E_P01STATUS_WRONGCRC, 0x03=E2E_P01STATUS_SYNC, 0x04=E2E_P01STATUS_INITIAL, 0x08=E2E_P01STATUS_REPEATED, 0x20=E2E_P01STATUS_OKSOMELOST, 0x40=E2E_P01STATUS_WRONGSEQUENCE}, range raw 0x00..0x40
    E2E_P01ConfigType: category=STRUCTURE
      9 x element, all with category=TYPE_REFERENCE:
        CounterOffset: implementation-data-type=uint16
        CRCOffset: implementation-data-type=uint16
        DataID: implementation-data-type=uint16
        DataIDNibbleOffset: implementation-data-type=uint16
        DataIDMode: implementation-data-type=E2E_P01DataIDMode
        DataLength: implementation-data-type=uint16
        MaxDeltaCounterInit: implementation-data-type=uint8
        MaxNoNewOrRepeatedData: implementation-data-type=uint8
        SyncCounterInit: implementation-data-type=uint8
    E2E_P01DataIDMode: compu {0=E2E_P01_DATAID_BOTH, 1=E2E_P01_DATAID_ALT, 2=E2E_P01_DATAID_LOW, 3=E2E_P01_DATAID_NIBBLE}, range raw 0..3
    E2E_P01ProtectStateType: category=STRUCTURE
      element Counter: implementation-data-type=uint8
    E2E_P02CheckStateType: category=STRUCTURE
      8 x element, all with category=TYPE_REFERENCE:
        LastValidCounter: implementation-data-type=uint8
        MaxDeltaCounter: implementation-data-type=uint8
        WaitForFirstData: implementation-data-type=boolean
        NewDataAvailable: implementation-data-type=boolean
        LostData: implementation-data-type=uint8
        Status: implementation-data-type=E2E_P02CheckStatusType
        SyncCounter: implementation-data-type=uint8
        NoNewOrRepeatedDataCounter: implementation-data-type=uint8
    E2E_P02CheckStatusType: compu {0x00=E2E_P02STATUS_OK, 0x01=E2E_P02STATUS_NONEWDATA, 0x02=E2E_P02STATUS_WRONGCRC, 0x03=E2E_P02STATUS_SYNC, 0x04=E2E_P02STATUS_INITIAL, 0x08=E2E_P02STATUS_REPEATED, 0x20=E2E_P02STATUS_OKSOMELOST, 0x40=E2E_P02STATUS_WRONGSEQUENCE}, range raw 0x00..0x40
    E2E_P02ConfigType: category=STRUCTURE
      6 x element:
        DataLength: implementation-data-type=uint16
        DataIDList: category=ARRAY, array-size-semantics=FIXED-SIZE
          element DataIDList: array-size=undefined, array-size-semantics=FIXED-SIZE, implementation-data-type=uint8
        MaxDeltaCounterInit: implementation-data-type=uint8
        MaxNoNewOrRepeatedData: implementation-data-type=uint8
        SyncCounterInit: implementation-data-type=uint8
        Offset: implementation-data-type=uint16
    E2E_P02ProtectStateType: category=STRUCTURE
      element Counter: implementation-data-type=uint8
    E2E_P04CheckStateType: category=STRUCTURE
      element Status: implementation-data-type=E2E_P04CheckStatusType
      element Counter: implementation-data-type=uint16
    E2E_P04CheckStatusType: compu {0x00=E2E_P04STATUS_OK, 0x20=E2E_P04STATUS_OKSOMELOST, 0x08=E2E_P04STATUS_REPEATED, 0x01=E2E_P04STATUS_NONEWDATA, 0x40=E2E_P04STATUS_WRONGSEQUENCE, 0x02=E2E_P04STATUS_ERROR}, range raw 0x00..0x40
    E2E_P04ConfigType: category=STRUCTURE
      5 x element, all with category=TYPE_REFERENCE:
        DataID: implementation-data-type=uint32
        Offset: implementation-data-type=uint16
        MinDataLength: implementation-data-type=uint16
        MaxDataLength: implementation-data-type=uint16
        MaxDeltaCounter: implementation-data-type=uint16
    E2E_P04ProtectStateType: category=STRUCTURE
      element Counter: implementation-data-type=uint16
    E2E_P05CheckStateType: category=STRUCTURE
      element Status: implementation-data-type=E2E_P05CheckStatusType
      element Counter: implementation-data-type=uint8
    E2E_P05CheckStatusType: compu {0x01=E2E_P05STATUS_NONEWDATA, 0x07=E2E_P05STATUS_ERROR, 0x40=E2E_P05STATUS_WRONGSEQUENCE, 0x08=E2E_P05STATUS_REPEATED, 0x20=E2E_P05STATUS_OKSOMELOST, 0x00=E2E_P05STATUS_OK}, range raw 0x00..0x40
    E2E_P05ConfigType: category=STRUCTURE
      4 x element, all with category=TYPE_REFERENCE:
        Offset: implementation-data-type=uint16
        DataLength: implementation-data-type=uint16
        DataID: implementation-data-type=uint16
        MaxDeltaCounter: implementation-data-type=uint8
    E2E_P05ProtectStateType: category=STRUCTURE
      element Counter: implementation-data-type=uint8
    E2E_P06CheckStateType: category=STRUCTURE
      element Status: implementation-data-type=E2E_P06CheckStatusType
      element Counter: implementation-data-type=uint8
    E2E_P06CheckStatusType: compu {0x01=E2E_P06STATUS_NONEWDATA, 0x07=E2E_P06STATUS_ERROR, 0x40=E2E_P06STATUS_WRONGSEQUENCE, 0x08=E2E_P06STATUS_REPEATED, 0x20=E2E_P06STATUS_OKSOMELOST, 0x00=E2E_P06STATUS_OK}, range raw 0x00..0x40
    E2E_P06ConfigType: category=STRUCTURE
      5 x element, all with category=TYPE_REFERENCE:
        Offset: implementation-data-type=uint16
        MinDataLength: implementation-data-type=uint16
        MaxDataLength: implementation-data-type=uint16
        DataID: implementation-data-type=uint16
        MaxDeltaCounter: implementation-data-type=uint8
    E2E_P06ProtectStateType: category=STRUCTURE
      element Counter: implementation-data-type=uint8
    E2E_P07CheckStateType: category=STRUCTURE
      element Status: implementation-data-type=E2E_P07CheckStatusType
      element Counter: implementation-data-type=uint32
    E2E_P07CheckStatusType: compu {0x00=E2E_P07STATUS_OK, 0x20=E2E_P07STATUS_OKSOMELOST, 0x08=E2E_P07STATUS_REPEATED, 0x01=E2E_P07STATUS_NONEWDATA, 0x40=E2E_P07STATUS_WRONGSEQUENCE, 0x02=E2E_P07STATUS_ERROR}, range raw 0x00..0x40
    E2E_P07ConfigType: category=STRUCTURE
      5 x element, all with category=TYPE_REFERENCE, implementation-data-type=uint32:
        DataID
        Offset
        MinDataLength
        MaxDataLength
        MaxDeltaCounter
    E2E_P07ProtectStateType: category=STRUCTURE
      element Counter: implementation-data-type=uint32
    E2E_P11CheckStateType: category=STRUCTURE
      element Status: implementation-data-type=E2E_P11CheckStatusType
      element Counter: implementation-data-type=uint8
    E2E_P11CheckStatusType: compu {0x01=E2E_P11STATUS_NONEWDATA, 0x07=E2E_P11STATUS_ERROR, 0x40=E2E_P11STATUS_WRONGSEQUENCE, 0x08=E2E_P11STATUS_REPEATED, 0x20=E2E_P11STATUS_OKSOMELOST, 0x00=E2E_P11STATUS_OK}, range raw 0x00..0x40
    E2E_P11ConfigType: category=STRUCTURE
      7 x element, all with category=TYPE_REFERENCE:
        DataLength: implementation-data-type=uint16
        DataID: implementation-data-type=uint16
        MaxDeltaCounter: implementation-data-type=uint8
        DataIDMode: implementation-data-type=E2E_P11DataIDMode
        CRCOffset: implementation-data-type=uint16
        CounterOffset: implementation-data-type=uint16
        DataIDNibbleOffset: implementation-data-type=uint16
    E2E_P11DataIDMode: compu {0=E2E_P11_DATAID_BOTH, 3=E2E_P11_DATAID_NIBBLE}, range raw 0..3
    E2E_P11ProtectStateType: category=STRUCTURE
      element Counter: implementation-data-type=uint8
    E2E_P22CheckStateType: category=STRUCTURE
      element Counter: implementation-data-type=uint8
      element Status: implementation-data-type=E2E_P22CheckStatusType
    E2E_P22CheckStatusType: compu {0x00=E2E_P22STATUS_OK, 0x01=E2E_P22STATUS_NONEWDATA, 0x07=E2E_P22STATUS_ERROR, 0x08=E2E_P22STATUS_REPEATED, 0x20=E2E_P22STATUS_OKSOMELOST, 0x40=E2E_P22STATUS_WRONGSEQUENCE}, range raw 0x00..0x40
    E2E_P22ConfigType: category=STRUCTURE
      4 x element:
        DataLength: implementation-data-type=uint16
        DataIDList: category=ARRAY, array-size-semantics=FIXED-SIZE
          element DataIDList: array-size=undefined, array-size-semantics=FIXED-SIZE, implementation-data-type=uint8
        MaxDeltaCounter: implementation-data-type=uint8
        Offset: implementation-data-type=uint16
    E2E_P22ProtectStateType: category=STRUCTURE
      element Counter: implementation-data-type=uint8
    E2E_PCheckStatusType: compu {0x00=E2E_P_OK, 0x01=E2E_P_REPEATED, 0x02=E2E_P_WRONGSEQUENCE, 0x03=E2E_P_ERROR, 0x04=E2E_P_NOTAVAILABLE, 0x05=E2E_P_NONEWDATA, 0x07, 0x0F=reserved}, range raw 0x00..0x07, 0x0F
    E2E_SMCheckStateType: category=STRUCTURE
      5 x element:
        ProfileStatusWindow: category=DATA_REFERENCE, sw-pointer-target-props={target-category=TYPE_REFERENCE, implementation-data-type=uint8}
        WindowTopIndex: implementation-data-type=uint8
        OkCount: implementation-data-type=uint8
        ErrorCount: implementation-data-type=uint8
        SMState: implementation-data-type=E2E_SMStateType
    E2E_SMConfigType: category=STRUCTURE
      7 x element, all with category=TYPE_REFERENCE, implementation-data-type=uint8:
        WindowSize
        MinOkStateInit
        MaxErrorStateInit
        MinOkStateValid
        MaxErrorStateValid
        MinOkStateInvalid
        MaxErrorStateInvalid
    E2E_SMStateType: compu {0x00=E2E_SM_VALID, 0x01=E2E_SM_DEINIT, 0x02=E2E_SM_NODATA, 0x03=E2E_SM_INIT, 0x04=E2E_SM_INVALID, 0x07, 0x0F=reserved}, range raw 0x00..0x07, 0x0F
package /AUTOSAR/E2EXf/ImplementationDataTypes_Blueprint
  impl type E2EXf_ConfigType: category=STRUCTURE
package /AUTOSAR/Ea/ImplementationDataTypes_Blueprint
  impl type Ea_ConfigType: category=STRUCTURE
package /AUTOSAR/EcuM/ImplementationDataTypes_Blueprint
  impl type EcuM_ConfigType: category=STRUCTURE
  impl type EcuM_WakeupSourceType: range raw undefined, implementation-data-type=uint32
  impl type EcuM_WakeupStatusType: compu {0=ECUM_WKSTATUS_NONE, 1=ECUM_WKSTATUS_PENDING, 2=ECUM_WKSTATUS_VALIDATED, 3=ECUM_WKSTATUS_EXPIRED, 6=ECUM_WKSTATUS_ENABLED}, range raw 0..6, implementation-data-type=uint8
package /AUTOSAR/EcuM_flex/ImplementationDataTypes_Blueprint
  5 x impl type:
    EcuM_ConfigType: category=STRUCTURE
    EcuM_ResetType: compu {0=ECUM_RESET_MCU, 1=ECUM_RESET_WDG, 2=ECUM_RESET_IO}, range raw 0..2, implementation-data-type=uint8
    EcuM_RunStatusType: compu {0=ECUM_RUNSTATUS_UNKNOWN, 1=ECUM_RUNSTATUS_REQUESTED, 2=ECUM_RUNSTATUS_RELEASED}, range raw 0..2, implementation-data-type=uint8
    EcuM_WakeupSourceType: range raw undefined, implementation-data-type=uint32
    EcuM_WakeupStatusType: compu {0=ECUM_WKSTATUS_NONE, 1=ECUM_WKSTATUS_PENDING, 2=ECUM_WKSTATUS_VALIDATED, 3=ECUM_WKSTATUS_EXPIRED}, range raw 0..3, implementation-data-type=uint8
package /AUTOSAR/Eep/ImplementationDataTypes_Blueprint
  impl type Eep_AddressType: range raw undefined
  impl type Eep_ConfigType: category=STRUCTURE
  impl type Eep_LengthType: range raw undefined
package /AUTOSAR/Efx/ImplementationDataTypes_Blueprint
  20 x impl type:
    InType
    OutType
    Efx_DebounceParam_Type: category=STRUCTURE
      element TimeHighLow: implementation-data-type=sint16
      element TimeLowHigh: implementation-data-type=sint16
    Efx_DebounceState_Type: category=STRUCTURE
      element XOld: implementation-data-type=boolean
      element Timer: implementation-data-type=sint32
    Efx_Limits_Type: category=STRUCTURE
      element Min_C: implementation-data-type=sint32
      element Max_C: implementation-data-type=sint32
    Efx_MovingAvrgInTypeMn_Type
    Efx_MovingAvrgS16_Type: category=STRUCTURE
      5 x element, all with category=TYPE_REFERENCE:
        sum: implementation-data-type=sint32
        n: implementation-data-type=sint16
        p_beg: implementation-data-type=sint16
        p_end: implementation-data-type=sint16
        p_act: implementation-data-type=sint16
    Efx_MovingAvrgS32_Type: category=STRUCTURE
      5 x element, all with category=TYPE_REFERENCE:
        sum: implementation-data-type=sint64
        n: implementation-data-type=sint32
        p_beg: implementation-data-type=sint32
        p_end: implementation-data-type=sint32
        p_act: implementation-data-type=sint32
    Efx_ParamPD_Type: category=STRUCTURE
      element K_C: implementation-data-type=sint32
      element Tv_C: implementation-data-type=sint32
    Efx_ParamPID_Type: category=STRUCTURE
      element K_C: implementation-data-type=sint32
      element Tv_C: implementation-data-type=sint32
      element Tnrec_C: implementation-data-type=sint32
    Efx_ParamPI_Type: category=STRUCTURE
      element K_C: implementation-data-type=sint32
      element Tnrec_C: implementation-data-type=sint32
    Efx_ParamRamp_Type: category=STRUCTURE
      element SlopePos_u32: implementation-data-type=uint32
      element SlopeNeg_u32: implementation-data-type=uint32
    Efx_StateDT1Typ1_Type: category=STRUCTURE
      element X1: implementation-data-type=sint32
      element X2: implementation-data-type=sint32
      element Y1: implementation-data-type=sint32
    Efx_StateDT1Typ2_Type: category=STRUCTURE
      element X1: implementation-data-type=sint32
      element Y1: implementation-data-type=sint32
    Efx_StateI_Type: category=STRUCTURE
      element X1: implementation-data-type=sint32
      element Y1: implementation-data-type=sint32
    Efx_StatePD_Type: category=STRUCTURE
      element X1: implementation-data-type=sint32
      element Y1: implementation-data-type=sint32
    Efx_StatePID_Type: category=STRUCTURE
      element X1: implementation-data-type=sint32
      element X2: implementation-data-type=sint32
      element Y1: implementation-data-type=sint32
    Efx_StatePI_Type: category=STRUCTURE
      element X1: implementation-data-type=sint32
      element Y1: implementation-data-type=sint32
    Efx_StatePT1_Type: category=STRUCTURE
      element X1: implementation-data-type=sint32
      element Y1: implementation-data-type=sint32
    Efx_StateRamp_Type: category=STRUCTURE
      element State_s32: implementation-data-type=sint32
      element Dir_s8: implementation-data-type=sint8
      element Switch_s8: implementation-data-type=sint8
package /AUTOSAR/Eth/ImplementationDataTypes_Blueprint
  impl type Eth_ConfigType: category=STRUCTURE
package /AUTOSAR/EthIf/ImplementationDataTypes_Blueprint
  5 x impl type:
    EthIf_ConfigType: category=STRUCTURE
    EthIf_MeasurementIdxType: compu {0x01=ETHIF_MEAS_DROP_CRTLIDX, 0x02-0x7F=ETHIF_MEAS_RESERVED_1, 0x80-0xEF=ETHIF_MEAS_RESERVED_2, 0xF0-0xFE=ETHIF_MEAS_RESERVED_3, 0xFF=ETHIF_MEAS_ALL}, range raw 0x01..0xFF, implementation-data-type=uint8
    EthIf_SignalQualityResultType: category=STRUCTURE
      element HighestSignalQuality: implementation-data-type=uint32
      element LowestSignalQuality: implementation-data-type=uint32
      element ActualSignalQuality: implementation-data-type=uint32
    EthIf_StateType: compu {0x00=ETHCTRL_STATE_UNINIT, 0x01=ETHCTRL_STATE_INIT}, range raw 0x00..0x01
    EthIf_SwitchPortGroupIdxType: range raw undefined, implementation-data-type=uint8
package /AUTOSAR/EthSM/ImplementationDataTypes_Blueprint
  impl type EthSM_NetworkModeStateType: compu {0=ETHSM_STATE_OFFLINE, 1=ETHSM_STATE_WAIT_TRCVLINK, 2=ETHSM_STATE_WAIT_ONLINE, 3=ETHSM_STATE_ONLINE, 4=ETHSM_STATE_ONHOLD, 5=ETHSM_STATE_WAIT_OFFLINE}, range raw 0..5
package /AUTOSAR/EthSwt/ImplementationDataTypes_Blueprint
  9 x impl type:
    EthSwt_ConfigType: category=STRUCTURE
    EthSwt_MacLearningType: compu {0=ETHSWT_MACLEARNING_HWDISABLED, 1=ETHSWT_MACLEARNING_HWENABLED, 2=ETHSWT_MACLEARNING_SWENABLED}, range raw 0..2
    EthSwt_MgmtInfoType: category=STRUCTURE
      element SwitchIdx: implementation-data-type=uint8
      element SwitchPortIdx: implementation-data-type=uint8
    EthSwt_MgmtObjectType: category=STRUCTURE
      5 x element, all with category=TYPE_REFERENCE:
        Validation: implementation-data-type=EthSwt_MgmtObjectValidType
        IngressTimestamp: implementation-data-type=Eth_TimeStampType
        EgressTimestamp: implementation-data-type=Eth_TimeStampType
        MgmtInfo: implementation-data-type=EthSwt_MgmtInfoType
        Ownership: implementation-data-type=EthSwt_MgmtOwner
    EthSwt_MgmtObjectValidType: category=STRUCTURE
      element IngressTimestampValid: implementation-data-type=Std_ReturnType
      element EgressTimestampValid: implementation-data-type=Std_ReturnType
      element MgmtInfoValid: implementation-data-type=Std_ReturnType
    EthSwt_MgmtOwner: compu {0x00=ETHSWT_MGMT_OBJ_UNUSED, 0x01=ETHSWT_MGMT_OBJ_OWNED_BY_ETHSWT, 0x02=ETHSWT_MGMT_OBJ_OWNED_BY_UPPER_LAYER}, range raw 0x00..0x02
    EthSwt_PortMirrorCfgType: category=STRUCTURE
      10 x element:
        srcMacAddrFilter: category=ARRAY, array-size-semantics=FIXED-SIZE
          element srcMacAddrFilter: array-size=undefined, array-size-semantics=FIXED-SIZE, implementation-data-type=uint8
        dstMacAddrFilter: category=ARRAY, array-size-semantics=FIXED-SIZE
          element dstMacAddrFilter: array-size=undefined, array-size-semantics=FIXED-SIZE, implementation-data-type=uint8
        VlanIdFilter: implementation-data-type=uint16
        MirroringPacketDivider: implementation-data-type=uint8
        MirroringMode: implementation-data-type=uint8
        TrafficDirectionIngressBitMask: implementation-data-type=uint32
        TrafficDirectionEgressBitMask: implementation-data-type=uint32
        CapturePortIdx: implementation-data-type=uint8
        ReTaggingVlanId: implementation-data-type=uint8
        DoubleTaggingVlanId: implementation-data-type=uint8
    EthSwt_PortMirrorStateType: compu {0x00=PORT_MIRRORING_DISABLED, 0x01=PORT_MIRRORING_ENABLED}, range raw 0x00..0x01
    EthSwt_StateType: compu {0x00=ETHSWT_STATE_UNINIT, 0x01=ETHSWT_STATE_INIT, 0x02=ETHSWT_STATE_ACTIVE}, range raw 0x00..0x02
package /AUTOSAR/EthTSyn/ImplementationDataTypes_Blueprint
  impl type EthTSyn_ConfigType: category=STRUCTURE
  impl type EthTSyn_TransmissionModeType: compu {0x00=ETHTSYN_TX_OFF, 0x01=ETHTSYN_TX_ON}, range raw 0x00..0x01
package /AUTOSAR/Eth_GeneralTypes/ImplementationDataTypes_Blueprint
  28 x impl type:
    EthTrcv_BaudRateType: compu {0x00=ETHTRCV_BAUD_RATE_10MBIT, 0x01=ETHTRCV_BAUD_RATE_100MBIT, 0x02=ETHTRCV_BAUD_RATE_1000MBIT}, range raw 0x00..0x02
    EthTrcv_CableDiagResultType: compu {0x00=ETHTRCV_CABLEDIAG_OK, 0x01=ETHTRCV_CABLEDIAG_ERROR, 0x02=ETHTRCV_CABLEDIAG_SHORT, 0x03=ETHTRCV_CABLEDIAG_OPEN, 0x04=ETHTRCV_CABLEDIAG_PENDING, 0x05=ETHTRCV_CABLEDIAG_WRONG_POLARITY}, range raw 0x00..0x05
    EthTrcv_ConfigType: category=STRUCTURE
    EthTrcv_DuplexModeType: compu {0x00=ETHTRCV_DUPLEX_MODE_HALF, 0x01=ETHTRCV_DUPLEX_MODE_FULL}, range raw 0x00..0x01
    EthTrcv_LinkStateType: compu {0x00=ETHTRCV_LINK_STATE_DOWN, 0x01=ETHTRCV_LINK_STATE_ACTIVE}, range raw 0x00..0x01
    EthTrcv_ModeType: compu {0x00=ETHTRCV_MODE_DOWN, 0x01=ETHTRCV_MODE_ACTIVE}, range raw 0x00..0x01
    EthTrcv_PhyLoopbackModeType: compu {0x00=ETHTRCV_PHYLOOPBACK_NONE, 0x01=ETHTRCV_PHYLOOPBACK_INTERNAL, 0x02=ETHTRCV_PHYLOOPBACK_EXTERNAL, 0x03=ETHTRCV_PHYLOOPBACK_REMOTE}, range raw 0x00..0x03
    EthTrcv_PhyTestModeType: compu {0x00=ETHTRCV_PHYTESTMODE_NONE, 0x01=ETHTRCV_PHYTESTMODE_1, 0x02=ETHTRCV_PHYTESTMODE_2, 0x03=ETHTRCV_PHYTESTMODE_3, 0x04=ETHTRCV_PHYTESTMODE_4, 0x05=ETHTRCV_PHYTESTMODE_5}, range raw 0x00..0x05
    EthTrcv_PhyTxModeType: compu {0x00=ETHTRCV_PHYTXMODE_NORMAL, 0x01=ETHTRCV_PHYTXMODE_TX_OFF, 0x02=ETHTRCV_PHYTXMODE_SCRAMBLER_OFF}, range raw 0x00..0x02
    EthTrcv_StateType: compu {0x00=ETHTRCV_STATE_UNINIT, 0x01=ETHTRCV_STATE_INIT}, range raw 0x00..0x01
    EthTrcv_WakeupModeType: compu {0x00=ETHTRCV_WUM_DISABLE, 0x01=ETHTRCV_WUM_ENABLE, 0x02=ETHTRCV_WUM_CLEAR}, range raw 0x00..0x02
    EthTrcv_WakeupReasonType: compu {0x00=ETHTRCV_WUR_NONE, 0x01=ETHTRCV_WUR_GENERAL, 0x02=ETHTRCV_WUR_BUS, 0x03=ETHTRCV_WUR_INTERNAL, 0x04=ETHTRCV_WUR_RESET, 0x05=ETHTRCV_WUR_POWER_ON, 0x06=ETHTRCV_WUR_PIN, 0x07=ETHTRCV_WUR_SYSERR}, range raw 0x00..0x07
    Eth_BufIdxType: range raw undefined, implementation-data-type=uint32
    Eth_CounterType: category=STRUCTURE
      18 x element, all with category=TYPE_REFERENCE, implementation-data-type=uint32:
        DropPktBufOverrun
        DropPktCrc
        UndersizePkt
        OversizePkt
        AlgnmtErr
        SqeTestErr
        DiscInbdPkt
        ErrInbdPkt
        DiscOtbdPkt
        ErrOtbdPkt
        SnglCollPkt
        MultCollPkt
        DfrdPkt
        LatCollPkt
        HwDepCtr{0..3}
    Eth_DataType: range raw undefined, implementation-data-type=uint8, variation-point=blueprint-condition=verbatim=l-5=8, 16 or 32 bit CPU, range raw undefined, implementation-data-type=uint16, variation-point=blueprint-condition=verbatim=l-5=8 or 16 bit CPU, range raw undefined, implementation-data-type=uint32, variation-point=blueprint-condition=verbatim=l-5=32 bit CPU
    Eth_FilterActionType: compu {0x00=ETH_ADD_TO_FILTER, 0x01=ETH_REMOVE_FROM_FILTER}, range raw 0x00..0x01
    Eth_FrameType: range raw undefined, implementation-data-type=uint16, variation-point=blueprint-condition=verbatim=l-5=See [21]
    Eth_MacVlanType: category=STRUCTURE
      element MacAddr: category=ARRAY, array-size-semantics=FIXED-SIZE
        element MacAddr: array-size=undefined, array-size-semantics=FIXED-SIZE, implementation-data-type=uint8
      element VlanId: implementation-data-type=uint16
      element SwitchPort: implementation-data-type=uint32
    Eth_ModeType: compu {0x00=ETH_MODE_DOWN, 0x01=ETH_MODE_ACTIVE}, range raw 0x00..0x01
    Eth_RateRatioType: category=STRUCTURE
      element IngressTimeStampDelta: implementation-data-type=Eth_TimeIntDiffType
      element OriginTimeStampDelta: implementation-data-type=Eth_TimeIntDiffType
    Eth_RxStatsType: category=STRUCTURE
      18 x element, all with category=TYPE_REFERENCE, implementation-data-type=uint32:
        RxStatsDropEvents
        RxStatsOctets
        RxStatsPkts
        RxStatsBroadcastPkts
        RxStatsMulticastPkts
        RxStatsCrcAlignErrors
        RxStatsUndersizePkts
        RxStatsOversizePkts
        RxStatsFragments
        RxStatsJabbers
        RxStatsCollisions
        RxStatsPkts64Octets
        RxStatsPkts65to127Octets
        RxStatsPkts128to255Octets
        RxStatsPkts256to511Octets
        RxStatsPkts512to1023Octets
        RxStatsPkts1024to1518Octets
        RxUnicastFrames
    Eth_RxStatusType: compu {0x00=ETH_RECEIVED, 0x01=ETH_NOT_RECEIVED, 0x02=ETH_RECEIVED_MORE_DATA_AVAILABLE}, range raw 0x00..0x02
    Eth_StateType: compu {0x00=ETH_STATE_UNINIT, 0x01=ETH_STATE_INIT}, range raw 0x00..0x01
    Eth_TimeIntDiffType: category=STRUCTURE
      element diff: implementation-data-type=Eth_TimeStampType
      element sign: implementation-data-type=boolean
    Eth_TimeStampQualType: compu {0=ETH_VALID, 1=ETH_INVALID, 2=ETH_UNCERTAIN}, range raw 0..2
    Eth_TimeStampType: category=STRUCTURE
      element nanoseconds: implementation-data-type=uint32
      element seconds: implementation-data-type=uint32
      element secondsHi: implementation-data-type=uint16
    Eth_TxErrorCounterValuesType: category=STRUCTURE
      7 x element, all with category=TYPE_REFERENCE, implementation-data-type=uint32:
        TxDroppedNoErrorPkts
        TxDroppedErrorPkts
        TxDeferredTrans
        TxSingleCollision
        TxMultipleCollision
        TxLateCollision
        TxExcessiveCollison
    Eth_TxStatsType: category=STRUCTURE
      element TxNumberOfOctets: implementation-data-type=uint32
      element TxNUcastPkts: implementation-data-type=uint32
      element TxUniCastPkts: implementation-data-type=uint32
package /AUTOSAR/Fee/ImplementationDataTypes_Blueprint
  impl type Fee_ConfigType: category=STRUCTURE
package /AUTOSAR/FiM/ImplementationDataTypes_Blueprint
  impl type FiM_ConfigType: category=STRUCTURE
package /AUTOSAR/Fls/ImplementationDataTypes_Blueprint
  impl type Fls_AddressType: range raw undefined
  impl type Fls_ConfigType: category=STRUCTURE
  impl type Fls_LengthType: range raw undefined
package /AUTOSAR/FlsTst/ImplementationDataTypes_Blueprint
  9 x impl type:
    FlsTst_BlockIdFgndType: range raw undefined, implementation-data-type=uint32, range raw undefined, implementation-data-type=uint8, range raw undefined, implementation-data-type=uint16
    FlsTst_ConfigType: category=STRUCTURE
    FlsTst_ErrorDetailsType: category=STRUCTURE
    FlsTst_StateType: compu {0x00=FLSTST_UNINIT, 0x01=FLSTST_INIT, 0x02=FLSTST_RUNNING, 0x03=FLSTST_ABORTED, 0x04=FLSTST_SUSPENDED}, range raw 0x00..0x04
    FlsTst_TestResultBgndType: category=STRUCTURE
      element result: implementation-data-type=FlsTst_TestResultType
    FlsTst_TestResultFgndType: compu {0x00=FLSTST_NOT_TESTED, 0x01=FLSTST_OK, 0x02=FLSTST_NOT_OK}, range raw 0x00..0x02
    FlsTst_TestResultType: compu {0x00=FLSTST_RESULT_NOT_TESTED, 0x01=FLSTST_RESULT_OK, 0x02=FLSTST_RESULT_NOT_OK}, range raw 0x00..0x02
    FlsTst_TestSignatureBgndType: category=STRUCTURE
    FlsTst_TestSignatureFgndType: category=STRUCTURE
package /AUTOSAR/Fr/ImplementationDataTypes_Blueprint
  11 x impl type:
    Fr_ChannelType: compu {0x01=FR_CHANNEL_A, 0x02=FR_CHANNEL_B, 0x03=FR_CHANNEL_AB}, range raw 0x01..0x03
    Fr_ConfigType: range raw undefined
    Fr_ErrorModeType: compu {0x00=FR_ERRORMODE_ACTIVE, 0x01=FR_ERRORMODE_PASSIVE, 0x02=FR_ERRORMODE_COMM_HALT}, range raw 0x00..0x02
    Fr_POCStateType: compu {0x00=FR_POCSTATE_CONFIG, 0x01=FR_POCSTATE_DEFAULT_CONFIG, 0x02=FR_POCSTATE_HALT, 0x03=FR_POCSTATE_NORMAL_ACTIVE, 0x04=FR_POCSTATE_NORMAL_PASSIVE, 0x05=FR_POCSTATE_READY, 0x06=FR_POCSTATE_STARTUP, 0x07=FR_POCSTATE_WAKEUP}, range raw 0x00..0x07
    Fr_POCStatusType: category=STRUCTURE
      9 x element, all with category=TYPE_REFERENCE:
        CHIHaltRequest: implementation-data-type=boolean
        ColdstartNoise: implementation-data-type=boolean
        ErrorMode: implementation-data-type=Fr_ErrorModeType
        Freeze: implementation-data-type=boolean
        SlotMode: implementation-data-type=Fr_SlotModeType
        StartupState: implementation-data-type=Fr_StartupStateType
        State: implementation-data-type=Fr_POCStateType
        WakeupStatus: implementation-data-type=Fr_WakeupStatusType
        CHIReadyRequest: implementation-data-type=boolean
    Fr_RxLPduStatusType: compu {0x00=FR_RECEIVED, 0x01=FR_NOT_RECEIVED, 0x02=FR_RECEIVED_MORE_DATA_AVAILABLE}, range raw 0x00..0x02
    Fr_SlotAssignmentType: category=STRUCTURE
      element Cycle: implementation-data-type=uint8
      element SlotId: implementation-data-type=uint16
      element channelId: implementation-data-type=Fr_ChannelType
    Fr_SlotModeType: compu {0x00=FR_SLOTMODE_KEYSLOT, 0x01=FR_SLOTMODE_ALL_PENDING, 0x02=FR_SLOTMODE_ALL}, range raw 0x00..0x02
    Fr_StartupStateType: compu {0x00=FR_STARTUP_UNDEFINED, 0x01=FR_STARTUP_COLDSTART_LISTEN, 0x02=FR_STARTUP_INTEGRATION_COLDSTART_CHECK, 0x03=FR_STARTUP_COLDSTART_JOIN, 0x04=FR_STARTUP_COLDSTART_COLLISION_RESOLUTION, 0x05=FR_STARTUP_COLDSTART_CONSISTENCY_CHECK, 0x06=FR_STARTUP_INTEGRATION_LISTEN, 0x07=FR_STARTUP_INITIALIZE_SCHEDULE, 0x08=FR_STARTUP_INTEGRATION_CONSISTENCY_CHECK, 0x09=FR_STARTUP_COLDSTART_GAP, 0x0a=FR_STARTUP_EXTERNAL_STARTUP}, range raw 0x00..0x0a
    Fr_TxLPduStatusType: compu {0x00=FR_TRANSMITTED, 0x01=FR_TRANSMITTED_CONFLICT, 0x02=FR_NOT_TRANSMITTED}, range raw 0x00..0x02
    Fr_WakeupStatusType: compu {0x00=FR_WAKEUP_UNDEFINED, 0x01=FR_WAKEUP_RECEIVED_HEADER, 0x02=FR_WAKEUP_RECEIVED_WUP, 0x03=FR_WAKEUP_COLLISION_HEADER, 0x04=FR_WAKEUP_COLLISION_WUP, 0x05=FR_WAKEUP_COLLISION_UNKNOWN, 0x06=FR_WAKEUP_TRANSMITTED}, range raw 0x00..0x06
package /AUTOSAR/FrArTp/ImplementationDataTypes_Blueprint
  impl type FrArTp_ConfigType: category=STRUCTURE
package /AUTOSAR/FrIf/ImplementationDataTypes_Blueprint
  impl type FrIf_ConfigType: category=STRUCTURE
  impl type FrIf_StateTransitionType: compu {0=FRIF_GOTO_OFFLINE, 1=FRIF_GOTO_ONLINE}, range raw 0..1
  impl type FrIf_StateType: compu {0=FRIF_STATE_OFFLINE, 1=FRIF_STATE_ONLINE}, range raw 0..1
package /AUTOSAR/FrNm/ImplementationDataTypes_Blueprint
  impl type FrNm_ConfigType: category=STRUCTURE
package /AUTOSAR/FrSm/ImplementationDataTypes_Blueprint
  impl type FrSM_BswM_StateType: compu {0x00=FRSM_BSWM_READY, 0x01=FRSM_BSWM_READY_ECU_PASSIVE, 0x02=FRSM_BSWM_STARTUP, 0x03=FRSM_BSWM_STARTUP_ECU_PASSIVE, 0x04=FRSM_BSWM_WAKEUP, 0x05=FRSM_BSWM_WAKEUP_ECU_PASSIVE, 0x06=FRSM_BSWM_HALT_REQ, 0x07=FRSM_BSWM_HALT_REQ_ECU_PASSIVE, 0x08=FRSM_BSWM_KEYSLOT_ONLY, 0x09=FRSM_BSWM_KEYSLOT_ONLY_ECU_PASSIVE, 0x0A=FRSM_BSWM_ONLINE, 0x0B=FRSM_BSWM_ONLINE_ECU_PASSIVE, 0x0C=FRSM_BSWM_ONLINE_PASSIVE, 0x0D=FRSM_BSWM_ONLINE_PASSIVE_ECU_PASSIVE, 0x0E=FRSM_LOW_NUMBER_OF_COLDSTARTERS, 0x0F=FRSM_LOW_NUMBER_OF_COLDSTARTERS_ECU_PASSIVE}, range raw 0x00..0x0F
  impl type FrSM_ConfigType: category=STRUCTURE
package /AUTOSAR/FrTSyn/ImplementationDataTypes_Blueprint
  impl type FrTSyn_ConfigType: category=STRUCTURE
  impl type FrTSyn_TransmissionModeType: compu {0=FRTSYN_TX_OFF, 1=FRTSYN_TX_ON}, range raw 0..1
package /AUTOSAR/FrTp/ImplementationDataTypes_Blueprint
  impl type FrTp_ConfigType: category=STRUCTURE
package /AUTOSAR/FrTrcv/ImplementationDataTypes_Blueprint
  impl type FrTrcv_ConfigType: category=STRUCTURE
  impl type FrTrcv_TrcvModeType: compu {0=FRTRCV_TRCVMODE_NORMAL, 1=FRTRCV_TRCVMODE_STANDBY, 2=FRTRCV_TRCVMODE_SLEEP, 3=FRTRCV_TRCVMODE_RECEIVEONLY}, range raw 0..3
  impl type FrTrcv_TrcvWUReasonType: compu {0=FRTRCV_WU_NOT_SUPPORTED, 1=FRTRCV_WU_BY_BUS, 2=FRTRCV_WU_BY_PIN, 3=FRTRCV_WU_INTERNALLY, 4=FRTRCV_WU_RESET, 5=FRTRCV_WU_POWER_ON}, range raw 0..5
package /AUTOSAR/Gpt/ImplementationDataTypes_Blueprint
  5 x impl type:
    Gpt_ChannelType: range raw undefined
    Gpt_ConfigType: category=STRUCTURE
    Gpt_ModeType: compu {0x00=GPT_MODE_NORMAL, 0x01=GPT_MODE_SLEEP}, range raw 0x00..0x01
    Gpt_PredefTimerType: compu {0x00=GPT_PREDEF_TIMER_1US_16BIT, 0x01=GPT_PREDEF_TIMER_1US_24BIT, 0x02=GPT_PREDEF_TIMER_1US_32BIT, 0x03=GPT_PREDEF_TIMER_100US_32BIT}, range raw 0x00..0x03
    Gpt_ValueType: range raw undefined
package /AUTOSAR/Icu/ImplementationDataTypes_Blueprint
  12 x impl type:
    Icu_ActivationType: compu {0=ICU_RISING_EDGE, 1=ICU_FALLING_EDGE, 2=ICU_BOTH_EDGES}, range raw 0..2
    Icu_ChannelType: range raw undefined
    Icu_ConfigType: category=STRUCTURE
    Icu_DutyCycleType: category=STRUCTURE
      element ActiveTime: implementation-data-type=Icu_ValueType
      element PeriodTime: implementation-data-type=Icu_ValueType
    Icu_EdgeNumberType: range raw undefined
    Icu_IndexType: range raw undefined
    Icu_InputStateType: compu {0=ICU_ACTIVE, 1=ICU_IDLE}, range raw 0..1
    Icu_MeasurementModeType: compu {0=ICU_MODE_SIGNAL_EDGE_DETECT, 1=ICU_MODE_SIGNAL_MEASUREMENT, 2=ICU_MODE_TIMESTAMP, 3=ICU_MODE_EDGE_COUNTER}, range raw 0..3
    Icu_ModeType: compu {0=ICU_MODE_NORMAL, 1=ICU_MODE_SLEEP}, range raw 0..1
    Icu_SignalMeasurementPropertyType: compu {0=ICU_LOW_TIME, 1=ICU_HIGH_TIME, 2=ICU_PERIOD_TIME, 3=ICU_DUTY_CYCLE}, range raw 0..3
    Icu_TimestampBufferType: compu {0=ICU_LINEAR_BUFFER, 1=ICU_CIRCULAR_BUFFER}, range raw 0..1
    Icu_ValueType: range raw undefined
package /AUTOSAR/Ifl/ImplementationDataTypes_Blueprint
  impl type Ifl_DPResultF32_Type: category=STRUCTURE
    element Index: implementation-data-type=uint32
    element Ratio: implementation-data-type=float32
package /AUTOSAR/Ifx/ImplementationDataTypes_Blueprint
  4 x impl type:
    InType
    OutType
    inType
    Ifx_DPResultU16_Type: category=STRUCTURE
      element Index: implementation-data-type=uint16
      element Ratio: implementation-data-type=uint16
package /AUTOSAR/IoHwAb/ImplementationDataTypes_Blueprint
  impl type EcuSignalDataType
  impl type IoHwAbInit_Id_ConfigType: category=STRUCTURE
package /AUTOSAR/Ioc/ImplementationDataTypes_Blueprint
  impl type Data1
  impl type Data2
  impl type Data
package /AUTOSAR/IpduM/ImplementationDataTypes_Blueprint
  impl type IpduM_ConfigType: category=STRUCTURE
package /AUTOSAR/J1939Dcm/ImplementationDataTypes_Blueprint
  impl type J1939Dcm_ConfigType: category=STRUCTURE
  impl type J1939Dcm_StateType: compu {0x00=J1939DCM_STATE_ONLINE, 0x01=J1939DCM_STATE_OFFLINE}, range raw 0x00..0x01
package /AUTOSAR/J1939Nm/ImplementationDataTypes_Blueprint
  impl type J1939Nm_ConfigType: category=STRUCTURE
package /AUTOSAR/J1939Rm/ImplementationDataTypes_Blueprint
  impl type J1939Rm_ConfigType: category=STRUCTURE
  impl type J1939Rm_StateType: compu {0x00=J1939RM_STATE_OFFLINE, 0x01=J1939RM_STATE_ONLINE}, range raw 0x00..0x01
package /AUTOSAR/J1939Tp/ImplementationDataTypes_Blueprint
  impl type J1939Tp_ConfigType: category=STRUCTURE
package /AUTOSAR/KeyM/ImplementationDataTypes_Blueprint
  6 x impl type:
    KeyM_CertDataPointerType: category=DATA_REFERENCE, sw-pointer-target-props={target-category=TYPE_REFERENCE, implementation-data-type=uint8}
    KeyM_CertDataType: category=STRUCTURE
      element certDataLength: implementation-data-type=uint32
      element certData: implementation-data-type=KeyM_CertDataPointerType
    KeyM_CertElementIteratorType: category=STRUCTURE
    KeyM_ConfigType: category=STRUCTURE
    KeyM_CryptoKeyIdType: range raw undefined, implementation-data-type=uint16
    KeyM_KH_UpdateOperationType: compu {0x02=KEYM_KH_UPDATE_FINISH, 0x01=KEYM_KH_UPDATE_KEY_UPDATE_REPEAT}, range raw 0x01..0x02
package /AUTOSAR/LdCom/ImplementationDataTypes_Blueprint
  impl type LdCom_ConfigType: category=STRUCTURE
package /AUTOSAR/Lin/ImplementationDataTypes_Blueprint
  impl type Lin_ConfigType: category=STRUCTURE
package /AUTOSAR/LinIf/ImplementationDataTypes_Blueprint
  4 x impl type:
    LinIf_ConfigType: category=STRUCTURE
    LinIf_SchHandleType: compu {1..255=range, 0x00=NULL_SCHEDULE}, range raw 0x00..1..255, implementation-data-type=uint8
    LinTp_ConfigType: category=STRUCTURE
    LinTp_Mode: compu {0=LINTP_APPLICATIVE_SCHEDULE, 1=LINTP_DIAG_REQUEST, 2=LINTP_DIAG_RESPONSE}, range raw 0..2
package /AUTOSAR/LinSM/ImplementationDataTypes_Blueprint
  impl type LinSM_ConfigType: category=STRUCTURE
  impl type LinSM_ModeType: compu {0x01=LINSM_FULL_COM, 0x02=LINSM_NO_COM}, range raw 0x01..0x02, implementation-data-type=uint8
package /AUTOSAR/LinTrcv/ImplementationDataTypes_Blueprint
  impl type LinTrcv_ConfigType: category=STRUCTURE
  impl type LinTrcv_TrcvModeType: compu {0=LINTRCV_TRCV_MODE_NORMAL, 1=LINTRCV_TRCV_MODE_STANDBY, 2=LINTRCV_TRCV_MODE_SLEEP}, range raw 0..2
package /AUTOSAR/Lin_GeneralTypes/ImplementationDataTypes_Blueprint
  9 x impl type:
    LinTrcv_TrcvWakeupModeType: compu {0=LINTRCV_WUMODE_ENABLE, 1=LINTRCV_WUMODE_DISABLE, 2=LINTRCV_WUMODE_CLEAR}, range raw 0..2
    LinTrcv_TrcvWakeupReasonType: compu {0=LINTRCV_WU_ERROR, 1=LINTRCV_WU_NOT_SUPPORTED, 2=LINTRCV_WU_BY_BUS, 3=LINTRCV_WU_BY_PIN, 4=LINTRCV_WU_INTERNALLY, 5=LINTRCV_WU_RESET, 6=LINTRCV_WU_POWER_ON}, range raw 0..6
    Lin_FrameCsModelType: compu {0=LIN_ENHANCED_CS, 1=LIN_CLASSIC_CS}, range raw 0..1
    Lin_FrameDlType: range raw undefined, implementation-data-type=uint8
    Lin_FramePidType: range raw undefined, implementation-data-type=uint8
    Lin_FrameResponseType: compu {0=LIN_FRAMERESPONSE_TX, 1=LIN_FRAMERESPONSE_RX, 2=LIN_FRAMERESPONSE_IGNORE}, range raw 0..2
    Lin_PduType: category=STRUCTURE
      5 x element:
        Pid: implementation-data-type=Lin_FramePidType
        Cs: implementation-data-type=Lin_FrameCsModelType
        Drc: implementation-data-type=Lin_FrameResponseType
        Dl: implementation-data-type=Lin_FrameDlType
        SduPtr: category=DATA_REFERENCE, sw-pointer-target-props={target-category=TYPE_REFERENCE, implementation-data-type=uint8}
    Lin_SlaveErrorType: compu {0=LIN_ERR_HEADER, 1=LIN_ERR_RESP_STOPBIT, 2=LIN_ERR_RESP_CHKSUM, 3=LIN_ERR_RESP_DATABIT, 4=LIN_ERR_NO_RESP, 5=LIN_ERR_INC_RESP}, range raw 0..5
    Lin_StatusType: compu {0=LIN_NOT_OK, 1=LIN_TX_OK, 2=LIN_TX_BUSY, 3=LIN_TX_HEADER_ERROR, 4=LIN_TX_ERROR, 5=LIN_RX_OK, 6=LIN_RX_BUSY, 7=LIN_RX_ERROR, 8=LIN_RX_NO_RESPONSE, 9=LIN_OPERATIONAL, 10=LIN_CH_SLEEP}, range raw 0..10
package /AUTOSAR/McOs/ImplementationDataTypes_Blueprint
  5 x impl type:
    AppModeType: compu {0=DONOTCARE}, range raw 0
    CoreIdType: range raw undefined
    SpinlockIdType: range raw undefined
    TotalNumberOfCores: compu {undefined=1..65535}, range raw undefined
    TryToGetSpinlockType: compu {0=TRYTOGETSPINLOCK_SUCCESS, 1=TRYTOGETSPINLOCK_NOSUCCESS}, range raw 0..1
package /AUTOSAR/Mcu/ImplementationDataTypes_Blueprint
  8 x impl type:
    Mcu_ClockType: range raw undefined
    Mcu_ConfigType: category=STRUCTURE
    Mcu_ModeType: range raw undefined
    Mcu_PllStatusType: compu {0=MCU_PLL_LOCKED, 1=MCU_PLL_UNLOCKED, 2=MCU_PLL_STATUS_UNDEFINED}, range raw 0..2
    Mcu_RamSectionType: range raw undefined
    Mcu_RamStateType: compu {0=MCU_RAMSTATE_INVALID, 1=MCU_RAMSTATE_VALID}, range raw 0..1
    Mcu_RawResetType: range raw undefined
    Mcu_ResetType: compu {0=MCU_POWER_ON_RESET, 1=MCU_WATCHDOG_RESET, 2=MCU_SW_RESET, 3=MCU_RESET_UNDEFINED}, range raw 0..3
package /AUTOSAR/MemIf/ImplementationDataTypes_Blueprint
  impl type MemIf_JobResultType: compu {0=MEMIF_JOB_OK, 1=MEMIF_JOB_FAILED, 2=MEMIF_JOB_PENDING, 3=MEMIF_JOB_CANCELED, 4=MEMIF_BLOCK_INCONSISTENT, 5=MEMIF_BLOCK_INVALID}, range raw 0..5
  impl type MemIf_ModeType: compu {0=MEMIF_MODE_SLOW, 1=MEMIF_MODE_FAST}, range raw 0..1
  impl type MemIf_StatusType: compu {0=MEMIF_UNINIT, 1=MEMIF_IDLE, 2=MEMIF_BUSY, 3=MEMIF_BUSY_INTERNAL}, range raw 0..3
package /AUTOSAR/Mfl/ImplementationDataTypes_Blueprint
  18 x impl type:
    InType
    OutType
    Mfl_DeadTimeParam_Type: category=STRUCTURE
      4 x element, all with category=TYPE_REFERENCE, implementation-data-type=float32:
        dsintStatic
        lszStatic
        dtbufBegStatic
        dtbufEndStatic
    Mfl_DebounceParam_Type: category=STRUCTURE
      element TimeHighLow: implementation-data-type=float32
      element TimeLowHigh: implementation-data-type=float32
    Mfl_DebounceState_Type: category=STRUCTURE
      element XOld: implementation-data-type=boolean
      element Timer: implementation-data-type=float32
    Mfl_Limits_Type: category=STRUCTURE
      element Min_C: implementation-data-type=float32
      element Max_C: implementation-data-type=float32
    Mfl_ParamPD_Type: category=STRUCTURE
      element K_C: implementation-data-type=float32
      element Tv_C: implementation-data-type=float32
    Mfl_ParamPID_Type: category=STRUCTURE
      element K_C: implementation-data-type=float32
      element Tv_C: implementation-data-type=float32
      element Tnrec_C: implementation-data-type=float32
    Mfl_ParamPI_Type: category=STRUCTURE
      element K_C: implementation-data-type=float32
      element Tnrec_C: implementation-data-type=float32
    Mfl_ParamRamp_Type: category=STRUCTURE
      element SlopePos_f32: implementation-data-type=float32
      element SlopeNeg_f32: implementation-data-type=float32
    Mfl_StateDT1Typ1_Type: category=STRUCTURE
      element X1: implementation-data-type=float32
      element X2: implementation-data-type=float32
      element Y1: implementation-data-type=float32
    Mfl_StateDT1Typ2_Type: category=STRUCTURE
      element X1: implementation-data-type=float32
      element Y1: implementation-data-type=float32
    Mfl_StateI_Type: category=STRUCTURE
      element X1: implementation-data-type=float32
      element Y1: implementation-data-type=float32
    Mfl_StatePD_Type: category=STRUCTURE
      element X1: implementation-data-type=float32
      element Y1: implementation-data-type=float32
    Mfl_StatePID_Type: category=STRUCTURE
      element X1: implementation-data-type=float32
      element X2: implementation-data-type=float32
      element Y1: implementation-data-type=float32
    Mfl_StatePI_Type: category=STRUCTURE
      element X1: implementation-data-type=float32
      element Y1: implementation-data-type=float32
    Mfl_StatePT1_Type: category=STRUCTURE
      element X1: implementation-data-type=float32
      element Y1: implementation-data-type=float32
    Mfl_StateRamp_Type: category=STRUCTURE
      element State_f32: implementation-data-type=float32
      element Dir_s8: implementation-data-type=sint8
      element Switch_s8: implementation-data-type=sint8
package /AUTOSAR/Mfx/ImplementationDataTypes_Blueprint
  6 x impl type:
    InType{1..3}
    InType
    OutType
    Type
package /AUTOSAR/Mirror/ImplementationDataTypes_Blueprint
  impl type Mirror_ConfigType: category=STRUCTURE
package /AUTOSAR/Nm/ImplementationDataTypes_Blueprint
  4 x impl type:
    Nm_BusNmType: compu {0=NM_BUSNM_CANNM, 1=NM_BUSNM_FRNM, 2=NM_BUSNM_UDPNM, 3=NM_BUSNM_GENERICNM, 4=NM_BUSNM_UNDEF, 5=NM_BUSNM_J1939NM, 6=NM_BUSNM_LOCALNM}, range raw 0..6
    Nm_ConfigType: category=STRUCTURE
    Nm_ModeType: compu {0=NM_MODE_BUS_SLEEP, 1=NM_MODE_PREPARE_BUS_SLEEP, 2=NM_MODE_SYNCHRONIZE, 3=NM_MODE_NETWORK}, range raw 0..3
    Nm_StateType: compu {0x00=NM_STATE_UNINIT, 0x01=NM_STATE_BUS_SLEEP, 0x02=NM_STATE_PREPARE_BUS_SLEEP, 0x03=NM_STATE_READY_SLEEP, 0x04=NM_STATE_NORMAL_OPERATION, 0x05=NM_STATE_REPEAT_MESSAGE, 0x06=NM_STATE_SYNCHRONIZE, 0x07=NM_STATE_OFFLINE}, range raw 0x00..0x07
package /AUTOSAR/NvM/ImplementationDataTypes_Blueprint
  impl type NvM_ConfigType: category=STRUCTURE
  impl type NvM_MultiBlockRequestType: compu {0x00=NVM_READ_ALL, 0x01=NVM_WRITE_ALL, 0x02=NVM_VALIDATE_ALL, 0x03=NVM_FIRST_INIT_ALL, 0x04=NVM_CANCEL_WRITE_ALL}, range raw 0x00..0x04
package /AUTOSAR/Ocu/ImplementationDataTypes_Blueprint
  6 x impl type:
    Ocu_ChannelType: range raw undefined
    Ocu_ConfigType: category=STRUCTURE
    Ocu_PinActionType: compu {0=OCU_SET_HIGH, 1=OCU_SET_LOW, 2=OCU_TOGGLE, 3=OCU_DISABLE}, range raw 0..3
    Ocu_PinStateType: compu {0=OCU_HIGH, 1=OCU_LOW}, range raw 0..1
    Ocu_ReturnType: compu {0=OCU_CM_IN_REF_INTERVAL, 1=OCU_CM_OUT_REF_INTERVAL}, range raw 0..1
    Ocu_ValueType: range raw undefined
package /AUTOSAR/Os/ImplementationDataTypes_Blueprint
  24 x impl type:
    AccessType: range raw undefined
    AlarmType: range raw undefined
    ApplicationStateRefType: range raw undefined
    ApplicationStateType: compu {undefined=APPLICATION_ACCESSIBLE, undefined=APPLICATION_RESTARTING, undefined=APPLICATION_TERMINATED}, range raw undefined
    ApplicationType: compu {undefined=INVALID_OSAPPLICATION}, range raw undefined, implementation-data-type=uint32
    AreaIdType: compu {undefined=0..65534}, range raw undefined
    ISRType: compu {undefined=INVALID_ISR}, range raw undefined
    IdleModeType: compu {undefined=IDLE_NO_HALT}, range raw undefined
    MemorySizeType: range raw undefined
    MemoryStartAddressType: range raw undefined
    ObjectAccessType: compu {undefined=ACCESS, undefined=NO_ACCESS}, range raw undefined
    ObjectTypeType: compu {undefined=OBJECT_TASK, undefined=OBJECT_ISR, undefined=OBJECT_ALARM, undefined=OBJECT_RESOURCE, undefined=OBJECT_COUNTER, undefined=OBJECT_SCHEDULETABLE}, range raw undefined
    PhysicalTimeType: range raw undefined
    ProtectionReturnType: compu {undefined=PRO_IGNORE, undefined=PRO_TERMINATETASKISR, undefined=PRO_TERMINATEAPPL, undefined=PRO_TERMINATEAPPL_RESTART, undefined=PRO_SHUTDOWN}, range raw undefined
    RestartType: compu {undefined=RESTART, undefined=NO_RESTART}, range raw undefined
    ScheduleTableStatusRefType: range raw undefined
    ScheduleTableStatusType: compu {undefined=SCHEDULETABLE_STOPPED, undefined=SCHEDULETABLE_NEXT, undefined=SCHEDULETABLE_WAITING, undefined=SCHEDULETABLE_RUNNING, undefined=SCHEDULETABLE_RUNNING_AND_SYNCHRONOUS}, range raw undefined
    ScheduleTableType: range raw undefined
    StatusType: compu {0x00=E_OK, 0x01=E_OS_ACCESS, 0x02=E_OS_CALLEVEL, 0x03=E_OS_ID, 0x04=E_OS_LIMIT, 0x05=E_OS_NOFUNC, 0x06=E_OS_RESOURCE, 0x07=E_OS_STATE, 0x08=E_OS_VALUE}, range raw 0x00..0x08
    TaskType: range raw undefined
    TickRefType: range raw undefined
    TickType: range raw undefined, implementation-data-type=uint32
    TrustedFunctionIndexType: range raw undefined
    TrustedFunctionParameterRefType: range raw undefined
package /AUTOSAR/PduR/ImplementationDataTypes_Blueprint
  4 x impl type:
    PduR_PBConfigIdType: range raw undefined, implementation-data-type=uint16
    PduR_PBConfigType: category=STRUCTURE
    PduR_RoutingPathGroupIdType: range raw undefined, implementation-data-type=uint16
    PduR_StateType: compu {0=PDUR_UNINIT, 1=PDUR_ONLINE}, range raw 0..1
package /AUTOSAR/Port/ImplementationDataTypes_Blueprint
  4 x impl type:
    Port_ConfigType: category=STRUCTURE
    Port_PinDirectionType: compu {0=PORT_PIN_IN, 1=PORT_PIN_OUT}, range raw 0..1
    Port_PinModeType: range raw undefined
    Port_PinType: range raw undefined
package /AUTOSAR/Pwm/ImplementationDataTypes_Blueprint
  8 x impl type:
    Pwm_ChannelClassType: compu {0=PWM_VARIABLE_PERIOD, 1=PWM_FIXED_PERIOD, 2=PWM_FIXED_PERIOD_SHIFTED}, range raw 0..2
    Pwm_ChannelType: range raw undefined
    Pwm_ConfigType: category=STRUCTURE
    Pwm_EdgeNotificationType: compu {0=PWM_RISING_EDGE, 1=PWM_FALLING_EDGE, 2=PWM_BOTH_EDGES}, range raw 0..2
    Pwm_OutputStateType: compu {0=PWM_HIGH, 1=PWM_LOW}, range raw 0..1
    Pwm_PeriodType: range raw undefined
    Pwm_PowerStateRequestResultType: compu {0x00=PWM_SERVICE_ACCEPTED, 0x01=PWM_NOT_INIT, 0x02=PWM_SEQUENCE_ERROR, 0x03=PWM_HW_FAILURE, 0x04=PWM_POWER_STATE_NOT_SUPP, 0x05=PWM_TRANS_NOT_POSSIBLE}, range raw 0x00..0x05
    Pwm_PowerStateType: compu {0x00=PWM_FULL_POWER, 1=1..255}, range raw 0x00..1
package /AUTOSAR/RamTst/ImplementationDataTypes_Blueprint
  7 x impl type:
    RamTst_AlgParamsIdType: range raw undefined, implementation-data-type=uint8
    RamTst_AlgorithmType: compu {0x00=RAMTST_ALGORITHM_UNDEFINED, 0x01=RAMTST_CHECKERBOARD_TEST, 0x02=RAMTST_MARCH_TEST, 0x03=RAMTST_WALK_PATH_TEST, 0x04=RAMTST_GALPAT_TEST, 0x05=RAMTST_TRANSP_GALPAT_TEST, 0x06=RAMTST_ABRAHAM_TEST}, range raw 0x00..0x06
    RamTst_ConfigType: category=STRUCTURE
    RamTst_ExecutionStatusType: compu {0x00=RAMTST_EXECUTION_UNINIT, 0x01=RAMTST_EXECUTION_STOPPED, 0x02=RAMTST_EXECUTION_RUNNING, 0x03=RAMTST_EXECUTION_SUSPENDED}, range raw 0x00..0x03
    RamTst_NumberOfBlocksType: range raw undefined, implementation-data-type=uint16
    RamTst_NumberOfTestedCellsType: range raw undefined, implementation-data-type=uint32
    RamTst_TestResultType: compu {0x00=RAMTST_RESULT_NOT_TESTED, 0x01=RAMTST_RESULT_OK, 0x02=RAMTST_RESULT_NOT_OK, 0x03=RAMTST_RESULT_UNDEFINED}, range raw 0x00..0x03
package /AUTOSAR/Rte/ImplementationDataTypes_Blueprint
  7 x impl type:
    return
    rips_return_ref
    Rte_Cs_TransactionHandleType: category=STRUCTURE
      element clientId: implementation-data-type=uint16
      element sequenceCounter: implementation-data-type=uint16
    Rte_DsmqStatusType: compu {0x04=RTE_DSMQ_DEQUEUED_LAST, 0x05=RTE_DSMQ_DEQUEUED_NOT_LAST, 0x03=RTE_DSMQ_ENQUEUE_FAILED, 0x01=RTE_DSMQ_ENQUEUED_FIRST, 0x02=RTE_DSMQ_ENQUEUED_NOT_FIRST}, range raw 0x01..0x05, implementation-data-type=uint8
    Rte_Instance: range raw undefined, implementation-data-type=implementation_specific
    Rte_ModeType_M
    Rte_ModeType_EcuM_Mode: range raw undefined, implementation-data-type=implementation_specific
package /AUTOSAR/SchM/ImplementationDataTypes_Blueprint
  impl type SchM_ConfigType: category=STRUCTURE
  impl type SchM_ReturnType: compu {0x00=SCHM_E_OK, 0x04=SCHM_E_LIMIT, 0x05=SCHM_E_NOFUNC, 0x07=SCHM_E_STATE}, range raw 0x00..0x07, implementation-data-type=uint8
package /AUTOSAR/Sd/ImplementationDataTypes_Blueprint
  8 x impl type:
    Sd_ClientServiceCurrentStateType: compu {0x00=SD_CLIENT_SERVICE_DOWN, 0x01=SD_CLIENT_SERVICE_AVAILABLE}, range raw 0x00..0x01
    Sd_ClientServiceSetStateType: compu {0x00=SD_CLIENT_SERVICE_RELEASED, 0x01=SD_CLIENT_SERVICE_REQUESTED}, range raw 0x00..0x01
    Sd_ConfigOptionStringType: category=DATA_REFERENCE, sw-pointer-target-props={target-category=TYPE_REFERENCE, implementation-data-type=uint8, sw-impl-policy=CONST}
    Sd_ConfigType: category=STRUCTURE
    Sd_ConsumedEventGroupCurrentStateType: compu {0x00=SD_CONSUMED_EVENTGROUP_DOWN, 0x01=SD_CONSUMED_EVENTGROUP_AVAILABLE}, range raw 0x00..0x01
    Sd_ConsumedEventGroupSetStateType: compu {0x00=SD_CONSUMED_EVENTGROUP_RELEASED, 0x01=SD_CONSUMED_EVENTGROUP_REQUESTED}, range raw 0x00..0x01
    Sd_EventHandlerCurrentStateType: compu {0x00=SD_EVENT_HANDLER_RELEASED, 0x01=SD_EVENT_HANDLER_REQUESTED}, range raw 0x00..0x01
    Sd_ServerServiceSetStateType: compu {0x00=SD_SERVER_SERVICE_DOWN, 0x01=SD_SERVER_SERVICE_AVAILABLE}, range raw 0x00..0x01
package /AUTOSAR/SecOC/ImplementationDataTypes_Blueprint
  impl type SecOC_ConfigType: category=STRUCTURE
  impl type SecOC_StateType: compu {0=SECOC_UNINIT, 1=SECOC_INIT}, range raw 0..1
package /AUTOSAR/SoAd/ImplementationDataTypes_Blueprint
  5 x impl type:
    SoAd_ConfigType: category=STRUCTURE
    SoAd_MeasurementIdxType: compu {0x01=SOAD_MEAS_DROP_TCP, 0x02=SOAD_MEAS_DROP_UDP, 0x03-0x7F=SOAD_MEAS_RESERVED_1, 0x80-0xEF=SOAD_MEAS_RESERVED_2, 0xF0-0xFE=SOAD_MEAS_RESERVED_3, 0xFF=SOAD_MEAS_ALL}, range raw 0x01..0xFF, implementation-data-type=uint8
    SoAd_RoutingGroupIdType: range raw 0..<SoAdRoutingGroupMax>, implementation-data-type=uint16, range raw 0..<SoAdRoutingGroupMax>, implementation-data-type=uint8
    SoAd_SoConIdType: range raw 0..<SoAdSoConMax>, implementation-data-type=uint8, range raw 0..<SoAdSoConMax>, implementation-data-type=uint16
    SoAd_SoConModeType: compu {0=SOAD_SOCON_ONLINE, 1=SOAD_SOCON_RECONNECT, 2=SOAD_SOCON_OFFLINE}, range raw 0..2
package /AUTOSAR/SomeIpTp/ImplementationDataTypes_Blueprint
  impl type SomeIpTp_ConfigType: category=STRUCTURE
package /AUTOSAR/SomeIpXf/ImplementationDataTypes_Blueprint
  impl type paramtype
  impl type type
  impl type SomeIpXf_ConfigType: category=STRUCTURE
package /AUTOSAR/Spi/ImplementationDataTypes_Blueprint
  11 x impl type:
    Spi_AsyncModeType: compu {0=SPI_POLLING_MODE, 1=SPI_INTERRUPT_MODE}, range raw 0..1
    Spi_ChannelType: range raw undefined, implementation-data-type=uint8
    Spi_ConfigType: category=STRUCTURE
    Spi_DataBufferType: range raw undefined, implementation-data-type=uint8
    Spi_HWUnitType: range raw undefined, implementation-data-type=uint8
    Spi_JobResultType: compu {0=SPI_JOB_OK, 1=SPI_JOB_PENDING, 2=SPI_JOB_FAILED, 3=SPI_JOB_QUEUED}, range raw 0..3
    Spi_JobType: range raw undefined, implementation-data-type=uint16
    Spi_NumberOfDataType: range raw undefined, implementation-data-type=uint16
    Spi_SeqResultType: compu {0=SPI_SEQ_OK, 1=SPI_SEQ_PENDING, 2=SPI_SEQ_FAILED, 3=SPI_SEQ_CANCELED}, range raw 0..3
    Spi_SequenceType: range raw undefined, implementation-data-type=uint8
    Spi_StatusType: compu {0x00=SPI_UNINIT, 0x01=SPI_IDLE, 0x02=SPI_BUSY}, range raw 0x00..0x02
package /AUTOSAR/StbM/ImplementationDataTypes_Blueprint
  4 x impl type:
    StbM_ConfigType: category=STRUCTURE
    StbM_MeasurementType: category=STRUCTURE
      element pathDelay: implementation-data-type=uint32
    StbM_TimeStampRawType: range raw undefined, implementation-data-type=uint32
    StbM_VirtualLocalTimeType: category=STRUCTURE
      element nanosecondsLo: implementation-data-type=uint32
      element nanosecondsHi: implementation-data-type=uint32
package /AUTOSAR/TcpIp/ImplementationDataTypes_Blueprint
  22 x impl type:
    TcpIpIp6AddrWildcardType: compu {implementation specific=TCPIP_IP6ADDR_ANY}, range raw implementation specific, implementation-data-type=uint32
    TcpIpIpAddrWildcardType: compu {implementation specific=TCPIP_IPADDR_ANY}, range raw implementation specific, implementation-data-type=uint32
    TcpIpLocalAddrIdWildcardType: compu {implementation specific=TCPIP_LOCALADDRID_ANY}, range raw implementation specific, implementation-data-type=TcpIp_LocalAddrIdType
    TcpIpPortWildcardType: compu {implementation specific=TCPIP_PORT_ANY}, range raw implementation specific, implementation-data-type=uint16
    TcpIp_ArpCacheEntryType: category=STRUCTURE
      element InetAddr: category=ARRAY, array-size-semantics=FIXED-SIZE
        element InetAddr: array-size=undefined, array-size-semantics=FIXED-SIZE, implementation-data-type=uint32
      element PhysAddr: category=ARRAY, array-size-semantics=FIXED-SIZE
        element PhysAddr: array-size=undefined, array-size-semantics=FIXED-SIZE, implementation-data-type=uint8
      element State: implementation-data-type=uint8
    TcpIp_ConfigType: category=STRUCTURE
    TcpIp_DomainType: compu {0x02=TCPIP_AF_INET, 0x1c=TCPIP_AF_INET6}, range raw 0x02..0x1c, implementation-data-type=uint16
    TcpIp_EventType: compu {0x01=TCPIP_TCP_RESET, 0x02=TCPIP_TCP_CLOSED, 0x03=TCPIP_TCP_FIN_RECEIVED, 0x04=TCPIP_UDP_CLOSED, 0x05=TCPIP_TLS_HANDSHAKE_SUCCEEDED}, range raw 0x01..0x05
    TcpIp_IpAddrAssignmentType: compu {0=TCPIP_IPADDR_ASSIGNMENT_STATIC, 1=TCPIP_IPADDR_ASSIGNMENT_LINKLOCAL_DOIP, 2=TCPIP_IPADDR_ASSIGNMENT_DHCP, 3=TCPIP_IPADDR_ASSIGNMENT_LINKLOCAL, 4=TCPIP_IPADDR_ASSIGNMENT_IPV6_ROUTER, 5=TCPIP_IPADDR_ASSIGNMENT_ALL}, range raw 0..5
    TcpIp_IpAddrStateType: compu {0=TCPIP_IPADDR_STATE_ASSIGNED, 1=TCPIP_IPADDR_STATE_ONHOLD, 2=TCPIP_IPADDR_STATE_UNASSIGNED}, range raw 0..2
    TcpIp_LocalAddrIdType: range raw undefined, implementation-data-type=uint8
    TcpIp_MeasurementIdxType: compu {0x01=TCPIP_MEAS_DROP_TCP, 0x02=TCPIP_MEAS_DROP_UDP, 0x03=TCPIP_MEAS_DROP_IPV4, 0x04=TCPIP_MEAS_DROP_IPV6, 0x05-0x7F=TCPIP_MEAS_RESERVED_1, 0x80-0xEF=TCPIP_MEAS_RESERVED_2, 0xF0-0xFE=TCPIP_MEAS_RESERVED_3, 0xFF=TCPIP_MEAS_ALL}, range raw 0x01..0xFF, implementation-data-type=uint8
    TcpIp_NdpCacheEntryType: category=STRUCTURE
      element Inet6Addr: category=ARRAY, array-size-semantics=FIXED-SIZE
        element Inet6Addr: array-size=undefined, array-size-semantics=FIXED-SIZE, implementation-data-type=uint32
      element PhysAddr: category=ARRAY, array-size-semantics=FIXED-SIZE
        element PhysAddr: array-size=undefined, array-size-semantics=FIXED-SIZE, implementation-data-type=uint8
      element State: implementation-data-type=uint8
    TcpIp_ParamIdType:
      compu {0x00=TCPIP_PARAMID_TCP_RXWND_MAX, 0x01=TCPIP_PARAMID_FRAMEPRIO, 0x02=TCPIP_PARAMID_TCP_NAGLE, 0x03=TCPIP_PARAMID_TCP_KEEPALIVE, 0x04=TCPIP_PARAMID_TTL, 0x05=TCPIP_PARAMID_TCP_KEEPALIVE_TIME, 0x06=TCPIP_PARAMID_TCP_KEEPALIVE_PROBES_MAX, 0x07=TCPIP_PARAMID_TCP_KEEPALIVE_INTERVAL, 0x08=TCPIP_PARAMID_TCP_OPTIONFILTER, 0x09=TCPIP_PARAMID_PATHMTU_ENABLE, 0x0a=TCPIP_PARAMID_FLOWLABEL, 0x0b=TCPIP_PARAMID_DSCP, 0x0c=TCPIP_PARAMID_UDP_CHECKSUM, 0x80=TCPIP_PARAMID_VENDOR_SPECIFIC, 0x0d=TCPIP_PARAMID_TLS_CONNECTION_ASSIGNMENT}
      range raw 0x00..0x80
      implementation-data-type=uint8
    TcpIp_ProtocolType: compu {0x06=TCPIP_IPPROTO_TCP, 0x11=TCPIP_IPPROTO_UDP}, range raw 0x06..0x11
    TcpIp_ReturnType: compu {0=TCPIP_E_OK, 1=TCPIP_E_NOT_OK, 2=TCPIP_E_PHYS_ADDR_MISS}, range raw 0..2
    TcpIp_SockAddrInet6Type: category=STRUCTURE
      element domain: implementation-data-type=TcpIp_DomainType
      element port: implementation-data-type=uint16
      element addr: category=ARRAY, array-size-semantics=FIXED-SIZE
        element addr: array-size=undefined, array-size-semantics=FIXED-SIZE, implementation-data-type=uint32
    TcpIp_SockAddrInetType: category=STRUCTURE
      element domain: implementation-data-type=TcpIp_DomainType
      element port: implementation-data-type=uint16
      element addr: category=ARRAY, array-size-semantics=FIXED-SIZE
        element addr: array-size=undefined, array-size-semantics=FIXED-SIZE, implementation-data-type=uint32
    TcpIp_SockAddrType: category=STRUCTURE
      element domain: implementation-data-type=TcpIp_DomainType
    TcpIp_SocketIdType: range raw undefined, implementation-data-type=uint16, range raw undefined, implementation-data-type=uint8
    TcpIp_StateType: compu {0=TCPIP_STATE_ONLINE, 1=TCPIP_STATE_ONHOLD, 2=TCPIP_STATE_OFFLINE, 3=TCPIP_STATE_STARTUP, 4=TCPIP_STATE_SHUTDOWN}, range raw 0..4
    TcpIp_TlsConnectionIdType: range raw undefined, implementation-data-type=uint8, range raw undefined, implementation-data-type=uint16
package /AUTOSAR/Tm/ImplementationDataTypes_Blueprint
  4 x impl type, all with category=STRUCTURE:
    Tm_PredefTimer100us32bitType
    Tm_PredefTimer1us16bitType
    Tm_PredefTimer1us24bitType
    Tm_PredefTimer1us32bitType
package /AUTOSAR/UdpNm/ImplementationDataTypes_Blueprint
  impl type UdpNm_ConfigType: category=STRUCTURE
  impl type UdpNm_PduPositionType: compu {0x00=UDPNM_PDU_BYTE_0, 0x01=UDPNM_PDU_BYTE_1, 0xFF=UDPNM_PDU_OFF}, range raw 0x00..0xFF
package /AUTOSAR/V2xBtp/ImplementationDataTypes_Blueprint
  impl type V2xBtp_RxParamsType: category=STRUCTURE
    13 x element:
      upperProtocol: implementation-data-type=V2x_GnUpperProtocolType
      packetTransportType: implementation-data-type=V2x_GnPacketTransportType
      destinationAddress: implementation-data-type=V2x_GnAddressType
      destinationArea: implementation-data-type=V2x_GnDestinationAreaType
      destinationType: implementation-data-type=V2x_GnDestinationType
      sourcePositionVector: implementation-data-type=V2x_GnLongPositionVectorType
      securityReport: implementation-data-type=V2xM_SecReportType
      certificateId: implementation-data-type=uint64
      SspBits: category=ARRAY, array-size-semantics=FIXED-SIZE
        element SspBits: array-size=undefined, array-size-semantics=FIXED-SIZE, implementation-data-type=uint8
      SspLength: implementation-data-type=uint8
      trafficClass: implementation-data-type=V2x_TrafficClassIdType
      remPacketLifetime: implementation-data-type=uint16
      remHopLimit: implementation-data-type=uint8
  impl type V2xBtp_TxParamsType: category=STRUCTURE
    9 x element, all with category=TYPE_REFERENCE:
      upperProtocol: implementation-data-type=V2x_GnUpperProtocolType
      destinationPort: implementation-data-type=uint16
      transportType: implementation-data-type=V2x_GnPacketTransportType
      destinationAddress: implementation-data-type=V2x_GnAddressType
      destinationArea: implementation-data-type=V2x_GnDestinationAreaType
      destinationType: implementation-data-type=V2x_GnDestinationType
      secProfile: implementation-data-type=V2x_SecProfileType
      maxPacketLifetime: implementation-data-type=uint16
      trafficClassId: implementation-data-type=V2x_TrafficClassIdType
package /AUTOSAR/V2xFac/ImplementationDataTypes_Blueprint
  impl type V2xFac_RxParamsType: category=STRUCTURE
    11 x element:
      destinationPort: implementation-data-type=uint16
      destinationAddress: implementation-data-type=V2x_GnAddressType
      destinationArea: implementation-data-type=V2x_GnDestinationAreaType
      destinationType: implementation-data-type=V2x_GnDestinationType
      sourcePositionVector: implementation-data-type=V2x_GnLongPositionVectorType
      securityReport: implementation-data-type=V2xM_SecReportType
      certificateId: implementation-data-type=uint64
      SspBits: category=ARRAY, array-size-semantics=FIXED-SIZE
        element SspBits: array-size=undefined, array-size-semantics=FIXED-SIZE, implementation-data-type=uint8
      SspLength: implementation-data-type=uint8
      trafficClass: implementation-data-type=V2x_TrafficClassIdType
      remPacketLifetime: implementation-data-type=uint16
package /AUTOSAR/V2xGn/ImplementationDataTypes_Blueprint
  impl type V2xGn_StateType: compu {0x00=V2XGN_STATE_UNINIT, 0x01=V2XGN_STATE_INIT}, range raw 0x00..0x01
  impl type V2xGn_TxParamsType: category=STRUCTURE
    8 x element, all with category=TYPE_REFERENCE:
      upperProtocol: implementation-data-type=V2x_GnUpperProtocolType
      transportType: implementation-data-type=V2x_GnPacketTransportType
      destinationAddress: implementation-data-type=V2x_GnAddressType
      destinationArea: implementation-data-type=V2x_GnDestinationAreaType
      destinationType: implementation-data-type=V2x_GnDestinationType
      secProfile: implementation-data-type=V2x_SecProfileType
      maxPacketLifetime: implementation-data-type=uint16
      trafficClassId: implementation-data-type=V2x_TrafficClassIdType
package /AUTOSAR/V2xM/ImplementationDataTypes_Blueprint
  impl type V2xM_ConfigType: category=STRUCTURE
package /AUTOSAR/V2x_GeneralTypes/ImplementationDataTypes_Blueprint
  15 x impl type:
    V2x_ChanType: compu {180=V2X_CCH, 176=V2X_SCH1, 178=V2X_SCH2, 174=V2X_SCH3, 172=V2X_SCH4}, range raw 172..180
    V2x_GnAddressType: range raw undefined, implementation-data-type=uint64
    V2x_GnAreaShapeType: compu {0x00=V2X_GN_SHAPE_CIRCLE, 0x01=V2X_GN_SHAPE_RECT, 0x02=V2X_GN_SHAPE_ELLIPSE}, range raw 0x00..0x02
    V2x_GnDestinationAreaType: category=STRUCTURE
      6 x element, all with category=TYPE_REFERENCE:
        latitude: implementation-data-type=sint32
        longitude: implementation-data-type=sint32
        distanceA: implementation-data-type=uint16
        distanceB: implementation-data-type=uint16
        angle: implementation-data-type=uint16
        shape: implementation-data-type=V2x_GnAreaShapeType
    V2x_GnDestinationType: compu {0x00=V2X_GN_DESTINATION_ADDRESS, 0x01=V2X_GN_DESTINATION_AREA}, range raw 0x00..0x01
    V2x_GnLongPositionVectorType: category=STRUCTURE
      7 x element, all with category=TYPE_REFERENCE:
        gnAddress: implementation-data-type=V2x_GnAddressType
        timestamp: implementation-data-type=uint32
        latitude: implementation-data-type=sint32
        longitude: implementation-data-type=sint32
        pai: implementation-data-type=boolean
        speed: implementation-data-type=sint16
        heading: implementation-data-type=uint16
    V2x_GnPacketTransportType: compu {0x00=V2X_GN_GEOUNICAST, 0x01=V2X_GN_GEOANYCAST, 0x02=V2X_GN_GEOBROADCAST, 0x03=V2X_GN_TSB, 0x04=V2X_GN_SHB}, range raw 0x00..0x04
    V2x_GnTxResultType: compu {0=V2X_GNTX_ACCEPTED, 1=V2X_GNTX_E_MAXSDUSIZEOVFL, 2=V2X_GNTX_E_MAXPACKETLIFETIME, 3=V2X_GNTX_E_TCID, 4=V2X_GNTX_E_MAXGEOAREASIZE, 5=V2X_GNTX_E_UNSPECIFIED}, range raw 0..5
    V2x_GnUpperProtocolType: compu {0=V2X_ANY, 1=V2X_BTPA, 2=V2X_BTPB, 3=V2X_IPV6}, range raw 0..3
    V2x_MaximumPacketLifetimeType: range raw undefined, implementation-data-type=uint16
    V2x_PseudonymType: range raw undefined, implementation-data-type=uint64
    V2x_SecProfileType: compu {0=V2X_SECPROF_CAM, 1=V2X_SECPROF_DENM, 2=V2X_SECPROF_OTHER_SIGNED, 3=V2X_SECPROF_OTHER_SIGNED_EXTERNAL, 4=V2X_SECPROF_OTHER_SIGNED_ENCRYPTED}, range raw 0..4
    V2x_SecReportType:
      compu {0x00=V2X_SECREP_SUCCESS, 0x01=V2X_SECREP_FALSE_SIGNATURE, 0x02=V2X_SECREP_INVALID_CERTIFICATE, 0x03=V2X_SECREP_REVOKED_CERTIFICATE, 0x04=V2X_SECREP_INCONSISTENT_CHAIN, 0x05=V2X_SECREP_INVALID_TIMESTAMP, 0x06=V2X_SECREP_DUPLICATE_MESSAGE, 0x07=V2X_SECREP_INVALID_MOBILITY_DATA, 0x08=V2X_SECREP_UNSIGNED_MESSAGE, 0x09=V2X_SECREP_SIGNER_CERTIFICATE_NOT_FOUND, 0x0a=V2X_SECREP_UNSUPPORTED_SIGNER_IDENTIFIER_TYPE, 0x0b=V2X_SECREP_INCOMPATIBLE_PROTOCOL, 0x0c=V2X_SECREP_UNENCRYPTED_MESSAGE, 0x0d=V2X_SECREP_DECRYPTION_ERROR, 0xff=V2X_SECREP_NONE}
      range raw 0x00..0xff
      implementation-data-type=uint8
    V2x_SecReturnType: compu {0=V2X_E_OK, 1=V2X_E_NOT_OK, 2=V2X_E_UNVERIFIED, 3=V2X_E_BUF_OVFL}, range raw 0..3
    V2x_TrafficClassIdType: range raw undefined, implementation-data-type=uint8
package /AUTOSAR/WEth/ImplementationDataTypes_Blueprint
  impl type WEth_ConfigType: category=STRUCTURE
package /AUTOSAR/WEthTrcv/ImplementationDataTypes_Blueprint
  impl type WEthTrcv_ConfigType: category=STRUCTURE
package /AUTOSAR/WEth_GeneralTypes/ImplementationDataTypes_Blueprint
  10 x impl type:
    WEthTrcv_BandwidthType: compu {0x00=WETHTRCV_BW_5MHz, 0x01=WETHTRCV_BW_10MHz, 0x02=WETHTRCV_BW_20MHz, 0x03=WETHTRCV_BW_40MHz}, range raw undefined, implementation-data-type=uint32
    WEthTrcv_GetChanRxParamIdType: compu {0x00=WETHTRCV_GETCHRXPID_CBR, 0x01=WETHTRCV_GETCHRXPID_CIT}, range raw 0x00..0x01
    WEthTrcv_RadioModeType: compu {0x00=WETHTRCV_MODE_OFF, 0x01=WETHTRCV_MODE_RX, 0x02=WETHTRCV_MODE_TX, 0x03=WETHTRCV_MODE_RX_TX, 0x04=WETHTRCV_MODE_SWITCHED}, range raw undefined, implementation-data-type=uint32
    WEthTrcv_RssiType: compu {undefined=0..399, undefined=400..65535}, range raw undefined, implementation-data-type=uint16
    WEthTrcv_SetChanRxParamIdType: compu {0x00=WETHTRCV_SETCHRXPID_BITRATE, 0x01=WETHTRCV_SETCHRXPID_BANDWIDTH, 0x02=WETHTRCV_SETCHRXPID_FREQ, 0x03=WETHTRCV_SETCHRXPID_CSPWRTRESH, 0x04=WETHTRCV_SETCHRXPID_RADIO_MODE, 0x05=WETHTRCV_SETCHRXPID_ANTENNA}, range raw 0x00..0x05
    WEthTrcv_SetChanTxParamIdType: compu {0x00=WETHTRCV_SETCHTXPID_BITRATE, 0x01=WETHTRCV_SETCHTXPID_BANDWIDTH, 0x02=WETHTRCV_SETCHTXPID_TXPOWER, 0x03=WETHTRCV_SETCHTXPID_DCC_CBR, 0x04=WETHTRCV_SETCHTXPID_TXQSEL, 0x05=WETHTRCV_SETCHTXPID_TXQCFG_AIFSN, 0x06=WETHTRCV_SETCHTXPID_TXQCFG_CWMIN, 0x07=WETHTRCV_SETCHTXPID_TXQCFG_CWMAX, 0x08=WETHTRCV_SETCHTXPID_TXQCFG_TXOP, 0x09=WETHTRCV_SETCHTXPID_RADIO_MODE, 0x0A=WETHTRCV_SETCHTXPID_ANTENNA, 0x0C=WETHTRCV_SETCHTXPID_PACKET_INTERVAL, 0x0D=WETHTRCV_SETCHTXPID_DCC_STATE}, range raw 0x00..0x0D
    WEthTrcv_SetRadioParamIdType: compu {0x01=WETHTRCV_SETRADIOPID_SEL_TRCV_CHCFG, 0x02=WETHTRCV_SETRADIOPID_SET_CHCFGID, 0x03=WETHTRCV_SETRADIOPID_TOLLINGZONE_INFO}, range raw 0x01..0x03
    WEthTrcv_TxPwrLvlType: range raw undefined, implementation-data-type=uint16
    WEth_BufWRxParamIdType: compu {0x00=WETH_BUFWRXPID_RSSI, 0x01=WETH_BUFWRXPID_CHANNEL_ID, 0x02=WETH_BUFWRXPID_FREQ, 0x03=WETH_BUFWRXPID_TRANSACTION_ID_32, 0x04=WETH_BUFWRXPID_ANTENNA_ID}, range raw 0x00..0x04
    WEth_BufWTxParamIdType: compu {0x00=WETH_BUFWTXPID_POWER, 0x01=WETH_BUFWTXPID_CHANNEL_ID, 0x02=WETH_BUFWTXPID_QUEUE_ID, 0x03=WETH_BUFWTXPID_TRANSACTION_ID_16, 0x04=WETH_BUFWTXPID_ANTENNA_ID}, range raw 0x00..0x04
package /AUTOSAR/Wdg/ImplementationDataTypes_Blueprint
  impl type Wdg_ConfigType: category=STRUCTURE
package /AUTOSAR/WdgIf/ImplementationDataTypes_Blueprint
  impl type WdgIf_ModeType: compu {0=WDGIF_OFF_MODE, 1=WDGIF_SLOW_MODE, 2=WDGIF_FAST_MODE}, range raw 0..2
package /AUTOSAR/WdgM/ImplementationDataTypes_Blueprint
  impl type WdgM_ConfigType: category=STRUCTURE
package /AUTOSAR/Xcp/ImplementationDataTypes_Blueprint
  impl type Xcp_ConfigType: category=STRUCTURE
  impl type Xcp_TransmissionModeType: compu {0x00=XCP_TX_OFF, 0x01=XCP_TX_ON}, range raw 0x00..0x01
package /AUTOSAR/Xfrm/ImplementationDataTypes_Blueprint
  impl type Mip_ConfigType: category=STRUCTURE
  impl type paramtype
  impl type type
