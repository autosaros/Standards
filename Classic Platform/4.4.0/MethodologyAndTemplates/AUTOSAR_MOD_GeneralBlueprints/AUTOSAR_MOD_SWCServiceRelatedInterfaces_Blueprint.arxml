AUTOSAR XML (schema 00046)
package /AUTOSAR/NvBlockSoftwareComponentType/ClientServerInterfaces_Blueprint
  4 x client server interface:
    NvMAdmin
      operation SetBlockProtection: possible-error=[NvMAdmin/E_OK, NvMAdmin/E_NOT_OK], variation-point=blueprint-condition=p=l-1={ecuc(NvM/NvMCommon/NvMApiConfigClass)} == NVM_API_CONFIG_CLASS_3  # Service for setting/resetting the write protection for a NV block.
        arg ProtectionEnabled: type=boolean, direction=IN
      error E_OK: error-code=0  # Operation successful
      error E_NOT_OK: error-code=1  # Operation failed
    NvMNotifyInitBlock  # Callback that is called by the NvM module when default data needs to be restored to the RAM image
      operation InitBlock: possible-error=NvMNotifyInitBlock/E_OK  # This callback is called if the initialization of a block has completed.
        arg InitBlockRequest: type=NvM_InitBlockRequestType, direction=IN  # --
      error E_OK: error-code=0  # Operation successful
    NvMNotifyJobFinished  # Callback that is called when a job has finished
      operation JobFinished: possible-error=NvMNotifyJobFinished/E_OK  # Callback that gets called if a job has finished
        arg BlockRequest: type=NvM_BlockRequestType, direction=IN
        arg JobResult: type=NvM_RequestResultType, direction=IN
      error E_OK: error-code=0  # Operation successful
    NvMService
      12 x operation, all with possible-error=[NvMService/E_OK, NvMService/E_NOT_OK]:
        EraseBlock: variation-point=blueprint-condition=p=l-1={ecuc(NvM/NvMCommon/NvMApiConfigClass)} == NVM_API_CONFIG_CLASS_3  # Service to erase a NV block.
        GetDataIndex: variation-point=blueprint-condition=p=l-1=(({ecuc(NvM/NvMCommon/NvMApiConfigClass)} == NVM_API_CONFIG_CLASS_2) || ({ecuc(NvM/NvMCommon/NvMApiConfigClass)} == NVM_API_CONFIG_CLASS_3)) && (count({ecuc(NvM/NvMBlockDescriptor/NvMBlockManagementType)} == NVM_BLOCK_DATASET) > 0)  # Service for getting the currently set DataIndex of a dataset NVRAM block
          arg DataIndexPtr: type=uint8, direction=OUT
        GetErrorStatus  # Service to read the block dependent error/status information.
          arg RequestResultPtr: type=NvM_RequestResultType, direction=OUT
        InvalidateNvBlock: variation-point=blueprint-condition=p=l-1={ecuc(NvM/NvMCommon/NvMApiConfigClass)} == NVM_API_CONFIG_CLASS_3  # Service to invalidate a NV block.
        ReadBlock: variation-point=blueprint-condition=p=l-1=({ecuc(NvM/NvMCommon/NvMApiConfigClass)} == NVM_API_CONFIG_CLASS_2 || {ecuc(NvM/NvMCommon/NvMApiConfigClass)} == NVM_API_CONFIG_CLASS_3)  # Service to copy the data of the NV block to its corresponding RAM block.
          arg DstPtr: type=VoidPtr, direction=IN  # The parameter "DstPtr" shall be typed by an ImplementationDataType of category DATA_REFERENCE with the pointer target void to pass an address (pointer) to the RAM Block.
        ReadPRAMBlock: variation-point=blueprint-condition=p=l-1=({ecuc(NvM/NvMCommon/NvMApiConfigClass)} == NVM_API_CONFIG_CLASS_2 || {ecuc(NvM/NvMCommon/NvMApiConfigClass)} == NVM_API_CONFIG_CLASS_3)
        RestoreBlockDefaults: variation-point=blueprint-condition=p=l-1=({ecuc(NvM/NvMCommon/NvMApiConfigClass)} == NVM_API_CONFIG_CLASS_2 || {ecuc(NvM/NvMCommon/NvMApiConfigClass)} == NVM_API_CONFIG_CLASS_3)  # Service to restore the default data to its corresponding RAM block.
          arg DstPtr: type=VoidPtr, direction=IN  # The parameter "DstPtr" shall be typed by an ImplementationDataType of category DATA_REFERENCE with the pointer target void to pass an address (pointer) to the RAM Block.
        RestorePRAMBlockDefaults: variation-point=blueprint-condition=p=l-1=({ecuc(NvM/NvMCommon/NvMApiConfigClass)} == NVM_API_CONFIG_CLASS_2 || {ecuc(NvM/NvMCommon/NvMApiConfigClass)} == NVM_API_CONFIG_CLASS_3)
        SetDataIndex: variation-point=blueprint-condition=p=l-1=(({ecuc(NvM/NvMCommon/NvMApiConfigClass)} == NVM_API_CONFIG_CLASS_2) || ({ecuc(NvM/NvMCommon/NvMApiConfigClass)} == NVM_API_CONFIG_CLASS_3)) && (count({ecuc(NvM/NvMBlockDescriptor/NvMBlockManagementType)} == NVM_BLOCK_DATASET) > 0)  # Service for setting the DataIndex of a dataset NVRAM block.
          arg DataIndex: type=uint8, direction=IN
        SetRamBlockStatus: variation-point=blueprint-condition=p=l-1={ecuc(NvM/NvMBlockDescriptor/NvMBlockUseSetRamBlockStatus)} == true  # Service for setting the RAM block status of an NVRAM block.
          arg BlockChanged: type=boolean, direction=IN
        WriteBlock: variation-point=blueprint-condition=p=l-1=({ecuc(NvM/NvMCommon/NvMApiConfigClass)} == NVM_API_CONFIG_CLASS_2 || {ecuc(NvM/NvMCommon/NvMApiConfigClass)} == NVM_API_CONFIG_CLASS_3)  # Service to copy the data of the RAM block to its corresponding NV block.
          arg SrcPtr: type=ConstVoidPtr, direction=IN  # The parameter "SrcPtr" shall be typed by an ImplementationDataType of category DATA_REFERENCE with the pointer target void to pass an address (pointer) to the RAM Block.
        WritePRAMBlock: variation-point=blueprint-condition=p=l-1=({ecuc(NvM/NvMCommon/NvMApiConfigClass)} == NVM_API_CONFIG_CLASS_2 || {ecuc(NvM/NvMCommon/NvMApiConfigClass)} == NVM_API_CONFIG_CLASS_3)
      error E_OK: error-code=0  # Operation successful
      error E_NOT_OK: error-code=1  # Operation failed
