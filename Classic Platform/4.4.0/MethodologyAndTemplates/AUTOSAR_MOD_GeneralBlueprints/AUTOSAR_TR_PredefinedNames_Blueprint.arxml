AUTOSAR XML (schema 00046)
package /AUTOSAR/PredefinedNames_Blueprint/KeywordSets
  4 x keyword set:
    VirtualModules  # Virtual Modules | This keyword set defines virtual modules which take the role of module designators in naming conventions but do not exist as e.g. C-implementations. | Definition of Virtual Modules This keyword set contains two keyword classifications: ModuleDesignator: The Keyword.abbrName represents a valid module designator defined by AUTOSAR (see TPS_GST_00017 in TPS_2d_GenericStructureTemplate ). AUTOSAR-Document: The Referrable.shortName represents a module name for the implementation of a specification provided by AUTOSAR (see TR_IOAT_00069 in TR_2d_InteroperabilityOfAutosarTools ).
      5 x keyword:
        AISpecification: abbr-name=AISpecification, classifications=[AUTOSAR-Document, ModuleDesignator]  # XML Specification of Application Interfaces | This represents the Appplication Interfaces.
        EcuC: abbr-name=EcuC, classifications=ModuleDesignator  # Ecu Configuration | EcuC is a pseudo module which defines parameters applicable to all other BSW modules.
        GeneralBlueprints: abbr-name=GenBlpr, classifications=ModuleDesignator  # General Blueprints | Collection of blueprints for AUTOSAR M1 models.
        GeneralDefinitions: abbr-name=GenDef, classifications=ModuleDesignator  # General Definitions | This represents general elements that can be applied for both, basic (BSW) and application software (ASW), but for which no explicit AUTOSAR Document is maintained. Example for objects in this virtual module are elements such as life cycle definitions, role definitions etc.
        V2X: abbr-name=V2X, classifications=ModuleDesignator  # Vehicle-2-X | V2X is used as a cluster abbreviation by all cross module types used by the Vehicle-2-X communication modules.
    InformationCategories  # AUTOSAR Information Categories | This keyword set denotes abbreviations used e.g. in filenames respectively in trace tags. | Definition of AUTOSAR Information Categories This keyword set contains the following keyword classifications: DocumentCategory: The keyword (Keyword.abbrName) represents a valid category of a document provided by AUTOSAR (see TPS_STDT_00050 in TPS_2d_StandardizationTemplate ). TraceCategory: The keyword (Keyword.abbrName) represents a valid category of a traceable text within a document provided by AUTOSAR (see TPS_STDT_00042 in TPS_2d_StandardizationTemplate ). InternalDocumentCategory: The keyword ( Keyword.abbrName) represents a valid category of a document internal to AUTOSAR which is not published but still follows the conventions.
      22 x keyword:
        ASWS: abbr-name=ASWS, classifications=[DocumentCategory, TraceCategory]  # Abstract SWS Software Specification | General Specification of AUTOSAR Basic Software Modules
        ATR: abbr-name=ATR, classifications=[DocumentCategory, TraceCategory]  # Acceptance Test Requirement | Specification of requirements for acceptance tests
        ATS: abbr-name=ATS, classifications=[DocumentCategory, TraceCategory]  # Acceptance Test Specification | Test specification and scripts for the execution of acceptance tests
        CONC: abbr-name=CONC, classifications=[DocumentCategory, TraceCategory]  # Concept Document | Concept describing planned changes for the next minor or major release
        CTCF: abbr-name=CTCF, classifications=[DocumentCategory, TraceCategory]  # Configuration Settings | Configuration settings for the execution of conformance Tests
        CTSP: abbr-name=CTSP, classifications=[DocumentCategory, TraceCategory]  # Conformance Test Specification | Test specification and scripts for the execution of conformance tests
        EXP: abbr-name=EXP, classifications=[DocumentCategory, TraceCategory]  # Explanation | Explanatory material discussiong contents already shown in other documents
        MMOD: abbr-name=MMOD, classifications=[DocumentCategory, TraceCategory]  # MetaModel | Modeled contents (a model or generated from a model) on meta level 2 (Meta-Model)
        MOD: abbr-name=MOD, classifications=[DocumentCategory, TraceCategory]  # Model | Modeled contents (a model or generated from a model) on meta level 1 (Model)
        PD: abbr-name=PD, classifications=[DocumentCategory, TraceCategory]  # Process Description | Description of process applied within AUTOSAR standardization activities
        PDEP: abbr-name=PDEP, classifications=[DocumentCategory, TraceCategory]  # Profile of Data Exchange Point | Contains models that tailor AUTOSAR specifications and templates for specific data exchange points
        PRS: abbr-name=PRS, classifications=[DocumentCategory, TraceCategory]  # Protocol Specification | Specification of Protocols standardized by AUTOSAR
        RS: abbr-name=RS, classifications=[DocumentCategory, TraceCategory]  # Requirement Specification | Specification of requirements other than for software specifications
        SRS: abbr-name=SRS, classifications=[DocumentCategory, TraceCategory]  # Software Requirement Specification | Specification of requirements for software specifications
        SWS: abbr-name=SWS, classifications=[DocumentCategory, TraceCategory]  # Software Specification | Specification of AUTOSAR Software
        TMPL: abbr-name=TMPL, classifications=InternalDocumentCategory  # Template | Predefined documentation templates
        TPS: abbr-name=TPS, classifications=[DocumentCategory, TraceCategory]  # Template Specification | Specification of AUTOSAR Templates, containing Meta model information, constraints etc.
        TR: abbr-name=TR, classifications=[DocumentCategory, TraceCategory]  # Technical Report | A general technical report describing arbitrary AUTOSAR related topics
        UC: abbr-name=UC, classifications=TraceCategory  # Use Case Specification | Specification of use cases from which requirements are derived. Note that there are documents which maintain the use cases in their requirement spec. So this documentCategory may exist, even if it is not an own artifact.
        ZAUX: abbr-name=ZAUX, classifications=InternalDocumentCategory  # Auxilary material | Auxillary files used internally for the creation of the standard. May be merged with ZSUPP.
        ZGEN: abbr-name=ZGEN, classifications=InternalDocumentCategory  # Generated intermediate material | Generated intermediate products which are maintained in the SCM system of AUTOSAR and used internally for the creation of the standard
        ZSUPP: abbr-name=ZSUPP, classifications=InternalDocumentCategory  # Supplemental material | Supplementary material used internally for the creation of the standard
    DocumentAbbreviations  # AUTOSAR Document Abbreviations for Trace Prefixes | These keywords represent the abbreviations to indicate documents e.g. in the requirements tags | Document Abbreviations for Trace Prefixes This keyword set contains the keyword classifications: DocumentAbbreviation: The Keyword.abbrName represents a valid document abbreviation in tracing tags (see TPS_STDT_00042 in TPS_2d_GenericStructureTemplate ). Note that there are cases where one document uses more than one abbreviation (e.g. [SWMC, SWNR], [MCM, MCG, MCA]). There are also cases where one abbreviation is used across multiple documents (e.g. [BSW]).
      94 x keyword, all with classifications=DocumentAbbreviation:
        AIBodyAndComfort: abbr-name=AIBC  # Application Interfaces "Body and Comfort" | This document explains Application Interfaces for "Body and Comfort".
        AIChassis: abbr-name=AICS  # Application Interfaces "Chassis" | This document explains Application Interfaces for "Chassis".
        AIDesignPatternCatalogue: abbr-name=AIDPC  # Application Interface Design Pattern Catalogue | This document contains Application Interface Design Pattern Catalogue.
        AIHMIMultimediaAndTelematics: abbr-name=AIHMI  # Application Interfaces "HMI Multimedia and Telematics" | This document explains Application Interfaces for "HMI Multimedia And Telematics".
        AIOccupantAndPedestrianSafety: abbr-name=AIOPS  # Application Interfaces "Occupant and pedestrian Safety" | This document explains Application Interfaces for "Application Interface Occupant and pedestrian Safety".
        AIPowertrain: abbr-name=AIPT  # Application Interfaces "Powertrain" | This document document explains Application Interfaces for "Powertrain".
        AISpecificationExamples: abbr-name=AISE  # XML Examples of Application Interfaces | This represents XML Examples of Appplication Interfaces.
        AIUserGuide: abbr-name=AIUG  # Application Interfaces User Guide | This document aims at explaining all relevant details about the AI Table.
        ApplicationLevelErrorHandling: abbr-name=ALEH  # Application Level Error Handling | This document explains the Application Level Error Handling.
        AdaptiveNetworkManagement: abbr-name=ANM  # Adaptive Network Management | Adaptive Platform - to be filled correclty
        AdaptivePlatformTypes: abbr-name=ASR  # ARXML Serialization Rules | This document explains how to serialize AUTOSAR models into ARXML files and vice versa.
        AutosarModelConstraints: abbr-name=ArModC  # Autosar Model Constraints | This document explains Autosar Model Constraints.
        ARXMLSerializationRules: abbr-name=ASR  # ARXML Serialization Rules | This document explains how to serialize AUTOSAR models into ARXML files and vice versa.
        ATBM: abbr-name=ATBM  # Interaction with Behavioral Models | This document describes interaction with behavioral models.
        BSWAndRTEFeatures: abbr-name=BRF  # AUTOSAR BSW and RTE Features | This document specifies the features of the BSW Architecture and the RTE.
        BSW: abbr-name=BSW  # Basic Software | This abbreviation represents the superset of all BSW software requirement specifications. This means that this abbreviation is used throughout all Basic Software Specifications.
        BSWModuleDescriptionTemplate: abbr-name=BSWMDT  # Basic Software Module Description Template | This document specifies how to describe a Basic Software
        BSWModuleList: abbr-name=BSWML  # Basic Software Module List | This document lists the BSW modules.
        BSWUMLModelModelingGuide: abbr-name=BSWUMG  # BSW UML Model Modeling Guide | This guideline describes the BSW UML Model modeling.
        BSWUML: abbr-name=BSWUML  # Basic Software UML model | This abbreviation represents the BSW UML model. This means that this abbreviation is used throughout all elements maintained in the BSW UML model.
        BWCStatement: abbr-name=BWC  # BWC Statement | This document describes the backward compatibility statement.
        CDDDesignAndIntegrationGuideline: abbr-name=CDDG  # CDD Design And Integration Guideline | This guideline describes the Design and the Integration of CDD.
        CommunicationCan: abbr-name=COMCAN  # Communication on Can | Relevant for communication on CAN.
        CommunicationFlexray: abbr-name=COMFR  # Communication on Flexray | Relevant for communication on Flexray.
        CommunicationLin: abbr-name=COMLIN  # Communication on Lin | Relevant for communication on LIN.
        CommunicationManagement: abbr-name=COMMGMT  # Communication Management | Relevant for communication management.
        CommunicationViaBus: abbr-name=COMVB  # Communication via a bus | Relevant for communication via a bus.
        Diagnostic: abbr-name=DIAG  # Requirements on Diagnostic | The goal of AUTOSAR WP Diagnostics and this document is to define to what extent elements of the diagnostic basic software have to be configurable and what preliminaries they shall comply with to meet the tailoring requirements. The handling of the legislated OBD and enhanced Diagnostics shall also be achieved.
        AdaptiveDiagnostics: abbr-name=DM  # Adaptive Diagnostics | Adaptive Platform - to be filled correclty
        ECUConfiguration: abbr-name=ECUC  # Specification of ECU Configuration | This document specifies the technical details of the ECU configuration
        ECUConfigurationParameters: abbr-name=ECUCP  # ECU Configuration Parameters | This document describes ECU Configuration Parameters.
        EcuModeManagement: abbr-name=ECUMGMT  # ECU Mode Management | Relevant for ECU mode management.
        ECUResourceTemplate: abbr-name=ECUR  # Specification of ECU Resource Template | This specifies how to describe Resources of an ECU
        ErrorDescription: abbr-name=ED  # Error Description | This document explains the Error Description.
        ExecutionManagement: abbr-name=EM  # Execution Management | Adaptive Platform - to be filled correclty
        ErrataSheet: abbr-name=ERSH  # Errata Sheet | This document explains the Errata Sheet.
        FrancaIntegration: abbr-name=FCAINT  # Franca Integration | This document describes the Franca Integration.
        Features: abbr-name=Feature  # Feature Specification Acceptance Tests | Feature Specification of the acceptance tests.
        FeatureModelExchangeFormat: abbr-name=FMDT  # Specification of Feature Model Exchange Format | This specifies how to describe the Feature Model Exchange Format.
        FreeRunningTimer: abbr-name=FRT  # Free Running Timer | This document describes the Free Running Timer.
        Glossary: abbr-name=GLOS  # This document lists all Glossary items.
        GenericStructureTemplate: abbr-name=GST  # Generic Structure Template | This specifies common aspects applicable to all templates.
        Gateway: abbr-name=GTW  # This document explains the Gateway.
        HealthManagement: abbr-name=HM  # Health Management | Adaptive Platform - to be filled correclty
        InteroperabilityOfAutosarTools: abbr-name=IOAT  # Interoperability of AUTOSAR Tools | This document describes various aspects of interoperability of AUTOSAR tools.
        InteroperabilityOfAutosarToolsSupplement: abbr-name=IOATS  # Interoperability of AUTOSAR Tools Supplement | This document contains baseline profiles of data exchange points and examples.
        IOHWAbstraction: abbr-name=IOHWAB  # IO Hardware Abstraction | This document describes the IO Hardware Abstraction.
        InterruptHandlingExplanation: abbr-name=IRH  # Interrupt Handling Explanation | This document explains the Interrupt Handling.
        SRSLibraries: abbr-name=LIBS  # Requirements on Libraries | This document specifies requirements on the AUTOSAR Libraries.
        AdaptiveLogAndTrace: abbr-name=LOG  # Adaptive Log and Trace | Adaptive Platform - to be filled correclty
        LayeredSoftwareArchitecture: abbr-name=LSA  # Layered Software Architecture | This document describes the Layered Software Architecture.
        MainRequirements: abbr-name=Main  # AUTOSAR Main Requirements | This document specifies the AUTOSAR main requirements.
        AIMeasurementCalibrationDiagnostics: abbr-name=MCAI  # Unique Names for Documentation, Measurement and Calibration: Modeling and Naming Aspects including Automatic Generation | This document discusses how to automatically generate display names for measurement, calibration and diagnostic tools (MCD).
        AIMeasurementCalibrationDiagnostics_Assumptions: abbr-name=MCA  # Assumptions in Unique Names for Documentation, Measurement and Calibration: Modeling and Naming Aspects including Automatic Generation | This keyword reflects the assumptions how to automatically generate display names for measurement, calibration and diagnostic tools (MCD). The keyword is used for document internal tracing
        AIMeasurementCalibrationDiagnostics_GenerationRules: abbr-name=MCG  # Generation Rules in Unique Names for Documentation, Measurement and Calibration: Modeling and Naming Aspects including Automatic Generation | This keyword reflects the generation rules how to automatically generate display names for measurement, calibration and diagnostic tools (MCD). The keyword is used for document internal tracing.
        AIMeasurementCalibrationDiagnostics_ModelingRules: abbr-name=MCM  # Modeling Rules in Unique Names for Documentation, Measurement and Calibration: Modeling and Naming Aspects including Automatic Generation | This keyword reflects the modeling rules of how to automatically generate display names for measurement, calibration and diagnostic tools (MCD). The keyword is used for document internal tracing.
        AIMeasurementCalibrationDiagnostics_Requirements: abbr-name=MCR  # Requirements in Unique Names for Documentation, Measurement and Calibration: Modeling and Naming Aspects including Automatic Generation | This keyword reflects the requirments of how to automatically generate display names for measurement, calibration and diagnostic tools (MCD). The keyword is used for document internal tracing.
        MemoryServices: abbr-name=MEM  # Requirements on Memory Services | This document specifies requirements on Basic Software Modules of the memory services.
        Methodology: abbr-name=METH  # AUTOSAR Methodology | This describes the AUTOSAR Methodolgy.
        MethodologyModelRules: abbr-name=MethModR  # Methodology Model Rules | This document describes the Methodology Model Rules.
        MiscSupport: abbr-name=MICS  # Miscellaneous Support | This document contains miscellaneous support items.
        MetaModel: abbr-name=MM  # Meta Model | This document describes the Meta Model.
        MemoryHWAbstractionLayer: abbr-name=MMHWABLY  # Memory Hardware Abstraction Layer | This document describes the Memory Hardware Abstraction Layer.
        ModeManagementGuide: abbr-name=MMG  # Mode Management Guide | This guideline describes the Mode Management.
        ModeMgm: abbr-name=ModeMgm  # Mode Management | This document specifies Mode Management in AUTOSAR.
        MultiCoreGuide: abbr-name=MTCG  # Multi Core Guide | This guideline describes Multi Core.
        MethodologyAndTemplatesGeneral: abbr-name=MTG  # General Requirements on Methodology and Templates | This document has the purpose to collect requirements on Methodology and Templates which are relevant for more than one document.
        OperatingSystemInterface: abbr-name=OSI  # Operating System Interface | Adaptive Platform - to be filled correclty
        Pesistency: abbr-name=PER  # Persistency | Adaptive Platform - to be filled correclty
        PredefinedNames: abbr-name=PDN  # AUTOSAR PredefinedNames | This document describes various predefined names used in AUTOSAR.
        ProjectObjectives: abbr-name=PO  # AUTOSAR Project Objectives | This document specifies the AUTOSAR Project Objectives.
        ReferenceBase: abbr-name=RefBase  # Reference Base | This document contains Reference Base items.
        Requirements: abbr-name=Requirement  # Requirements Acceptance Tests | Requirements for the acceptance tests.
        ReleaseOverviewAndRevHistory: abbr-name=RORH  # Release Overview And Rev History | This document provides a Release Overview and Rev History.
        RTE: abbr-name=RTE  # Runtime Environment | This document specifies the AUTOSAR Runtime Environment.
        SAE: abbr-name=SAE  # Society of Automotive Engineers | This document describes the network standard developed by the Society of Automotive Engineers.
        SafetyExtensions: abbr-name=SAFEX  # Specifcation of Safety Extensions | This document specifes how to describe the safety relevant properties and requirements of an AUTOSAR System.
        XMLSchemaSupplement: abbr-name=SchemaSupp  # XML Schema Supplement | This document explains the XML Schema.
        SomeIpExample: abbr-name=SIPEX  # SomeIp Example | This document contains SomeIp Examples.
        SPAL: abbr-name=SPAL  # Standard Peripheral Abstraction Layer | This document describes the Standard Peripheral Abstraction Layer.
        SafetyUseCase: abbr-name=SUC  # Safety Use Case | This document explains the Safety Use Cases.
        SWCModeling: abbr-name=SWCM  # Software Component Modeling | This document describes the modeling of Software Components.
        SoftwareComponentTemplate: abbr-name=SWCT  # Software Component Template | This document specifies how to describe Software Components.
        SWCModelingGuide: abbr-name=SWMG  # SW-C and System Modeling Guide | This document gives guidelines and conventions on using the AUTOSAR model elements in order to build AUTOSAR systems.
        SWCModelingGuide_NamingRules: abbr-name=SWNR  # Naming Rules in SW-C and System Modeling Guide | This document gives guidelines and conventions, in particular the naming rules on using the AUTOSAR model elements in order to build AUTOSAR systems.
        StandardizationTemplate: abbr-name=STDT  # Standardization Template | This specifies how AUTOSAR Standardization is represented as ARXML file.
        SystemTemplate: abbr-name=SYST  # System Template | This document specifies how to describe AUTOSAR Systems.
        TimingAnalysis: abbr-name=TIMAY  # Specification of Timing Analysis | This document explains the Timing Analysis.
        TimingExtensions: abbr-name=TIMEX  # Specification of Timing Extensions | This document specifies how to describe the timing of an AUTOSAR System.
        TTCAN: abbr-name=TTCAN  # Requirements on TTCAN | This document specifies the additional TTCAN requirements for the CAN BSW stack.
        UtilizationOfCryptoServices: abbr-name=UOC  # Utilization Of Crypto Services | This document explains the Utilization of Crypto Services.
        VirtualFunctionalBus: abbr-name=VFB  # Virtual Functional Bus | This document describes the Virtual Functional Bus.
        XMLSchema: abbr-name=XMLS  # XML Schema | This document describes the XML Schema.
        XMLSchemaProductionRules: abbr-name=XMLSPR  # XML Schema Production Rules | This document describes how a W3C XML schema specification compliant XML schema can be compiled out of the AUTOSAR meta-model.
    NamespaceAbbreviations  # AUTOSAR Name Spaces | These keywords represent the name space abbreviations of AUTOSAR Adaptive Platform Functional Cluster. | Document Abbreviations for Name Spaces This keyword set contains the name space definitions: NamespaceAbbreviation: The Keyword.abbrName represents a valid name space abbreviation).
      9 x keyword, all with classifications=NamespaceAbbreviation:
        com: abbr-name=com  # Communication Management | To be filled.
        exec: abbr-name=exec  # Execution Management | To be filled.
        not_available: abbr-name=not_available  # Operating System | To be filled.
        per: abbr-name=per  # Persistency | To be filled.
        diag: abbr-name=diag  # Diagnostics | To be filled.
        log: abbr-name=log  # Log and Trace | To be filled.
        time: abbr-name=time  # Time Synchronisation | To be filled.
        rest: abbr-name=rest  # REpresentational State Transfer | To be filled.
        ara: abbr-name=ara  # Autosar API (in combination with a cluster name ex: ara::rest) | To be filled.
