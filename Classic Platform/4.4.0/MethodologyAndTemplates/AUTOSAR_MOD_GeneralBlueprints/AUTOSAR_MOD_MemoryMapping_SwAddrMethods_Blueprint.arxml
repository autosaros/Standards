AUTOSAR XML (schema 00046)
package /AUTOSAR/MemMap/SwAddrMethods_Blueprint  # This ARPackage defines the blueprints for SwAddrMethods which are the basis for the standardized Memory Allocation Keywords in the document SWS_MemoryMapping | The derived SwAddrmethods shall reside at the qualified path /AUTOSAR_MemMap/SwAddrMethods/
  14 x sw addr method:
    VAR: memory-allocation-keyword-policy=ADDR-METHOD-SHORT-NAME-AND-ALIGNMENT, section-type=VAR  # To be used for all global or static variables.
    VAR_FAST: memory-allocation-keyword-policy=ADDR-METHOD-SHORT-NAME-AND-ALIGNMENT, section-type=VAR  # To be used for all global or static variables. | To be used for all global or static variables that have at least one of the following properties: accessed bitwise frequently used high number of accesses in source code Some platforms allow the use of bit instructions for variables located in this specific RAM area as well as shorter addressing instructions. This saves code and runtime.
    VAR_SLOW: memory-allocation-keyword-policy=ADDR-METHOD-SHORT-NAME-AND-ALIGNMENT, section-type=VAR  # To be used for all infrequently accessed global or static variables.
    INTERNAL_VAR: memory-allocation-keyword-policy=ADDR-METHOD-SHORT-NAME-AND-ALIGNMENT, section-type=VAR  # To be used for global or static variables those are accessible from a calibration tool.
    VAR_SAVED_ZONE: memory-allocation-keyword-policy=ADDR-METHOD-SHORT-NAME-AND-ALIGNMENT, section-initialization-policy=NO-INIT, section-type=VAR  # To be used for RAM buffers of variables saved in non volatile memory. | {anyNamePart} denotes the specific content of the saved zone. In the related SwAddrMethod the sectionInitializationPolicy attribute shall be set to NO-INIT.
    CONST_SAVED_RECOVERY_ZONE: memory-allocation-keyword-policy=ADDR-METHOD-SHORT-NAME-AND-ALIGNMENT, section-type=CONST  # To be used for ROM buffers of variables saved in non volatile memory. | {anyNamePart} denotes the specific content of the recovery zone.
    CONST: memory-allocation-keyword-policy=ADDR-METHOD-SHORT-NAME-AND-ALIGNMENT, section-type=CONST  # To be used for global or static constants.
    CALIB: memory-allocation-keyword-policy=ADDR-METHOD-SHORT-NAME-AND-ALIGNMENT, section-type=CALPRM  # To be used for calibration constants.
    CODE: section-type=CODE  # To be used for mapping code to application block, boot block, external flash etc. | {codePeriod} is the typical period time value and unit of the ExecutableEntitys in this MemorySection. The name part _{codePeriod} is optional. Units are: US microseconds MS milli second S second For example: 100US, 400US, 1MS, 5MS, 10MS, 20MS, 100MS, 1S Please note that deviations from this typical period time are possible due to integration decisions (e.g. RTEEvent To Task Mapping). Further on in special modes of the ECU the code may be scheduled with a higher or lower period.
    CONFIG_DATA: memory-allocation-keyword-policy=ADDR-METHOD-SHORT-NAME-AND-ALIGNMENT, section-type=CONFIG-DATA  # Constants with attributes that show that they reside in one segment for module configuration.
    CALLOUT_CODE: section-type=CODE  # To be used for mapping callouts of the BSW Modules which shall typically use the global linker settings for callouts.
    CALLOUT_CODE2: section-type=CODE  # To be used for mapping callouts of the BSW Modules. | {capitalizedCallbackName} is the Callback name, which shall have the same spelling of the Callback name, including module reference, but written in upper case.
    CODE_FAST: section-type=CODE  # To be used for code that shall go into fast code memory segments. | The FAST sections should be used when the execution does not happen in a well defined period times but with the knowledge of high frequent access and /or high execution time. For example, a callback for a frequent notification.
    CODE_SLOW: section-type=CODE  # To be used for code that shall go into slow code memory segments. | The SLOW sections should be used when the execution does not happen in a well defined period times but with the knowledge of low frequent access. For example, a callback in case of seldom error.
