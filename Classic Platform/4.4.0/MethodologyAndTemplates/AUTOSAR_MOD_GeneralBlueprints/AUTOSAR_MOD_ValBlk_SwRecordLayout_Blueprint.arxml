AUTOSAR XML (schema 00046)
package /AUTOSAR/GenDef/SwRecordLayouts_Blueprint
  31 x sw record layout:
    Val_b: sw-record-layout-group={short-label=Val, sw-record-layout-v={base-type=boolean, sw-record-layout-v-axis=0, sw-record-layout-v-prop=VALUE}}
    Val_s8: sw-record-layout-group={short-label=Val, sw-record-layout-v={base-type=sint8, sw-record-layout-v-axis=0, sw-record-layout-v-prop=VALUE}}
    Val_u8: sw-record-layout-group={short-label=Val, sw-record-layout-v={base-type=uint8, sw-record-layout-v-axis=0, sw-record-layout-v-prop=VALUE}}
    Val_s16: sw-record-layout-group={short-label=Val, sw-record-layout-v={base-type=sint16, sw-record-layout-v-axis=0, sw-record-layout-v-prop=VALUE}}
    Val_u16: sw-record-layout-group={short-label=Val, sw-record-layout-v={base-type=uint16, sw-record-layout-v-axis=0, sw-record-layout-v-prop=VALUE}}
    Val_s32: sw-record-layout-group={short-label=Val, sw-record-layout-v={base-type=sint32, sw-record-layout-v-axis=0, sw-record-layout-v-prop=VALUE}}
    Val_u32: sw-record-layout-group={short-label=Val, sw-record-layout-v={base-type=uint32, sw-record-layout-v-axis=0, sw-record-layout-v-prop=VALUE}}
    Val_s64: sw-record-layout-group={short-label=Val, sw-record-layout-v={base-type=sint64, sw-record-layout-v-axis=0, sw-record-layout-v-prop=VALUE}}
    Val_u64: sw-record-layout-group={short-label=Val, sw-record-layout-v={base-type=uint64, sw-record-layout-v-axis=0, sw-record-layout-v-prop=VALUE}}
    Val_f32: sw-record-layout-group={short-label=Val, sw-record-layout-v={base-type=float32, sw-record-layout-v-axis=0, sw-record-layout-v-prop=VALUE}}
    Val_f64: sw-record-layout-group={short-label=Val, sw-record-layout-v={base-type=float64, sw-record-layout-v-axis=0, sw-record-layout-v-prop=VALUE}}
    ValBlk_s8: sw-record-layout-group={short-label=Val, category=COLUMN_DIR, sw-record-layout-group-from=1, sw-record-layout-group-to=-1, sw-record-layout-v={base-type=sint8, sw-record-layout-v-axis=0, sw-record-layout-v-prop=VALUE}}
    ValBlk_u8: sw-record-layout-group={short-label=Val, category=COLUMN_DIR, sw-record-layout-group-from=1, sw-record-layout-group-to=-1, sw-record-layout-v={base-type=uint8, sw-record-layout-v-axis=0, sw-record-layout-v-prop=VALUE}}
    ValBlk_s16: sw-record-layout-group={short-label=Val, category=COLUMN_DIR, sw-record-layout-group-from=1, sw-record-layout-group-to=-1, sw-record-layout-v={base-type=sint16, sw-record-layout-v-axis=0, sw-record-layout-v-prop=VALUE}}
    ValBlk_u16: sw-record-layout-group={short-label=Val, category=COLUMN_DIR, sw-record-layout-group-from=1, sw-record-layout-group-to=-1, sw-record-layout-v={base-type=uint16, sw-record-layout-v-axis=0, sw-record-layout-v-prop=VALUE}}
    ValBlk_s32: sw-record-layout-group={short-label=Val, category=COLUMN_DIR, sw-record-layout-group-from=1, sw-record-layout-group-to=-1, sw-record-layout-v={base-type=sint32, sw-record-layout-v-axis=0, sw-record-layout-v-prop=VALUE}}
    ValBlk_u32: sw-record-layout-group={short-label=Val, category=COLUMN_DIR, sw-record-layout-group-from=1, sw-record-layout-group-to=-1, sw-record-layout-v={base-type=uint32, sw-record-layout-v-axis=0, sw-record-layout-v-prop=VALUE}}
    ValBlk_s64: sw-record-layout-group={short-label=Val, category=COLUMN_DIR, sw-record-layout-group-from=1, sw-record-layout-group-to=-1, sw-record-layout-v={base-type=sint64, sw-record-layout-v-axis=0, sw-record-layout-v-prop=VALUE}}
    ValBlk_u64: sw-record-layout-group={short-label=Val, category=COLUMN_DIR, sw-record-layout-group-from=1, sw-record-layout-group-to=-1, sw-record-layout-v={base-type=uint64, sw-record-layout-v-axis=0, sw-record-layout-v-prop=VALUE}}
    ValBlk_f32: sw-record-layout-group={short-label=Val, category=COLUMN_DIR, sw-record-layout-group-from=1, sw-record-layout-group-to=-1, sw-record-layout-v={base-type=float32, sw-record-layout-v-axis=0, sw-record-layout-v-prop=VALUE}}
    ValBlk_f64: sw-record-layout-group={short-label=Val, category=COLUMN_DIR, sw-record-layout-group-from=1, sw-record-layout-group-to=-1, sw-record-layout-v={base-type=float64, sw-record-layout-v-axis=0, sw-record-layout-v-prop=VALUE}}
    ValBlkMDim_s8: sw-record-layout-group={short-label=Val, category=COLUMN_DIR, sw-record-layout-group-index=i, sw-record-layout-group-from=1, sw-record-layout-group-to=-1, sw-record-layout-group={sw-record-layout-group-index=j, sw-record-layout-group-from=1, sw-record-layout-group-to=-1, sw-record-layout-v={base-type=sint8, sw-record-layout-v-axis=0, sw-record-layout-v-prop=VALUE, sw-record-layout-v-index=i j}}}
    ValBlkMDim_u8: sw-record-layout-group={short-label=Val, category=COLUMN_DIR, sw-record-layout-group-index=i, sw-record-layout-group-from=1, sw-record-layout-group-to=-1, sw-record-layout-group={sw-record-layout-group-index=j, sw-record-layout-group-from=1, sw-record-layout-group-to=-1, sw-record-layout-v={base-type=uint8, sw-record-layout-v-axis=0, sw-record-layout-v-prop=VALUE, sw-record-layout-v-index=i j}}}
    ValBlkMDim_s16: sw-record-layout-group={short-label=Val, category=COLUMN_DIR, sw-record-layout-group-index=i, sw-record-layout-group-from=1, sw-record-layout-group-to=-1, sw-record-layout-group={sw-record-layout-group-index=j, sw-record-layout-group-from=1, sw-record-layout-group-to=-1, sw-record-layout-v={base-type=sint16, sw-record-layout-v-axis=0, sw-record-layout-v-prop=VALUE, sw-record-layout-v-index=i j}}}
    ValBlkMDim_u16: sw-record-layout-group={short-label=Val, category=COLUMN_DIR, sw-record-layout-group-index=i, sw-record-layout-group-from=1, sw-record-layout-group-to=-1, sw-record-layout-group={sw-record-layout-group-index=j, sw-record-layout-group-from=1, sw-record-layout-group-to=-1, sw-record-layout-v={base-type=uint16, sw-record-layout-v-axis=0, sw-record-layout-v-prop=VALUE, sw-record-layout-v-index=i j}}}
    ValBlkMDim_s32: sw-record-layout-group={short-label=Val, category=COLUMN_DIR, sw-record-layout-group-index=i, sw-record-layout-group-from=1, sw-record-layout-group-to=-1, sw-record-layout-group={sw-record-layout-group-index=j, sw-record-layout-group-from=1, sw-record-layout-group-to=-1, sw-record-layout-v={base-type=sint32, sw-record-layout-v-axis=0, sw-record-layout-v-prop=VALUE, sw-record-layout-v-index=i j}}}
    ValBlkMDim_u32: sw-record-layout-group={short-label=Val, category=COLUMN_DIR, sw-record-layout-group-index=i, sw-record-layout-group-from=1, sw-record-layout-group-to=-1, sw-record-layout-group={sw-record-layout-group-index=j, sw-record-layout-group-from=1, sw-record-layout-group-to=-1, sw-record-layout-v={base-type=uint32, sw-record-layout-v-axis=0, sw-record-layout-v-prop=VALUE, sw-record-layout-v-index=i j}}}
    ValBlkMDim_s64: sw-record-layout-group={short-label=Val, category=COLUMN_DIR, sw-record-layout-group-index=i, sw-record-layout-group-from=1, sw-record-layout-group-to=-1, sw-record-layout-group={sw-record-layout-group-index=j, sw-record-layout-group-from=1, sw-record-layout-group-to=-1, sw-record-layout-v={base-type=sint64, sw-record-layout-v-axis=0, sw-record-layout-v-prop=VALUE, sw-record-layout-v-index=i j}}}
    ValBlkMDim_u64: sw-record-layout-group={short-label=Val, category=COLUMN_DIR, sw-record-layout-group-index=i, sw-record-layout-group-from=1, sw-record-layout-group-to=-1, sw-record-layout-group={sw-record-layout-group-index=j, sw-record-layout-group-from=1, sw-record-layout-group-to=-1, sw-record-layout-v={base-type=uint64, sw-record-layout-v-axis=0, sw-record-layout-v-prop=VALUE, sw-record-layout-v-index=i j}}}
    ValBlkMDim_f32: sw-record-layout-group={short-label=Val, category=COLUMN_DIR, sw-record-layout-group-index=i, sw-record-layout-group-from=1, sw-record-layout-group-to=-1, sw-record-layout-group={sw-record-layout-group-index=j, sw-record-layout-group-from=1, sw-record-layout-group-to=-1, sw-record-layout-v={base-type=float32, sw-record-layout-v-axis=0, sw-record-layout-v-prop=VALUE, sw-record-layout-v-index=i j}}}
    ValBlkMDim_f64: sw-record-layout-group={short-label=Val, category=COLUMN_DIR, sw-record-layout-group-index=i, sw-record-layout-group-from=1, sw-record-layout-group-to=-1, sw-record-layout-group={sw-record-layout-group-index=j, sw-record-layout-group-from=1, sw-record-layout-group-to=-1, sw-record-layout-v={base-type=float64, sw-record-layout-v-axis=0, sw-record-layout-v-prop=VALUE, sw-record-layout-v-index=i j}}}
