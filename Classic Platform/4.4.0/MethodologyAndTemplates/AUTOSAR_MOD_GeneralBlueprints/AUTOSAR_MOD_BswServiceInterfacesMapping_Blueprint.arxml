AUTOSAR XML (schema 00046)
package /AUTOSAR/Dem/Mapping_Blueprint
  29 x client server interface to bsw module entry blueprint mapping:
    CallbackClearEventAllowed__Mapping: client-server-interface=CallbackClearEventAllowed, client-server-operation-blueprint-mapping{bsw-module-entry=DemClearEventAllowed, client-server-operation=ClearEventAllowed}
    CallbackGetFaultDetectCounter__Mapping: client-server-interface=CallbackGetFaultDetectCounter, client-server-operation-blueprint-mapping{bsw-module-entry=GetFaultDetection, client-server-operation=GetFaultDetectionCounter}
    CallbackInitMonitorForEvent__Mapping: client-server-interface=CallbackInitMonitorForEvent, client-server-operation-blueprint-mapping{bsw-module-entry=InitMonitorForEvent, client-server-operation=InitMonitorForEvent}
    CallbackDTCStatusChange__Mapping: client-server-interface=CallbackDTCStatusChange, client-server-operation-blueprint-mapping{bsw-module-entry=DemTriggerOnDTCStatus, client-server-operation=DTCStatusChanged}
    ClearDTC__Mapping: client-server-interface=ClearDTC, port-defined-argument-blueprint=uint8
      operation-mappings:
        bsw-module-entry=Dem_ClearDTC, client-server-operation=ClearDTC
        bsw-module-entry=Dem_SelectDTC, client-server-operation=SelectDTC
    DTCSuppression__Mapping: client-server-interface=DTCSuppression
      operation-mappings:
        bsw-module-entry=Dem_GetDTCSuppression, client-server-operation=GetDTCSuppression
        bsw-module-entry=Dem_SetDTCSuppression, client-server-operation=SetDTCSuppression
    EventAvailable__Mapping: client-server-interface=EventAvailable, client-server-operation-blueprint-mapping{bsw-module-entry=Dem_SetEventAvailable, client-server-operation=SetEventAvailable}, port-defined-argument-blueprint=Dem_EventIdType
    EventFailureCycleCounterThreshold__Mapping: client-server-interface=EventFailureCycleCounterThreshold, client-server-operation-blueprint-mapping{bsw-module-entry=Dem_SetEventFailureCycleCounterThreshold, client-server-operation=SetEventFailureCycleCounterThreshold}, port-defined-argument-blueprint=Dem_EventIdType
    DataServices__Mapping: client-server-interface=DataServices, client-server-operation-blueprint-mapping{bsw-module-entry=ReadData1, client-server-operation=ReadData}
    DiagnosticMonitor_MonitorData__Mapping: client-server-interface=DiagnosticMonitor_MonitorData, client-server-operation-blueprint-mapping{bsw-module-entry=Dem_SetEventStatusWithMonitorData, client-server-operation=SetEventStatusWithMonitorData}, port-defined-argument-blueprint=Dem_EventIdType
    DTRCentralReport__Mapping: client-server-interface=DTRCentralReport, client-server-operation-blueprint-mapping{bsw-module-entry=Dem_SetDTR, client-server-operation=SetDTR}, port-defined-argument-blueprint=uint16
    EnableCondition__Mapping: client-server-interface=EnableCondition, client-server-operation-blueprint-mapping{bsw-module-entry=Dem_SetEnableCondition, client-server-operation=SetEnableCondition}, port-defined-argument-blueprint=uint8
    DiagnosticMonitor__Mapping: client-server-interface=DiagnosticMonitor, port-defined-argument-blueprint=Dem_EventIdType
      operation-mappings:
        bsw-module-entry=Dem_ClearPrestoredFreezeFrame, client-server-operation=ClearPrestoredFreezeFrame
        bsw-module-entry=Dem_PrestoreFreezeFrame, client-server-operation=PrestoreFreezeFrame
        bsw-module-entry=Dem_ResetEventDebounceStatus, client-server-operation=ResetEventDebounceStatus
        bsw-module-entry=Dem_ResetEventStatus, client-server-operation=ResetEventStatus
        bsw-module-entry=Dem_SetEventDisabled, client-server-operation=SetEventDisabled
        bsw-module-entry=Dem_SetEventStatus, client-server-operation=SetEventStatus
    DiagnosticInfo__Mapping: client-server-interface=DiagnosticInfo, port-defined-argument-blueprint=Dem_EventIdType
      operation-mappings:
        bsw-module-entry=Dem_GetDTCOfEvent, client-server-operation=GetDTCOfEvent
        bsw-module-entry=Dem_GetDebouncingOfEvent, client-server-operation=GetDebouncingOfEvent
        bsw-module-entry=Dem_GetEventExtendedDataRecordEx, client-server-operation=GetEventExtendedDataRecordEx
        bsw-module-entry=Dem_GetEventFreezeFrameDataEx, client-server-operation=GetEventFreezeFrameDataEx
        bsw-module-entry=Dem_GetEventUdsStatus, client-server-operation=GetEventUdsStatus
        bsw-module-entry=Dem_GetFaultDetectionCounter, client-server-operation=GetFaultDetectionCounter
        bsw-module-entry=Dem_GetMonitorStatus, client-server-operation=GetMonitorStatus
    EventStatus__Mapping: client-server-interface=EventStatus, client-server-operation-blueprint-mapping{bsw-module-entry=Dem_SetWIRStatus, client-server-operation=SetWIRStatus}, port-defined-argument-blueprint=Dem_EventIdType
    GeneralDiagnosticInfo__Mapping: client-server-interface=GeneralDiagnosticInfo
      operation-mappings:
        bsw-module-entry=Dem_GetDTCOfEvent, client-server-operation=GetDTCOfEvent
        bsw-module-entry=Dem_GetDebouncingOfEvent, client-server-operation=GetDebouncingOfEvent
        bsw-module-entry=Dem_GetEventExtendedDataRecordEx, client-server-operation=GetEventExtendedDataRecordEx
        bsw-module-entry=Dem_GetEventFreezeFrameDataEx, client-server-operation=GetEventFreezeFrameDataEx
        bsw-module-entry=Dem_GetEventUdsStatus, client-server-operation=GetEventUdsStatus
        bsw-module-entry=Dem_GetFaultDetectionCounter, client-server-operation=GetFaultDetectionCounter
        bsw-module-entry=Dem_GetMonitorStatus, client-server-operation=GetMonitorStatus
    GetDataOfPID21__Mapping: client-server-interface=GetDataOfPID21, client-server-operation-blueprint-mapping{bsw-module-entry=Dem_GetDataOfPID21, client-server-operation=GetDataOfPID21}
    IndicatorStatus__Mapping: client-server-interface=IndicatorStatus, client-server-operation-blueprint-mapping{bsw-module-entry=Dem_GetIndicatorStatus, client-server-operation=GetIndicatorStatus}, port-defined-argument-blueprint=uint8
    IUMPRDenominator__Mapping: client-server-interface=IUMPRDenominator, client-server-operation-blueprint-mapping{bsw-module-entry=Dem_RepIUMPRDenRelease, client-server-operation=RepIUMPRDenRelease}, port-defined-argument-blueprint=Dem_RatioIdType
    IUMPRDenominatorCondition__Mapping: client-server-interface=IUMPRDenominatorCondition, port-defined-argument-blueprint=Dem_IumprDenomCondIdType
      operation-mappings:
        bsw-module-entry=Dem_GetIUMPRDenCondition, client-server-operation=GetIUMPRDenCondition
        bsw-module-entry=Dem_SetIUMPRDenCondition, client-server-operation=SetIUMPRDenCondition
    IUMPRNumerator__Mapping: client-server-interface=IUMPRNumerator, client-server-operation-blueprint-mapping{bsw-module-entry=Dem_RepIUMPRFaultDetect, client-server-operation=RepIUMPRFaultDetect}, port-defined-argument-blueprint=Dem_RatioIdType
    OperationCycle__Mapping: client-server-interface=OperationCycle, port-defined-argument-blueprint=uint8
      operation-mappings:
        bsw-module-entry=Dem_GetCycleQualified, client-server-operation=GetCycleQualified
        bsw-module-entry=Dem_RestartOperationCycle, client-server-operation=RestartOperationCycle
        bsw-module-entry=Dem_SetCycleQualified, client-server-operation=SetCycleQualified
    EvMemOverflowIndication__Mapping: client-server-interface=EvMemOverflowIndication, port-defined-argument-blueprints=[uint8, Dem_DTCOriginType]
      operation-mappings:
        bsw-module-entry=Dem_GetEventMemoryOverflow, client-server-operation=GetEventMemoryOverflow
        bsw-module-entry=Dem_GetNumberOfEventMemoryEntries, client-server-operation=GetNumberOfEventMemoryEntries
    PowerTakeOff__Mapping: client-server-interface=PowerTakeOff, client-server-operation-blueprint-mapping{bsw-module-entry=Dem_SetPtoStatus, client-server-operation=SetPtoStatus}
    SetDataOfPID21__Mapping: client-server-interface=SetDataOfPID21, client-server-operation-blueprint-mapping{bsw-module-entry=Dem_SetDataOfPID21, client-server-operation=SetDataOfPID21}
    SetDataOfPID31__Mapping: client-server-interface=SetDataOfPID31, client-server-operation-blueprint-mapping{bsw-module-entry=Dem_SetDataOfPID31, client-server-operation=SetDataOfPID31}
    SetDataOfPID4D__Mapping: client-server-interface=SetDataOfPID4D, client-server-operation-blueprint-mapping{bsw-module-entry=Dem_SetDataOfPID4D, client-server-operation=SetDataOfPID4D}
    SetDataOfPID4E__Mapping: client-server-interface=SetDataOfPID4E, client-server-operation-blueprint-mapping{bsw-module-entry=Dem_SetDataOfPID4E, client-server-operation=SetDataOfPID4E}
    StorageCondition__Mapping: client-server-interface=StorageCondition, client-server-operation-blueprint-mapping{bsw-module-entry=Dem_SetStorageCondition, client-server-operation=SetStorageCondition}, port-defined-argument-blueprint=uint8
package /AUTOSAR/Det/Mapping_Blueprint
  client server interface to bsw module entry blueprint mapping DETService__Mapping: client-server-interface=DETService, port-defined-argument-blueprints=[uint16, uint8]
    operation-mappings:
      bsw-module-entry=Det_ReportError, client-server-operation=ReportError
      bsw-module-entry=Det_ReportRuntimeError, client-server-operation=ReportRuntimeError
package /AUTOSAR/Dlt/Mapping_Blueprint
  client server interface to bsw module entry blueprint mapping DltControlService__Mapping: client-server-interface=DltControlService
    operation-mappings:
      bsw-module-entry=Dlt_GetDefaultLogLevel, client-server-operation=GetDefaultLogLevel
      bsw-module-entry=Dlt_GetDefaultTraceStatus, client-server-operation=GetDefaultTraceStatus
      bsw-module-entry=Dlt_GetLogChannelNames, client-server-operation=GetLogChannelNames
      bsw-module-entry=Dlt_GetLogChannelThreshold, client-server-operation=GetLogChannelThreshold
      bsw-module-entry=Dlt_GetLogInfo, client-server-operation=GetLogInfo
      bsw-module-entry=Dlt_GetTraceStatus, client-server-operation=GetTraceStatus
      bsw-module-entry=Dlt_ResetToFactoryDefault, client-server-operation=ResetToFactoryDefault
      bsw-module-entry=Dlt_SetDefaultLogLevel, client-server-operation=SetDefaultLogLevel
      bsw-module-entry=Dlt_SetDefaultTraceStatus, client-server-operation=SetDefaultTraceStatus
      bsw-module-entry=Dlt_SetLogChannelAssignment, client-server-operation=SetLogChannelAssignment
      bsw-module-entry=Dlt_SetLogChannelThreshold, client-server-operation=SetLogChannelThreshold
      bsw-module-entry=Dlt_SetLogLevel, client-server-operation=SetLogLevel
      bsw-module-entry=Dlt_SetMessageFiltering, client-server-operation=SetMessageFiltering
      bsw-module-entry=Dlt_SetTraceStatus, client-server-operation=SetTraceStatus
      bsw-module-entry=Dlt_StoreConfiguration, client-server-operation=StoreConfiguration
  client server interface to bsw module entry blueprint mapping InjectionCallback__Mapping: client-server-interface=InjectionCallback, client-server-operation-blueprint-mapping{bsw-module-entry=Dlt_InjectCall_SESSION, client-server-operation=InjectCall}
  client server interface to bsw module entry blueprint mapping DltSwcMessageService__Mapping: client-server-interface=DltSwcMessageService, port-defined-argument-blueprint=Dlt_SessionIDType
    operation-mappings:
      bsw-module-entry=Dlt_RegisterContext, client-server-operation=RegisterContext
      bsw-module-entry=Dlt_SendLogMessage, client-server-operation=SendLogMessage
      bsw-module-entry=Dlt_SendTraceMessage, client-server-operation=SendTraceMessage
      bsw-module-entry=Dlt_UnregisterContext, client-server-operation=UnregisterContext
package /AUTOSAR/FiM/Mapping_Blueprint
  client server interface to bsw module entry blueprint mapping ControlFunctionAvailable__Mapping: client-server-interface=ControlFunctionAvailable, client-server-operation-blueprint-mapping{bsw-module-entry=FiM_SetFunctionAvailable, client-server-operation=SetFunctionAvailable}, port-defined-argument-blueprint=FiM_FunctionIdType
  client server interface to bsw module entry blueprint mapping FunctionInhibition__Mapping: client-server-interface=FunctionInhibition, client-server-operation-blueprint-mapping{bsw-module-entry=FiM_GetFunctionPermission, client-server-operation=GetFunctionPermission}, port-defined-argument-blueprint=FiM_FunctionIdType
package /AUTOSAR/ComM/Mapping_Blueprint
  4 x client server interface to bsw module entry blueprint mapping:
    ComM_ChannelLimitation__Mapping: client-server-interface=ComM_ChannelLimitation, port-defined-argument-blueprint=NetworkHandleType
      operation-mappings:
        bsw-module-entry=ComM_GetInhibitionStatus, client-server-operation=GetInhibitionStatus
        bsw-module-entry=ComM_LimitChannelToNoComMode, client-server-operation=LimitChannelToNoComMode
    ComM_ChannelWakeup__Mapping: client-server-interface=ComM_ChannelWakeup, port-defined-argument-blueprint=NetworkHandleType
      operation-mappings:
        bsw-module-entry=ComM_GetInhibitionStatus, client-server-operation=GetInhibitionStatus
        bsw-module-entry=ComM_PreventWakeUp, client-server-operation=PreventWakeUp
    ComM_ECUModeLimitation__Mapping: client-server-interface=ComM_ECUModeLimitation
      operation-mappings:
        bsw-module-entry=ComM_LimitECUToNoComMode, client-server-operation=LimitECUToNoComMode
        bsw-module-entry=ComM_ReadInhibitCounter, client-server-operation=ReadInhibitCounter
        bsw-module-entry=ComM_ResetInhibitCounter, client-server-operation=ResetInhibitCounter
        bsw-module-entry=ComM_SetECUGroupClassification, client-server-operation=SetECUGroupClassification
    ComM_UserRequest__Mapping: client-server-interface=ComM_UserRequest, port-defined-argument-blueprint=ComM_UserHandleType
      operation-mappings:
        bsw-module-entry=ComM_GetCurrentComMode, client-server-operation=GetCurrentComMode
        bsw-module-entry=ComM_GetMaxComMode, client-server-operation=GetMaxComMode
        bsw-module-entry=ComM_RequestComMode, client-server-operation=GetRequestedComMode
        bsw-module-entry=ComM_GetRequestedComMode, client-server-operation=RequestComMode
package /AUTOSAR/EcuM_flex/Mapping_Blueprint
  5 x client server interface to bsw module entry blueprint mapping:
    EcuM_AlarmClock__Mapping: client-server-interface=EcuM_AlarmClock, port-defined-argument-blueprint=EcuM_UserType
      operation-mappings:
        bsw-module-entry=EcuM_AbortWakeupAlarm, client-server-operation=AbortWakeupAlarm
        bsw-module-entry=EcuM_SetAbsWakeupAlarm, client-server-operation=SetAbsWakeupAlarm
        bsw-module-entry=EcuM_SetClock, client-server-operation=SetClock
        bsw-module-entry=EcuM_SetRelWakeupAlarm, client-server-operation=SetRelWakeupAlarm
    EcuM_BootTarget__Mapping: client-server-interface=EcuM_BootTarget
      operation-mappings:
        bsw-module-entry=EcuM_GetBootTarget, client-server-operation=GetBootTarget
        bsw-module-entry=EcuM_SelectBootTarget, client-server-operation=SelectBootTarget
    EcuM_ShutdownTarget__Mapping: client-server-interface=EcuM_ShutdownTarget
      operation-mappings:
        bsw-module-entry=EcuM_GetLastShutdownTarget, client-server-operation=GetLastShutdownTarget
        bsw-module-entry=EcuM_GetShutdownCause, client-server-operation=GetShutdownCause
        bsw-module-entry=EcuM_GetShutdownTarget, client-server-operation=GetShutdownTarget
        bsw-module-entry=EcuM_SelectShutdownCause, client-server-operation=SelectShutdownCause
        bsw-module-entry=EcuM_SelectShutdownTarget, client-server-operation=SelectShutdownTarget
    EcuM_StateRequest__Mapping: client-server-interface=EcuM_StateRequest, port-defined-argument-blueprint=EcuM_UserType
      operation-mappings:
        bsw-module-entry=EcuM_ReleasePOST_RUN, client-server-operation=ReleasePOSTRUN
        bsw-module-entry=EcuM_ReleaseRUN, client-server-operation=ReleaseRUN
        bsw-module-entry=EcuM_RequestPOST_RUN, client-server-operation=RequestPOSTRUN
        bsw-module-entry=EcuM_RequestRUN, client-server-operation=RequestRUN
    EcuM_Time__Mapping: client-server-interface=EcuM_Time
      operation-mappings:
        bsw-module-entry=EcuM_GetCurrentTime, client-server-operation=GetCurrentTime
        bsw-module-entry=EcuM_GetWakeupTime, client-server-operation=GetWakeupTime
package /AUTOSAR/EcuM/Mapping_Blueprint
  client server interface to bsw module entry blueprint mapping EcuM_BootTarget__Mapping: client-server-interface=EcuM_BootTarget
    operation-mappings:
      bsw-module-entry=EcuM_GetBootTarget, client-server-operation=GetBootTarget
      bsw-module-entry=EcuM_SelectBootTarget, client-server-operation=SelectBootTarget
  client server interface to bsw module entry blueprint mapping EcuM_ShutdownTarget__Mapping: client-server-interface=EcuM_ShutdownTarget
    operation-mappings:
      bsw-module-entry=EcuM_GetLastShutdownTarget, client-server-operation=GetLastShutdownTarget
      bsw-module-entry=EcuM_GetShutdownTarget, client-server-operation=GetShutdownTarget
      bsw-module-entry=EcuM_SelectShutdownTarget, client-server-operation=SelectShutdownTarget
  client server interface to bsw module entry blueprint mapping EcuM_StateRequest__Mapping: client-server-interface=EcuM_StateRequest, port-defined-argument-blueprint=EcuM_UserType
    operation-mappings:
      bsw-module-entry=EcuM_ReleasePOST_RUN, client-server-operation=ReleasePOSTRUN
      bsw-module-entry=EcuM_ReleaseRUN, client-server-operation=ReleaseRUN
      bsw-module-entry=EcuM_RequestPOST_RUN, client-server-operation=RequestPOSTRUN
      bsw-module-entry=EcuM_RequestRUN, client-server-operation=RequestRUN
package /AUTOSAR/WdgM/Mapping_Blueprint
  client server interface to bsw module entry blueprint mapping WdgM_GlobalSupervision__Mapping: client-server-interface=WdgM_GlobalSupervision
    operation-mappings:
      bsw-module-entry=WdgM_GetFirstExpiredSEID, client-server-operation=GetFirstExpiredSEID
      bsw-module-entry=WdgM_GetGlobalStatus, client-server-operation=GetGlobalStatus
      bsw-module-entry=WdgM_GetMode, client-server-operation=GetMode
      bsw-module-entry=WdgM_PerformReset, client-server-operation=PerformReset
      bsw-module-entry=WdgM_SetMode, client-server-operation=SetMode
  client server interface to bsw module entry blueprint mapping WdgM_LocalSupervision__Mapping: client-server-interface=WdgM_LocalSupervision, client-server-operation-blueprint-mapping{bsw-module-entry=WdgM_CheckpointReached, client-server-operation=CheckpointReached}, port-defined-argument-blueprints=[WdgM_SupervisedEntityIdType, WdgM_CheckpointIdType]
  client server interface to bsw module entry blueprint mapping WdgM_LocalSupervisionStatus__Mapping: client-server-interface=WdgM_LocalSupervisionStatus, client-server-operation-blueprint-mapping{bsw-module-entry=WdgM_GetLocalStatus, client-server-operation=GetLocalStatus}, port-defined-argument-blueprint=WdgM_SupervisedEntityIdType
package /AUTOSAR/StbM/Mapping_Blueprint
  5 x client server interface to bsw module entry blueprint mapping:
    GlobalTime_Master__Mapping: client-server-interface=GlobalTime_Master, port-defined-argument-blueprint=StbM_SynchronizedTimeBaseType
      operation-mappings:
        bsw-module-entry=StbM_SetGlobalTime, client-server-operation=SetGlobalTime
        bsw-module-entry=StbM_SetOffset, client-server-operation=SetOffset
        bsw-module-entry=StbM_SetRateCorrection, client-server-operation=SetRateCorrection
        bsw-module-entry=StbM_SetUserData, client-server-operation=SetUserData
        bsw-module-entry=StbM_TriggerTimeTransmission, client-server-operation=TriggerTimeTransmission
    MeasurementNotification__Mapping: client-server-interface=MeasurementNotification
      operation-mappings:
        bsw-module-entry=OffsetTimeRecordBlockCallbackTimeBase, client-server-operation=SetOffsetTimeRecordTable
        bsw-module-entry=SyncTimeRecordBlockCallbackTimeBase, client-server-operation=SetSyncTimeRecordTable
    GlobalTime_Slave__Mapping: client-server-interface=GlobalTime_Slave, port-defined-argument-blueprint=StbM_SynchronizedTimeBaseType
      operation-mappings:
        bsw-module-entry=StbM_GetCurrentTime, client-server-operation=GetCurrentTime
        bsw-module-entry=StbM_GetCurrentTimeExtended, client-server-operation=GetCurrentTimeExtended
        bsw-module-entry=StbM_GetOffsetTimeRecordHead, client-server-operation=GetOffsetTimeRecordHead
        bsw-module-entry=StbM_GetRateDeviation, client-server-operation=GetRateDeviation
        bsw-module-entry=StbM_GetSyncTimeRecordHead, client-server-operation=GetSyncTimeRecordHead
        bsw-module-entry=StbM_GetTimeBaseStatus, client-server-operation=GetTimeBaseStatus
        bsw-module-entry=StbM_GetTimeLeap, client-server-operation=GetTimeLeap
    TimeNotification__Mapping: client-server-interface=TimeNotification, client-server-operation-blueprint-mapping{bsw-module-entry=Customer_TimeNotificationCallbackTimeBase, client-server-operation=NotifyTime}
    StartTimer__Mapping: client-server-interface=StartTimer, client-server-operation-blueprint-mapping{bsw-module-entry=StbM_StartTimer, client-server-operation=StartTimer}, port-defined-argument-blueprints=[StbM_SynchronizedTimeBaseType, StbM_CustomerIdType]
package /AUTOSAR/KeyM/Mapping_Blueprint
  6 x client server interface to bsw module entry blueprint mapping:
    KeyMCertificateNotification__Mapping: client-server-interface=KeyMCertificateNotification, port-defined-argument-blueprint=KeyM_CertificateIdType
      operation-mappings:
        bsw-module-entry=KeyM_CertificateVerifyCallbackNotification, client-server-operation=CertificateVerifyCallbackNotification
        bsw-module-entry=KeyM_ServiceCertificateCallbackNotification, client-server-operation=ServiceCertificateCallbackNotification
    KeyMCertificate__Mapping: client-server-interface=KeyMCertificate, port-defined-argument-blueprint=KeyM_CertificateIdType
      operation-mappings:
        bsw-module-entry=KeyM_GetCertificate, client-server-operation=GetCertificate
        bsw-module-entry=KeyM_CertGetStatus, client-server-operation=GetStatus
        bsw-module-entry=KeyM_SetCertificate, client-server-operation=SetCertificate
        bsw-module-entry=KeyM_VerifyCertificate, client-server-operation=VerifyCertificate
    KeyMCertificateElement__Mapping: client-server-interface=KeyMCertificateElement, client-server-operation-blueprint-mapping{bsw-module-entry=KeyM_CertElementGet, client-server-operation=CertificateElementGet}, port-defined-argument-blueprints=[KeyM_CertificateIdType, KeyM_CertElementIdType]
    KeyMCertificateService__Mapping: client-server-interface=KeyMCertificateService, client-server-operation-blueprint-mapping{bsw-module-entry=KeyM_ServiceCertificate, client-server-operation=Service}
    KeyMCryptoKey__Mapping: client-server-interface=KeyMCryptoKey
      operation-mappings:
        bsw-module-entry=KeyM_Finalize, client-server-operation=Finalize
        bsw-module-entry=KeyM_Prepare, client-server-operation=Prepare
        bsw-module-entry=KeyM_Start, client-server-operation=Start
        bsw-module-entry=KeyM_Update, client-server-operation=Update
        bsw-module-entry=KeyM_Verify, client-server-operation=Verify
    KeyMCryptoKeyNotification__Mapping: client-server-interface=KeyMCryptoKeyNotification
      operation-mappings:
        bsw-module-entry=KeyM_CryptoKeyFinalizeCallbackNotification, client-server-operation=CryptoKeyFinalizeCallbackNotification
        bsw-module-entry=KeyM_CryptoKeyUpdateCallbackNotification, client-server-operation=CryptoKeyUpdateCallbackNotification
        bsw-module-entry=KeyM_CryptoKeyVerifyCallbackNotification, client-server-operation=CryptoKeyVerifyCallbackNotification
package /AUTOSAR/Csm/Mapping_Blueprint
  30 x client server interface to bsw module entry blueprint mapping:
    CallbackNotification__Mapping: client-server-interface=CallbackNotification, client-server-operation-blueprint-mapping{bsw-module-entry=Csm_CallbackNotification, client-server-operation=CallbackNotification}
    AsyncJobInterface__Mapping: client-server-interface=AsyncJobInterface, port-defined-argument-blueprints=[uint32, Crypto_OperationModeType]
      operation-mappings:
        bsw-module-entry=Csm_CancelJob, client-server-operation=CancelJob
        bsw-module-entry=Csm_Hash, client-server-operation=Hash
    AsyncJobInterface__Mapping: client-server-interface=AsyncJobInterface, port-defined-argument-blueprints=[uint32, Crypto_OperationModeType]
      operation-mappings:
        bsw-module-entry=Csm_CancelJob, client-server-operation=CancelJob
        bsw-module-entry=Csm_MacGenerate, client-server-operation=MacGenerate
    AsyncJobInterface__Mapping: client-server-interface=AsyncJobInterface, port-defined-argument-blueprints=[uint32, Crypto_OperationModeType]
      operation-mappings:
        bsw-module-entry=Csm_CancelJob, client-server-operation=CancelJob
        bsw-module-entry=Csm_MacVerify, client-server-operation=MacVerify
    AsyncJobInterface__Mapping: client-server-interface=AsyncJobInterface, port-defined-argument-blueprints=[uint32, Crypto_OperationModeType]
      operation-mappings:
        bsw-module-entry=Csm_CancelJob, client-server-operation=CancelJob
        bsw-module-entry=Csm_Encrypt, client-server-operation=Encrypt
    AsyncJobInterface__Mapping: client-server-interface=AsyncJobInterface, port-defined-argument-blueprints=[uint32, Crypto_OperationModeType]
      operation-mappings:
        bsw-module-entry=Csm_CancelJob, client-server-operation=CancelJob
        bsw-module-entry=Csm_Decrypt, client-server-operation=Decrypt
    AsyncJobInterface__Mapping: client-server-interface=AsyncJobInterface, port-defined-argument-blueprints=[uint32, Crypto_OperationModeType]
      operation-mappings:
        bsw-module-entry=Csm_AEADEncrypt, client-server-operation=AEADEncrypt
        bsw-module-entry=Csm_CancelJob, client-server-operation=CancelJob
    AsyncJobInterface__Mapping: client-server-interface=AsyncJobInterface, port-defined-argument-blueprints=[uint32, Crypto_OperationModeType]
      operation-mappings:
        bsw-module-entry=Csm_AEADDecrypt, client-server-operation=AEADDecrypt
        bsw-module-entry=Csm_CancelJob, client-server-operation=CancelJob
    AsyncJobInterface__Mapping: client-server-interface=AsyncJobInterface, port-defined-argument-blueprints=[uint32, Crypto_OperationModeType]
      operation-mappings:
        bsw-module-entry=Csm_CancelJob, client-server-operation=CancelJob
        bsw-module-entry=Csm_SignatureGenerate, client-server-operation=SignatureGenerate
    AsyncJobInterface__Mapping: client-server-interface=AsyncJobInterface, port-defined-argument-blueprints=[uint32, Crypto_OperationModeType]
      operation-mappings:
        bsw-module-entry=Csm_CancelJob, client-server-operation=CancelJob
        bsw-module-entry=Csm_SignatureVerify, client-server-operation=SignatureVerify
    AsyncJobInterface__Mapping: client-server-interface=AsyncJobInterface, port-defined-argument-blueprints=[uint32, Crypto_OperationModeType]
      operation-mappings:
        bsw-module-entry=Csm_CancelJob, client-server-operation=CancelJob
        bsw-module-entry=Csm_RandomGenerate, client-server-operation=RandomGenerate
    AsyncJobInterface__Mapping: client-server-interface=AsyncJobInterface, port-defined-argument-blueprints=[uint32, Crypto_OperationModeType]
      operation-mappings:
        bsw-module-entry=Csm_CancelJob, client-server-operation=CancelJob
        bsw-module-entry=Csm_JobCertificateParse, client-server-operation=CertificateParse
    AsyncJobInterface__Mapping: client-server-interface=AsyncJobInterface, port-defined-argument-blueprints=[uint32, Crypto_OperationModeType]
      operation-mappings:
        bsw-module-entry=Csm_CancelJob, client-server-operation=CancelJob
        bsw-module-entry=Csm_JobCertificateVerify, client-server-operation=CertificateVerify
    AsyncJobInterface__Mapping: client-server-interface=AsyncJobInterface, port-defined-argument-blueprints=[uint32, Crypto_OperationModeType]
      operation-mappings:
        bsw-module-entry=Csm_CancelJob, client-server-operation=CancelJob
        bsw-module-entry=Csm_JobKeyDerive, client-server-operation=KeyDerive
    AsyncJobInterface__Mapping: client-server-interface=AsyncJobInterface, port-defined-argument-blueprints=[uint32, Crypto_OperationModeType]
      operation-mappings:
        bsw-module-entry=Csm_CancelJob, client-server-operation=CancelJob
        bsw-module-entry=Csm_JobKeyExchangeCalcPubVal, client-server-operation=KeyExchangeCalcPubVal
    AsyncJobInterface__Mapping: client-server-interface=AsyncJobInterface, port-defined-argument-blueprints=[uint32, Crypto_OperationModeType]
      operation-mappings:
        bsw-module-entry=Csm_CancelJob, client-server-operation=CancelJob
        bsw-module-entry=Csm_JobKeyExchangeCalcSecret, client-server-operation=KeyExchangeCalcSecret
    AsyncJobInterface__Mapping: client-server-interface=AsyncJobInterface, port-defined-argument-blueprints=[uint32, Crypto_OperationModeType]
      operation-mappings:
        bsw-module-entry=Csm_CancelJob, client-server-operation=CancelJob
        bsw-module-entry=Csm_JobKeyGenerate, client-server-operation=KeyGenerate
    AsyncJobInterface__Mapping: client-server-interface=AsyncJobInterface, port-defined-argument-blueprints=[uint32, Crypto_OperationModeType]
      operation-mappings:
        bsw-module-entry=Csm_CancelJob, client-server-operation=CancelJob
        bsw-module-entry=Csm_JobKeySetValid, client-server-operation=KeySetValid
    AsyncJobInterface__Mapping: client-server-interface=AsyncJobInterface, port-defined-argument-blueprints=[uint32, Crypto_OperationModeType]
      operation-mappings:
        bsw-module-entry=Csm_CancelJob, client-server-operation=CancelJob
        bsw-module-entry=Csm_JobRandomSeed, client-server-operation=RandomSeed
    SyncJobInterface__Mapping: client-server-interface=SyncJobInterface, client-server-operation-blueprint-mapping{bsw-module-entry=Csm_Hash, client-server-operation=Hash}, port-defined-argument-blueprints=[uint32, Crypto_OperationModeType]
    SyncJobInterface__Mapping: client-server-interface=SyncJobInterface, client-server-operation-blueprint-mapping{bsw-module-entry=Csm_MacGenerate, client-server-operation=MacGenerate}, port-defined-argument-blueprints=[uint32, Crypto_OperationModeType]
    SyncJobInterface__Mapping: client-server-interface=SyncJobInterface, client-server-operation-blueprint-mapping{bsw-module-entry=Csm_MacVerify, client-server-operation=MacVerify}, port-defined-argument-blueprints=[uint32, Crypto_OperationModeType]
    SyncJobInterface__Mapping: client-server-interface=SyncJobInterface, client-server-operation-blueprint-mapping{bsw-module-entry=Csm_Encrypt, client-server-operation=Encrypt}, port-defined-argument-blueprints=[uint32, Crypto_OperationModeType]
    SyncJobInterface__Mapping: client-server-interface=SyncJobInterface, client-server-operation-blueprint-mapping{bsw-module-entry=Csm_Decrypt, client-server-operation=Decrypt}, port-defined-argument-blueprints=[uint32, Crypto_OperationModeType]
    SyncJobInterface__Mapping: client-server-interface=SyncJobInterface, client-server-operation-blueprint-mapping{bsw-module-entry=Csm_AEADEncrypt, client-server-operation=AEADEncrypt}, port-defined-argument-blueprints=[uint32, Crypto_OperationModeType]
    SyncJobInterface__Mapping: client-server-interface=SyncJobInterface, client-server-operation-blueprint-mapping{bsw-module-entry=Csm_AEADDecrypt, client-server-operation=AEADDecrypt}, port-defined-argument-blueprints=[uint32, Crypto_OperationModeType]
    SyncJobInterface__Mapping: client-server-interface=SyncJobInterface, client-server-operation-blueprint-mapping{bsw-module-entry=Csm_SignatureGenerate, client-server-operation=SignatureGenerate}, port-defined-argument-blueprints=[uint32, Crypto_OperationModeType]
    SyncJobInterface__Mapping: client-server-interface=SyncJobInterface, client-server-operation-blueprint-mapping{bsw-module-entry=Csm_SignatureVerify, client-server-operation=SignatureVerify}, port-defined-argument-blueprints=[uint32, Crypto_OperationModeType]
    SyncJobInterface__Mapping: client-server-interface=SyncJobInterface, client-server-operation-blueprint-mapping{bsw-module-entry=Csm_RandomGenerate, client-server-operation=RandomGenerate}, port-defined-argument-blueprints=[uint32, Crypto_OperationModeType]
    CsmKeyManagement__Mapping: client-server-interface=CsmKeyManagement, port-defined-argument-blueprint=uint32
      operation-mappings:
        bsw-module-entry=Csm_CertificateParse, client-server-operation=CertificateParse
        bsw-module-entry=Csm_CertificateVerify, client-server-operation=CertificateVerify
        bsw-module-entry=Csm_KeyCopy, client-server-operation=KeyCopy
        bsw-module-entry=Csm_KeyDerive, client-server-operation=KeyDerive
        bsw-module-entry=Csm_KeyElementCopy, client-server-operation=KeyElementCopy
        bsw-module-entry=Csm_KeyElementCopyPartial, client-server-operation=KeyElementCopyPartial
        bsw-module-entry=Csm_KeyElementGet, client-server-operation=KeyElementGet
        bsw-module-entry=Csm_KeyElementSet, client-server-operation=KeyElementSet
        bsw-module-entry=Csm_KeyExchangeCalcPubVal, client-server-operation=KeyExchangeCalcPubVal
        bsw-module-entry=Csm_KeyExchangeCalcSecret, client-server-operation=KeyExchangeCalcSecret
        bsw-module-entry=Csm_KeyGenerate, client-server-operation=KeyGenerate
        bsw-module-entry=Csm_KeySetValid, client-server-operation=KeySetValid
        bsw-module-entry=Csm_RandomSeed, client-server-operation=RandomSeed
package /AUTOSAR/Mirror/Mapping_Blueprint
  client server interface to bsw module entry blueprint mapping MirrorControl__Mapping: client-server-interface=MirrorControl
    operation-mappings:
      bsw-module-entry=Mirror_AddCanMaskFilter, client-server-operation=AddCanMaskFilter
      bsw-module-entry=Mirror_AddCanRangeFilter, client-server-operation=AddCanRangeFilter
      bsw-module-entry=Mirror_AddFlexRayFilter, client-server-operation=AddFlexRayFilter
      bsw-module-entry=Mirror_AddLinMaskFilter, client-server-operation=AddLinMaskFilter
      bsw-module-entry=Mirror_AddLinRangeFilter, client-server-operation=AddLinRangeFilter
      bsw-module-entry=Mirror_GetDestNetwork, client-server-operation=GetDestNetwork
      bsw-module-entry=Mirror_GetNetworkHandle, client-server-operation=GetNetworkHandle
      bsw-module-entry=Mirror_GetNetworkId, client-server-operation=GetNetworkId
      bsw-module-entry=Mirror_GetNetworkType, client-server-operation=GetNetworkType
      bsw-module-entry=Mirror_GetStaticFilterState, client-server-operation=GetStaticFilterState
      bsw-module-entry=Mirror_IsMirrorActive, client-server-operation=IsMirrorActive
      bsw-module-entry=Mirror_IsSourceNetworkStarted, client-server-operation=IsSourceNetworkStarted
      bsw-module-entry=Mirror_Offline, client-server-operation=Offline
      bsw-module-entry=Mirror_RemoveFilter, client-server-operation=RemoveFilter
      bsw-module-entry=Mirror_SetStaticFilterState, client-server-operation=SetStaticFilterState
      bsw-module-entry=Mirror_StartSourceNetwork, client-server-operation=StartSourceNetwork
      bsw-module-entry=Mirror_StopSourceNetwork, client-server-operation=StopSourceNetwork
      bsw-module-entry=Mirror_SwitchDestNetwork, client-server-operation=SwitchDestNetwork
package /AUTOSAR/DoIP/Mapping_Blueprint
  5 x client server interface to bsw module entry blueprint mapping:
    CallbackGetFurtherActionByte__Mapping: client-server-interface=CallbackGetFurtherActionByte, client-server-operation-blueprint-mapping{bsw-module-entry=DoIPGetFurtherActionByteCallback, client-server-operation=GetFurtherActionByte}
    CallbackGetGID__Mapping: client-server-interface=CallbackGetGID, client-server-operation-blueprint-mapping{bsw-module-entry=DoIPGetGidCallback, client-server-operation=GetGID}
    CallbackGetPowerMode__Mapping: client-server-interface=CallbackGetPowerMode, client-server-operation-blueprint-mapping{bsw-module-entry=DoIPGetPowerModeCallback, client-server-operation=GetPowerMode}
    CallbackTriggerGIDSynchronization__Mapping: client-server-interface=CallbackTriggerGIDSynchronization, client-server-operation-blueprint-mapping{bsw-module-entry=DoIPTriggerGidSyncCallback, client-server-operation=TriggerGIDSynchronization}
    RoutingActivation__Mapping: client-server-interface=RoutingActivation
      operation-mappings:
        bsw-module-entry=DoIPRoutingActivationAuthentication, client-server-operation=RoutingActivationAuthentication
        bsw-module-entry=DoIPRoutingActivationConfirmation, client-server-operation=RoutingActivationConfirmation
package /AUTOSAR/J1939Rm/Mapping_Blueprint
  client server interface to bsw module entry blueprint mapping AppCancelRequestTimeout__Mapping: client-server-interface=AppCancelRequestTimeout, client-server-operation-blueprint-mapping{bsw-module-entry=J1939Rm_CancelRequestTimeout, client-server-operation=CancelRequestTimeout}, port-defined-argument-blueprint=uint8
  client server interface to bsw module entry blueprint mapping AppSendAck__Mapping: client-server-interface=AppSendAck, client-server-operation-blueprint-mapping{bsw-module-entry=J1939Rm_SendAck, client-server-operation=SendAck}, port-defined-argument-blueprint=uint8
  client server interface to bsw module entry blueprint mapping AppSendRequest__Mapping: client-server-interface=AppSendRequest, client-server-operation-blueprint-mapping{bsw-module-entry=J1939Rm_SendRequest, client-server-operation=SendRequest}, port-defined-argument-blueprint=uint8
package /AUTOSAR/SecOC/Mapping_Blueprint
  client server interface to bsw module entry blueprint mapping FreshnessManagement__Mapping: client-server-interface=FreshnessManagement
    operation-mappings:
      bsw-module-entry=SecOC_GetRxFreshness, client-server-operation=GetRxFreshness
      bsw-module-entry=SecOC_GetRxFreshnessAuthData, client-server-operation=GetRxFreshnessAuthData
      bsw-module-entry=SecOC_GetTxFreshness, client-server-operation=GetTxFreshness
      bsw-module-entry=SecOC_GetTxFreshnessTruncData, client-server-operation=GetTxFreshnessTruncData
      bsw-module-entry=SecOC_SPduTxConfirmation, client-server-operation=SPduTxConfirmation
  client server interface to bsw module entry blueprint mapping SendDefaultAuthenticationInformation__Mapping: client-server-interface=SendDefaultAuthenticationInformation
    operation-mappings:
      bsw-module-entry=SecOC_GetRxFreshness, client-server-operation=SendDefaultAuthenticationInformation
      bsw-module-entry=SecOC_SendDefaultAuthenticationInformation, client-server-operation=SendDefaultAuthenticationInformation
  client server interface to bsw module entry blueprint mapping VerifyStatusConfiguration__Mapping: client-server-interface=VerifyStatusConfiguration, client-server-operation-blueprint-mapping{bsw-module-entry=SecOC_VerifyStatusOverride, client-server-operation=VerifyStatusOverride}
package /AUTOSAR/Dcm/Mapping_Blueprint
  11 x client server interface to bsw module entry blueprint mapping:
    Authentication__Mapping: client-server-interface=Authentication, client-server-operation-blueprint-mapping{bsw-module-entry=Dcm_SetDeauthenticatedRole, client-server-operation=SetDeauthenticatedRole}, port-defined-argument-blueprint=uint16
    CallbackDCMRequestServices__Mapping: client-server-interface=CallbackDCMRequestServices
      operation-mappings:
        bsw-module-entry=StartProtocol, client-server-operation=StartProtocol
        bsw-module-entry=StopProtocol, client-server-operation=StopProtocol
    DataServices_DIDRange__Mapping: client-server-interface=DataServices_DIDRange
      operation-mappings:
        bsw-module-entry=IsDidAvailableAsynch, client-server-operation=IsDidAvailable
        bsw-module-entry=ReadDidData, client-server-operation=ReadDidData
        bsw-module-entry=ReadDidRangeDataLength, client-server-operation=ReadDidRangeDataLength
        bsw-module-entry=WriteDidData, client-server-operation=WriteDidData
    DCM_Roe__Mapping: client-server-interface=DCM_Roe, client-server-operation-blueprint-mapping{bsw-module-entry=Dcm_TriggerOnEvent, client-server-operation=TriggerOnEvent}, port-defined-argument-blueprint=uint8
    DCMServices__Mapping: client-server-interface=DCMServices
      operation-mappings:
        bsw-module-entry=Dcm_GetActiveProtocol, client-server-operation=GetActiveProtocol
        bsw-module-entry=Dcm_GetSecurityLevel, client-server-operation=GetSecurityLevel
        bsw-module-entry=Dcm_GetSesCtrlType, client-server-operation=GetSesCtrlType
        bsw-module-entry=Dcm_ResetToDefaultSession, client-server-operation=ResetToDefaultSession
        bsw-module-entry=Dcm_SetActiveDiagnostic, client-server-operation=SetActiveDiagnostic
    InfotypeServices__Mapping: client-server-interface=InfotypeServices, client-server-operation-blueprint-mapping{bsw-module-entry=GetInfotypeValueData, client-server-operation=GetInfotypeValueData}
    RequestControlServices__Mapping: client-server-interface=RequestControlServices, client-server-operation-blueprint-mapping{bsw-module-entry=RequestControl, client-server-operation=RequestControl}
    RequestFileTransfer__Mapping: client-server-interface=RequestFileTransfer
      operation-mappings:
        bsw-module-entry=Dcm_ProcessRequestAddFile, client-server-operation=ProcessRequestAddFile
        bsw-module-entry=Dcm_ProcessRequestDeleteFile, client-server-operation=ProcessRequestDeleteFile
        bsw-module-entry=Dcm_ProcessRequestReadDir, client-server-operation=ProcessRequestReadDir
        bsw-module-entry=Dcm_ProcessRequestReadFile, client-server-operation=ProcessRequestReadFile
        bsw-module-entry=Dcm_ProcessRequestReplaceFile, client-server-operation=ProcessRequestReplaceFile
        bsw-module-entry=Dcm_ReadFileOrDir, client-server-operation=ReadFileOrDir
        bsw-module-entry=Dcm_WriteFile, client-server-operation=WriteFile
    ServiceRequestNotification__Mapping: client-server-interface=ServiceRequestNotification
      operation-mappings:
        bsw-module-entry=Confirmation, client-server-operation=Confirmation
        bsw-module-entry=Indication, client-server-operation=Indication
    SecurityAccess__Mapping: client-server-interface=SecurityAccess
      operation-mappings:
        bsw-module-entry=GetSecurityAttemptCounter, client-server-operation=GetSecurityAttemptCounter
        bsw-module-entry=SetSecurityAttemptCounter, client-server-operation=SetSecurityAttemptCounter
    UploadDownloadServices__Mapping: client-server-interface=UploadDownloadServices
      operation-mappings:
        bsw-module-entry=ProcessRequestDownload, client-server-operation=ProcessRequestDownload
        bsw-module-entry=ProcessRequestTransferExit, client-server-operation=ProcessRequestTransferExit
        bsw-module-entry=ProcessRequestUpload, client-server-operation=ProcessRequestUpload
        bsw-module-entry=ProcessTransferDataRead, client-server-operation=ProcessTransferDataRead
        bsw-module-entry=ProcessTransferDataWrite, client-server-operation=ProcessTransferDataWrite
package /AUTOSAR/NvM/Mapping_Blueprint
  client server interface to bsw module entry blueprint mapping NvMAdmin__Mapping: client-server-interface=NvMAdmin, client-server-operation-blueprint-mapping{bsw-module-entry=NvM_SetBlockProtection, client-server-operation=SetBlockProtection}, port-defined-argument-blueprint=NvM_BlockIdType
  client server interface to bsw module entry blueprint mapping NvMMirror__Mapping: client-server-interface=NvMMirror
    operation-mappings:
      bsw-module-entry=NvM_ReadRamBlockFromNvm, client-server-operation=ReadRamBlockFromNvM
      bsw-module-entry=NvM_WriteRamBlockToNvm, client-server-operation=WriteRamBlockToNvM
  client server interface to bsw module entry blueprint mapping NvMService__Mapping: client-server-interface=NvMService, port-defined-argument-blueprint=NvM_BlockIdType
    operation-mappings:
      bsw-module-entry=NvM_EraseNvBlock, client-server-operation=EraseBlock
      bsw-module-entry=NvM_GetDataIndex, client-server-operation=GetDataIndex
      bsw-module-entry=NvM_GetErrorStatus, client-server-operation=GetErrorStatus
      bsw-module-entry=NvM_InvalidateNvBlock, client-server-operation=InvalidateNvBlock
      bsw-module-entry=NvM_ReadBlock, client-server-operation=ReadBlock
      bsw-module-entry=NvM_RestoreBlockDefaults, client-server-operation=RestoreBlockDefaults
      bsw-module-entry=NvM_SetDataIndex, client-server-operation=SetDataIndex
      bsw-module-entry=NvM_SetRamBlockStatus, client-server-operation=SetRamBlockStatus
      bsw-module-entry=NvM_WriteBlock, client-server-operation=WriteBlock
