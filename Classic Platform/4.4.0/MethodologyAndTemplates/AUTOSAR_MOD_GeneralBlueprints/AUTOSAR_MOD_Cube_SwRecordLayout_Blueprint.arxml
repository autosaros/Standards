AUTOSAR XML (schema 00046)
package /AUTOSAR/GenDef/SwRecordLayouts_Blueprint
  4 x sw record layout:
    Cuboid_s16s16s16_s16: sw-record-layout-group={sw-record-layout-v={short-label=Nx, base-type=sint16, sw-record-layout-v-axis=1, sw-record-layout-v-prop=COUNT}, sw-record-layout-v={short-label=Ny, base-type=sint16, sw-record-layout-v-axis=2, sw-record-layout-v-prop=COUNT}, sw-record-layout-v={short-label=Nz, base-type=sint16, sw-record-layout-v-axis=3, sw-record-layout-v-prop=COUNT}, sw-record-layout-group={short-label=X, category=INDEX_INCR, sw-record-layout-group-axis=1, sw-record-layout-group-index=X, sw-record-layout-group-from=1, sw-record-layout-group-to=-1, sw-record-layout-v={base-type=sint16, sw-record-layout-v-axis=1, sw-record-layout-v-prop=VALUE}}, sw-record-layout-group={short-label=Y, category=INDEX_INCR, sw-record-layout-group-axis=2, sw-record-layout-group-index=Y, sw-record-layout-group-from=1, sw-record-layout-group-to=-1, sw-record-layout-v={base-type=sint16, sw-record-layout-v-axis=2, sw-record-layout-v-prop=VALUE}}, sw-record-layout-group={short-label=Z, category=INDEX_INCR, sw-record-layout-group-axis=3, sw-record-layout-group-index=Z, sw-record-layout-group-from=1, sw-record-layout-group-to=-1, sw-record-layout-v={base-type=sint16, sw-record-layout-v-axis=3, sw-record-layout-v-prop=VALUE}}, sw-record-layout-group={short-label=Val, category=COLUMN_DIR, sw-record-layout-group-axis=3, sw-record-layout-group-index=Z, sw-record-layout-group-from=1, sw-record-layout-group-to=-1, sw-record-layout-group={category=COLUMN_DIR, sw-record-layout-group-axis=1, sw-record-layout-group-index=X, sw-record-layout-group-from=1, sw-record-layout-group-to=-1, sw-record-layout-group={sw-record-layout-group-axis=2, sw-record-layout-group-index=Y, sw-record-layout-group-from=1, sw-record-layout-group-to=-1, sw-record-layout-v={base-type=sint16, sw-record-layout-v-axis=0, sw-record-layout-v-prop=VALUE, sw-record-layout-v-index=Z X Y}}}}}
    Cuboid_s8s8s8_s16: sw-record-layout-group={sw-record-layout-v={short-label=Nx, base-type=sint8, sw-record-layout-v-axis=1, sw-record-layout-v-prop=COUNT}, sw-record-layout-v={short-label=Ny, base-type=sint8, sw-record-layout-v-axis=2, sw-record-layout-v-prop=COUNT}, sw-record-layout-v={short-label=Nz, base-type=sint8, sw-record-layout-v-axis=3, sw-record-layout-v-prop=COUNT}, sw-record-layout-group={short-label=X, category=INDEX_INCR, sw-record-layout-group-axis=1, sw-record-layout-group-index=X, sw-record-layout-group-from=1, sw-record-layout-group-to=-1, sw-record-layout-v={base-type=sint8, sw-record-layout-v-axis=1, sw-record-layout-v-prop=VALUE}}, sw-record-layout-group={short-label=Y, category=INDEX_INCR, sw-record-layout-group-axis=2, sw-record-layout-group-index=Y, sw-record-layout-group-from=1, sw-record-layout-group-to=-1, sw-record-layout-v={base-type=sint16, sw-record-layout-v-axis=2, sw-record-layout-v-prop=VALUE}}, sw-record-layout-group={short-label=Z, category=INDEX_INCR, sw-record-layout-group-axis=3, sw-record-layout-group-index=Z, sw-record-layout-group-from=1, sw-record-layout-group-to=-1, sw-record-layout-v={base-type=sint16, sw-record-layout-v-axis=3, sw-record-layout-v-prop=VALUE}}, sw-record-layout-group={short-label=Val, category=ROW_DIR, sw-record-layout-group-axis=3, sw-record-layout-group-index=Z, sw-record-layout-group-from=1, sw-record-layout-group-to=-1, sw-record-layout-group={category=ROW_DIR, sw-record-layout-group-axis=2, sw-record-layout-group-index=Y, sw-record-layout-group-from=1, sw-record-layout-group-to=-1, sw-record-layout-group={sw-record-layout-group-axis=1, sw-record-layout-group-index=X, sw-record-layout-group-from=1, sw-record-layout-group-to=-1, sw-record-layout-v={base-type=sint16, sw-record-layout-v-axis=0, sw-record-layout-v-prop=VALUE, sw-record-layout-v-index=Z X Y}}}}}
    Cube_4_s16s16s16s16_s16: sw-record-layout-group={sw-record-layout-v={short-label=Nx, base-type=sint16, sw-record-layout-v-axis=1, sw-record-layout-v-prop=COUNT}, sw-record-layout-v={short-label=Ny, base-type=sint16, sw-record-layout-v-axis=2, sw-record-layout-v-prop=COUNT}, sw-record-layout-v={short-label=Nz1, base-type=sint16, sw-record-layout-v-axis=3, sw-record-layout-v-prop=COUNT}, sw-record-layout-v={short-label=Nz2, base-type=sint16, sw-record-layout-v-axis=4, sw-record-layout-v-prop=COUNT}, sw-record-layout-group={short-label=X, category=INDEX_INCR, sw-record-layout-group-axis=1, sw-record-layout-group-index=X, sw-record-layout-group-from=1, sw-record-layout-group-to=-1, sw-record-layout-v={base-type=sint16, sw-record-layout-v-axis=1, sw-record-layout-v-prop=VALUE}}, sw-record-layout-group={short-label=Y, category=INDEX_INCR, sw-record-layout-group-axis=2, sw-record-layout-group-index=Y, sw-record-layout-group-from=1, sw-record-layout-group-to=-1, sw-record-layout-v={base-type=sint16, sw-record-layout-v-axis=2, sw-record-layout-v-prop=VALUE}}, sw-record-layout-group={short-label=Z1, category=INDEX_INCR, sw-record-layout-group-axis=3, sw-record-layout-group-index=Z1, sw-record-layout-group-from=1, sw-record-layout-group-to=-1, sw-record-layout-v={base-type=sint16, sw-record-layout-v-axis=3, sw-record-layout-v-prop=VALUE}}, sw-record-layout-group={short-label=Z2, category=INDEX_INCR, sw-record-layout-group-axis=4, sw-record-layout-group-index=Z2, sw-record-layout-group-from=1, sw-record-layout-group-to=-1, sw-record-layout-v={base-type=sint16, sw-record-layout-v-axis=4, sw-record-layout-v-prop=VALUE}}, sw-record-layout-group={short-label=Val, category=COLUMN_DIR, sw-record-layout-group-axis=4, sw-record-layout-group-index=Z2, sw-record-layout-group-from=1, sw-record-layout-group-to=-1, sw-record-layout-group={category=COLUMN_DIR, sw-record-layout-group-axis=3, sw-record-layout-group-index=Z1, sw-record-layout-group-from=1, sw-record-layout-group-to=-1, sw-record-layout-group={category=COLUMN_DIR, sw-record-layout-group-axis=1, sw-record-layout-group-index=X, sw-record-layout-group-from=1, sw-record-layout-group-to=-1, sw-record-layout-group={sw-record-layout-group-axis=2, sw-record-layout-group-index=Y, sw-record-layout-group-from=1, sw-record-layout-group-to=-1, sw-record-layout-v={base-type=sint16, sw-record-layout-v-axis=0, sw-record-layout-v-prop=VALUE, sw-record-layout-v-index=Z2 Z1 X Y}}}}}}
    Cube_5_u8s16s16s16s16_s16: sw-record-layout-group={sw-record-layout-v={short-label=Nx, base-type=sint8, sw-record-layout-v-axis=1, sw-record-layout-v-prop=COUNT}, sw-record-layout-v={short-label=Ny, base-type=sint16, sw-record-layout-v-axis=2, sw-record-layout-v-prop=COUNT}, sw-record-layout-v={short-label=Nz1, base-type=sint16, sw-record-layout-v-axis=3, sw-record-layout-v-prop=COUNT}, sw-record-layout-v={short-label=Nz2, base-type=sint16, sw-record-layout-v-axis=4, sw-record-layout-v-prop=COUNT}, sw-record-layout-v={short-label=Nz3, base-type=sint16, sw-record-layout-v-axis=5, sw-record-layout-v-prop=COUNT}, sw-record-layout-group={short-label=X, category=INDEX_INCR, sw-record-layout-group-axis=1, sw-record-layout-group-index=X, sw-record-layout-group-from=1, sw-record-layout-group-to=-1, sw-record-layout-v={base-type=sint8, sw-record-layout-v-axis=1, sw-record-layout-v-prop=VALUE}}, sw-record-layout-group={short-label=Y, category=INDEX_INCR, sw-record-layout-group-axis=2, sw-record-layout-group-index=Y, sw-record-layout-group-from=1, sw-record-layout-group-to=-1, sw-record-layout-v={base-type=sint16, sw-record-layout-v-axis=2, sw-record-layout-v-prop=VALUE}}, sw-record-layout-group={short-label=Z1, category=INDEX_INCR, sw-record-layout-group-axis=3, sw-record-layout-group-index=Z1, sw-record-layout-group-from=1, sw-record-layout-group-to=-1, sw-record-layout-v={base-type=sint16, sw-record-layout-v-axis=3, sw-record-layout-v-prop=VALUE}}, sw-record-layout-group={short-label=Z2, category=INDEX_INCR, sw-record-layout-group-axis=4, sw-record-layout-group-index=Z2, sw-record-layout-group-from=1, sw-record-layout-group-to=-1, sw-record-layout-v={base-type=sint16, sw-record-layout-v-axis=4, sw-record-layout-v-prop=VALUE}}, sw-record-layout-group={short-label=Z3, category=INDEX_INCR, sw-record-layout-group-axis=5, sw-record-layout-group-index=Z3, sw-record-layout-group-from=1, sw-record-layout-group-to=-1, sw-record-layout-v={base-type=sint16, sw-record-layout-v-axis=5, sw-record-layout-v-prop=VALUE}}, sw-record-layout-group={short-label=Val, category=COLUMN_DIR, sw-record-layout-group-axis=5, sw-record-layout-group-index=Z3, sw-record-layout-group-from=1, sw-record-layout-group-to=-1, sw-record-layout-group={category=COLUMN_DIR, sw-record-layout-group-axis=4, sw-record-layout-group-index=Z2, sw-record-layout-group-from=1, sw-record-layout-group-to=-1, sw-record-layout-group={category=COLUMN_DIR, sw-record-layout-group-axis=3, sw-record-layout-group-index=Z1, sw-record-layout-group-from=1, sw-record-layout-group-to=-1, sw-record-layout-group={category=COLUMN_DIR, sw-record-layout-group-axis=1, sw-record-layout-group-index=X, sw-record-layout-group-from=1, sw-record-layout-group-to=-1, sw-record-layout-group={sw-record-layout-group-axis=2, sw-record-layout-group-index=Y, sw-record-layout-group-from=1, sw-record-layout-group-to=-1, sw-record-layout-v={base-type=sint16, sw-record-layout-v-axis=0, sw-record-layout-v-prop=VALUE, sw-record-layout-v-index=Z3 Z2 Z1 X Y}}}}}}}
