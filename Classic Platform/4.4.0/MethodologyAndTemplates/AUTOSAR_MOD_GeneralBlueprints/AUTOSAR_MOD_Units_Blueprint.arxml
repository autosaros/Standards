AUTOSAR XML (schema 00046)
package /AUTOSAR/AUTOSAR_PhysicalUnits/Units_Blueprints
  164 x unit:
    Ampr: display-name=A, factor-si-to-unit=1.0, offset-si-to-unit=0.0, physical-dimension=I1  # Ampere
    AmprPerSec: display-name=A/s, factor-si-to-unit=1.0, offset-si-to-unit=0.0, physical-dimension=TiNeg1I1  # Ampere Per Second
    AmprSec: display-name=As, factor-si-to-unit=1.0, offset-si-to-unit=0.0, physical-dimension=T1I1  # Amperesecond
    Bar: display-name=bar, factor-si-to-unit=1.0E-5, offset-si-to-unit=0.0, physical-dimension=LenNeg1M1TiNeg2
    BarPerSec: display-name=bar/s, factor-si-to-unit=1.0E-5, offset-si-to-unit=0.0, physical-dimension=LenNeg1M1TiNeg3  # Bar Per Second
    Bel: display-name=B, factor-si-to-unit=1.0, offset-si-to-unit=0.0, physical-dimension=NoDimension_5
    Bit: display-name=bit, factor-si-to-unit=1.0, offset-si-to-unit=0.0, physical-dimension=NoDimension_6
    BitPerSec: display-name=bit/s, factor-si-to-unit=1.0, offset-si-to-unit=0.0, physical-dimension=TiNeg1_3  # Bit Per Second
    BytPerSec: display-name=Byte/s, factor-si-to-unit=0.125, offset-si-to-unit=0.0, physical-dimension=TiNeg1_3  # Byte Per Second
    Byte: display-name=Byte, factor-si-to-unit=0.125, offset-si-to-unit=0.0, physical-dimension=NoDimension_6
    Cd: display-name=cd, factor-si-to-unit=1.0, offset-si-to-unit=0.0, physical-dimension=Illmn1  # Candela
    CentiMtr: display-name=cm, factor-si-to-unit=100.0, offset-si-to-unit=0.0, physical-dimension=Len1  # Centimeter
    CentiMtrSqd: display-name=cm^2, factor-si-to-unit=10000.0, offset-si-to-unit=0.0, physical-dimension=Len2  # Squarecentimeter
    Coulomb: display-name=C, factor-si-to-unit=1.0, offset-si-to-unit=0.0, physical-dimension=T1I1
    Day: display-name=d, factor-si-to-unit=1.15740740740741E-5, offset-si-to-unit=0.0, physical-dimension=Ti1
    DeciBel: display-name=dB, factor-si-to-unit=10.0, offset-si-to-unit=0.0, physical-dimension=NoDimension_5  # Decibel
    Deg: display-name=°, factor-si-to-unit=360.0, offset-si-to-unit=0.0, physical-dimension=NoDimension_2  # Degree
    DegCgrd: display-name=°C, factor-si-to-unit=1.0, offset-si-to-unit=-273.15, physical-dimension=T1  # Degree Celsius (Absolute Temperature)
    DegPerSec: display-name=°/s, factor-si-to-unit=360.0, offset-si-to-unit=0.0, physical-dimension=TiNeg1_2  # Degree Per Sec
    Frd: display-name=F, factor-si-to-unit=1.0, offset-si-to-unit=0.0, physical-dimension=LenNeg2MNeg1Ti4I2  # Farad
    Gr: display-name=g, factor-si-to-unit=1000.0, offset-si-to-unit=0.0, physical-dimension=M1  # Gram
    GrPerLtr: display-name=g/l, factor-si-to-unit=1.0, offset-si-to-unit=0.0, physical-dimension=LenNeg3M1  # Gram Per Liter
    GrPerMol: display-name=g/mol, factor-si-to-unit=1000.0, offset-si-to-unit=0.0, physical-dimension=M1AmntNeg1  # Gram Per Mole
    GrPerSec: display-name=g/s, factor-si-to-unit=1000.0, offset-si-to-unit=0.0, physical-dimension=M1TiNeg1  # Gram Per Second
    HectoPa: display-name=hPa, factor-si-to-unit=0.01, offset-si-to-unit=0.0, physical-dimension=LenNeg1M1TiNeg2  # Hectopascal
    HectoPaPerSec: display-name=hPa/s, factor-si-to-unit=0.01, offset-si-to-unit=0.0, physical-dimension=LenNeg1M1TiNeg3  # Hecto-Pascal Per Second
    HectoPaPerVolt: display-name=hPa/V, factor-si-to-unit=0.01, offset-si-to-unit=0.0, physical-dimension=LenNeg3Ti1I1_1  # Hecto Pascal Per Volt
    HectoPaSecPerMtrCubd: display-name=hPa/((m^3)/s), factor-si-to-unit=0.01, offset-si-to-unit=0.0, physical-dimension=LenNeg4M1TiNeg1  # Hectopascal Second Per Cubicmeter
    Henry: display-name=H, factor-si-to-unit=1.0, offset-si-to-unit=0.0, physical-dimension=Len2M1TiNeg2INeg2
    HenryPerMtr: display-name=H/m, factor-si-to-unit=1.0, offset-si-to-unit=0.0, physical-dimension=Len1M1TiNeg2INeg2  # Henry Per Meter
    Hr: display-name=h, factor-si-to-unit=2.77777777777778E-4, offset-si-to-unit=0.0, physical-dimension=Ti1  # Hour
    Hz: display-name=Hz, factor-si-to-unit=1.0, offset-si-to-unit=0.0, physical-dimension=TiNeg1  # Hertz
    Jou: display-name=J, factor-si-to-unit=1.0, offset-si-to-unit=0.0, physical-dimension=Len2M1TiNeg2_1  # Joule
    JouPerKelvin: display-name=J/K, factor-si-to-unit=1.0, offset-si-to-unit=0.0, physical-dimension=Len2M1TiNeg2TNeg1  # Joule Per Kelvin
    JouPerKiloGr: display-name=J/kg, factor-si-to-unit=1.0, offset-si-to-unit=0.0, physical-dimension=Len2TiNeg2  # Joule Per Kilogram
    JouPerKiloGrPerKelvin: display-name=J/(kg*K), factor-si-to-unit=1.0, offset-si-to-unit=0.0, physical-dimension=Len2TiNeg2TNeg1  # Joule Per Kilogram PerKelvin
    JouPerMol: display-name=J/mol, factor-si-to-unit=1.0, offset-si-to-unit=0.0, physical-dimension=Len2M1TiNeg2AmntNeg1  # Joule Per Mole
    JouPerMolPerKelvin: display-name=J/(mol*K), factor-si-to-unit=1.0, offset-si-to-unit=0.0, physical-dimension=Len2M1TiNeg2TNeg1AmntNeg1  # Joule Per Mole Per Kelvin
    Kat: display-name=kat, factor-si-to-unit=1.0, offset-si-to-unit=0.0, physical-dimension=TiNeg1Amnt1  # Katal
    KelvinAbslt: display-name=K, factor-si-to-unit=1.0, offset-si-to-unit=0.0, physical-dimension=T1  # Kelvin (Absolute Temperature)
    KelvinPerSec: display-name=K/s, factor-si-to-unit=1.0, offset-si-to-unit=0.0, physical-dimension=TiNeg1T1  # Kelvin Per Second
    KelvinRel: display-name=K, factor-si-to-unit=1.0, offset-si-to-unit=0.0, physical-dimension=T1_1  # Kelvin (Relative Temperature, Temperature Difference)
    KiloBitPerSec: display-name=kbit/s, factor-si-to-unit=0.001, offset-si-to-unit=0.0, physical-dimension=TiNeg1_3  # Kilobit Per Second
    KiloGr: display-name=kg, factor-si-to-unit=1.0, offset-si-to-unit=0.0, physical-dimension=M1  # Kilogram
    KiloGrPerHr: display-name=kg/h, factor-si-to-unit=3600.0, offset-si-to-unit=0.0, physical-dimension=M1TiNeg1  # Kilogram Per Hour
    KiloGrPerMtrCubd: display-name=kg/(m^3), factor-si-to-unit=1.0, offset-si-to-unit=0.0, physical-dimension=LenNeg3M1  # Kilo-Gram Per Cubic Meter
    KiloGrPerSec: display-name=kg/s, factor-si-to-unit=1.0, offset-si-to-unit=0.0, physical-dimension=M1TiNeg1  # Kilogram Per Second
    KiloGrSqrMtr: display-name=kg*(m^2), factor-si-to-unit=1.0, offset-si-to-unit=0.0, physical-dimension=Len2M1  # Kilogram Squaremeter
    KiloHz: display-name=kHz, factor-si-to-unit=0.001, offset-si-to-unit=0.0, physical-dimension=TiNeg1  # Kilohertz
    KiloJou: display-name=kJ, factor-si-to-unit=0.001, offset-si-to-unit=0.0, physical-dimension=Len2M1TiNeg2_1  # Kilojoule
    KiloMtr: display-name=km, factor-si-to-unit=0.001, offset-si-to-unit=0.0, physical-dimension=Len1  # Kilometer
    KiloMtrPerHr: display-name=km/h, factor-si-to-unit=3.6, offset-si-to-unit=0.0, physical-dimension=Len1TiNeg1  # Kilometer Per Hour
    KiloMtrPerHrPerSec: display-name=(km/h)/s, factor-si-to-unit=3.6, offset-si-to-unit=0.0, physical-dimension=Len1TiNeg2  # Kilometer Per Hour Per Second
    KiloNwt: display-name=kN, factor-si-to-unit=0.001, offset-si-to-unit=0.0, physical-dimension=Len1M1TiNeg2  # Kilonewton
    KiloNwtMtrPerSec: display-name=(kN*m)/s, factor-si-to-unit=0.001, offset-si-to-unit=0.0, physical-dimension=Len2M1TiNeg3  # Kilonewtonmeter Per Second
    KiloOhm: display-name=kΩ, factor-si-to-unit=0.001, offset-si-to-unit=0.0, physical-dimension=Len2M1TiNeg3INeg2  # Kiloohm
    KiloVolt: display-name=kV, factor-si-to-unit=0.001, offset-si-to-unit=0.0, physical-dimension=Len2M1TiNeg3INeg1  # Kilovolt
    KiloWatt: display-name=kW, factor-si-to-unit=0.001, offset-si-to-unit=0.0, physical-dimension=Len2M1TiNeg3_1  # Kilowatt
    KiloWattHr: display-name=kWh, factor-si-to-unit=2.77777777777778E-7, offset-si-to-unit=0.0, physical-dimension=Len2M1TiNeg2_1  # Kilowatthour
    KiloWattHrPer100KiloMtr: display-name=kWh/(100*km), factor-si-to-unit=0.0277777777777778, offset-si-to-unit=0.0, physical-dimension=Len1M1TiNeg2_1  # Kilowatthour Per 100 Kilometer
    Ltr: display-name=l, factor-si-to-unit=1000.0, offset-si-to-unit=0.0, physical-dimension=Len3  # Liter
    LtrPer100KiloMtr: display-name=l/(100km), factor-si-to-unit=1.0E8, offset-si-to-unit=0.0, physical-dimension=Len2_1  # Liter Per 100 Kilometer
    LtrPerHr: display-name=l/h, factor-si-to-unit=3600000.0, offset-si-to-unit=0.0, physical-dimension=Len3TiNeg1  # Liter Per Hour
    LtrPerKiloMtr: display-name=l/km, factor-si-to-unit=1000000.0, offset-si-to-unit=0.0, physical-dimension=Len2_1  # Liter Per Kilometer
    MegaBitPerSec: display-name=Mbit/s, factor-si-to-unit=1.0E-6, offset-si-to-unit=0.0, physical-dimension=TiNeg1_3  # Megabit Per Second
    MegaHz: display-name=MHz, factor-si-to-unit=1.0E-6, offset-si-to-unit=0.0, physical-dimension=TiNeg1  # Megahertz
    MegaJou: display-name=MJ, factor-si-to-unit=1.0E-6, offset-si-to-unit=0.0, physical-dimension=Len2M1TiNeg2_1  # Megajoule
    MegaOhm: display-name=MΩ, factor-si-to-unit=1.0E-6, offset-si-to-unit=0.0, physical-dimension=Len2M1TiNeg3INeg2  # Megaohm
    MegaPa: display-name=MPa, factor-si-to-unit=1.0E-6, offset-si-to-unit=0.0, physical-dimension=LenNeg1M1TiNeg2  # Megapascal
    MegaWatt: display-name=MW, factor-si-to-unit=1.0E-6, offset-si-to-unit=0.0, physical-dimension=Len2M1TiNeg3_1  # Megawatt
    MicroAmpr: display-name=µA, factor-si-to-unit=1000000.0, offset-si-to-unit=0.0, physical-dimension=I1  # Microampere
    MicroFrd: display-name=µF, factor-si-to-unit=1000000.0, offset-si-to-unit=0.0, physical-dimension=LenNeg2MNeg1Ti4I2  # Microfarad
    MicroGr: display-name=µg, factor-si-to-unit=1.0E9, offset-si-to-unit=0.0, physical-dimension=M1  # Microgram
    MicroJou: display-name=µJ, factor-si-to-unit=1000000.0, offset-si-to-unit=0.0, physical-dimension=Len2M1TiNeg2_1  # Microjoule
    MicroLtr: display-name=µl, factor-si-to-unit=1.0E9, offset-si-to-unit=0.0, physical-dimension=Len3  # Microliter
    MicroLtrPerSec: display-name=µl/s, factor-si-to-unit=1.0E9, offset-si-to-unit=0.0, physical-dimension=Len3TiNeg1  # Microliter Per Second
    MicroMtr: display-name=µm, factor-si-to-unit=1000000.0, offset-si-to-unit=0.0, physical-dimension=Len1  # Micrometer
    MicroSec: display-name=µs, factor-si-to-unit=1000000.0, offset-si-to-unit=0.0, physical-dimension=Ti1  # Microsecond
    MicroTesla: display-name=µT, factor-si-to-unit=1000000.0, offset-si-to-unit=0.0, physical-dimension=M1TiNeg2INeg1  # Microtesla
    MilliAmpr: display-name=mA/s, factor-si-to-unit=1000.0, offset-si-to-unit=0.0, physical-dimension=I1  # MilliAmpere
    MilliAmprPerSec: display-name=mA/s, factor-si-to-unit=1000.0, offset-si-to-unit=0.0, physical-dimension=TiNeg1I1  # Milliampere Per Second
    MilliBar: display-name=mbar, factor-si-to-unit=0.01, offset-si-to-unit=0.0, physical-dimension=LenNeg1M1TiNeg2  # Millibar
    MilliFrd: display-name=mF, factor-si-to-unit=1000.0, offset-si-to-unit=0.0, physical-dimension=LenNeg2MNeg1Ti4I2  # Millifarad
    MilliGr: display-name=mg, factor-si-to-unit=1000000.0, offset-si-to-unit=0.0, physical-dimension=M1  # Milligram
    MilliGrPerSec: display-name=mg/s, factor-si-to-unit=1000000.0, offset-si-to-unit=0.0, physical-dimension=M1TiNeg1  # Milligram Per Second
    MilliJou: display-name=mJ, factor-si-to-unit=1000.0, offset-si-to-unit=0.0, physical-dimension=Len2M1TiNeg2_1  # Millijoule
    MilliLtr: display-name=ml, factor-si-to-unit=1000000.0, offset-si-to-unit=0.0, physical-dimension=Len3  # Milliliter
    MilliMtr: display-name=mm, factor-si-to-unit=1000.0, offset-si-to-unit=0.0, physical-dimension=Len1  # Millimeter
    MilliMtrCubd: display-name=mm^3, factor-si-to-unit=1.0E9, offset-si-to-unit=0.0, physical-dimension=Len3  # Cubicmillimeter
    MilliMtrCubdPerSec: display-name=(mm^3)/s, factor-si-to-unit=1.0E9, offset-si-to-unit=0.0, physical-dimension=Len3TiNeg1  # Cubicmillimeter Per Second
    MilliOhm: display-name=mΩ, factor-si-to-unit=1000.0, offset-si-to-unit=0.0, physical-dimension=Len2M1TiNeg3INeg2  # Milliohm
    MilliSec: display-name=ms, factor-si-to-unit=1000.0, offset-si-to-unit=0.0, physical-dimension=Ti1  # Millisecond
    MilliTesla: display-name=mT, factor-si-to-unit=1000.0, offset-si-to-unit=0.0, physical-dimension=M1TiNeg2INeg1  # Millitesla
    MilliVolt: display-name=mV, factor-si-to-unit=1000.0, offset-si-to-unit=0.0, physical-dimension=Len2M1TiNeg3INeg1  # Millivolt
    MilliVoltPerSec: display-name=mV/s, factor-si-to-unit=1000.0, offset-si-to-unit=0.0, physical-dimension=Len2M1TiNeg4INeg1  # Millivolt Per Second
    MilliWatt: display-name=mW, factor-si-to-unit=1000.0, offset-si-to-unit=0.0, physical-dimension=Len2M1TiNeg3_1  # Milliwatt
    Mins: display-name=min, factor-si-to-unit=0.0166666666666667, offset-si-to-unit=0.0, physical-dimension=Ti1  # Minute
    Ml: display-name=mile, factor-si-to-unit=6.21371192237333E-4, offset-si-to-unit=0.0, physical-dimension=Len1  # Mile
    MlPerHr: display-name=mph, factor-si-to-unit=2.2369362920544, offset-si-to-unit=0.0, physical-dimension=Len1TiNeg1  # Miles Per Hour
    Mol: display-name=mol, factor-si-to-unit=1.0, offset-si-to-unit=0.0, physical-dimension=Amnt1  # Mole
    MolPerLtr: display-name=mol/l, factor-si-to-unit=0.001, offset-si-to-unit=0.0, physical-dimension=LenNeg3Amnt1  # Mole Per Liter
    MolPerLtrPerSec: display-name=(mol/l)/s, factor-si-to-unit=0.001, offset-si-to-unit=0.0, physical-dimension=LenNeg3TiNeg1Amnt1  # Mol Per Liter per Second
    MolPerMtrCubd: display-name=mol/(m^3), factor-si-to-unit=1.0, offset-si-to-unit=0.0, physical-dimension=LenNeg3Amnt1  # Mole Per Cubicmeter
    MolPerSec: display-name=mol/s, factor-si-to-unit=1.0, offset-si-to-unit=0.0, physical-dimension=TiNeg1Amnt1  # Mole Per Second
    Mtr: display-name=m, factor-si-to-unit=1.0, offset-si-to-unit=0.0, physical-dimension=Len1  # Meter
    MtrCubd: display-name=m^3, factor-si-to-unit=1.0, offset-si-to-unit=0.0, physical-dimension=Len3  # Cubicmeter
    MtrCubdPerHr: display-name=(m^3)/h, factor-si-to-unit=3600.0, offset-si-to-unit=0.0, physical-dimension=Len3TiNeg1  # Cubicmeter Per Hour
    MtrCubdPerHrPerSec: display-name=(m^3)/(h*s), factor-si-to-unit=3600.0, offset-si-to-unit=0.0, physical-dimension=Len3TiNeg2  # Cubicmeter Per Hour Per Second
    MtrCubdPerKiloGr: display-name=(m^3)/kg, factor-si-to-unit=1.0, offset-si-to-unit=0.0, physical-dimension=Len3MNeg1  # Cubicmeter Per Kilogram
    MtrPerSec: display-name=m/s, factor-si-to-unit=1.0, offset-si-to-unit=0.0, physical-dimension=Len1TiNeg1  # Meter Per Second
    MtrPerSecCubd: display-name=m/(s^3), factor-si-to-unit=1.0, offset-si-to-unit=0.0, physical-dimension=Len1TiNeg3  # Meter Per Second Cubed
    MtrPerSecSqd: display-name=m/(s^2), factor-si-to-unit=1.0, offset-si-to-unit=0.0, physical-dimension=Len1TiNeg2  # Meter Per Second Squared
    MtrSqd: display-name=m^2, factor-si-to-unit=1.0, offset-si-to-unit=0.0, physical-dimension=Len2  # Squaremeter
    MtrSqdPerSec: display-name=(m^2)/s, factor-si-to-unit=1.0, offset-si-to-unit=0.0, physical-dimension=Len2Ti1  # Squaremeter Per Second
    NanoFrd: display-name=nF, factor-si-to-unit=1.0E9, offset-si-to-unit=0.0, physical-dimension=LenNeg2MNeg1Ti4I2  # Nanofarad
    NanoSec: display-name=ns, factor-si-to-unit=1.0E9, offset-si-to-unit=0.0, physical-dimension=Ti1  # Nanosecond
    NoUnit: display-name=-, factor-si-to-unit=1.0, offset-si-to-unit=0.0, physical-dimension=NoDimension  # Neither Physical nor Mathematical Unit
    Nwt: display-name=N, factor-si-to-unit=1.0, offset-si-to-unit=0.0, physical-dimension=Len1M1TiNeg2  # Newton
    NwtMtr: display-name=Nm, factor-si-to-unit=1.0, offset-si-to-unit=0.0, physical-dimension=Len2M1TiNeg2  # Newtonmeter
    NwtMtrPerRpm: display-name=Nm/rpm, factor-si-to-unit=0.0166666666666667, offset-si-to-unit=0.0, physical-dimension=Len2M1TiNeg1  # Newtonmeter Per Rpm
    NwtMtrPerRpmPerSec: display-name=Nm/(rpm/s), factor-si-to-unit=0.0166666666666667, offset-si-to-unit=0.0, physical-dimension=Len2M1  # Newtonmeter Per RPM Per Second
    NwtMtrPerSec: display-name=(N*m)/s, factor-si-to-unit=1.0, offset-si-to-unit=0.0, physical-dimension=Len2M1TiNeg3  # Newtonmeter Per Second
    NwtMtrSec: display-name=Nm*s, factor-si-to-unit=1.0, offset-si-to-unit=0.0, physical-dimension=Len2M1TiNeg1  # Newton Meter Second
    NwtMtrSqrSec: display-name=Nm*(s^2), factor-si-to-unit=1.0, offset-si-to-unit=0.0, physical-dimension=Len2M1  # Newtonmeter Second Squared
    NwtPerMtr: display-name=N/m, factor-si-to-unit=1.0, offset-si-to-unit=0.0, physical-dimension=M1TiNeg2  # Newton Per Meter
    NwtSecPerMtr: display-name=Ns/m, factor-si-to-unit=1.0, offset-si-to-unit=0.0, physical-dimension=M1TiNeg1_1  # Newtonsecond Per Meter
    Ohm: display-name=Ω, factor-si-to-unit=1.0, offset-si-to-unit=0.0, physical-dimension=Len2M1TiNeg3INeg2
    Pa: display-name=Pa, factor-si-to-unit=1.0, offset-si-to-unit=0.0, physical-dimension=LenNeg1M1TiNeg2  # Pascal
    PaPerMtrCubdPerSec: display-name=Pa/((m^3)/s), factor-si-to-unit=1.0, offset-si-to-unit=0.0, physical-dimension=LenNeg4M1TiNeg1  # Pascal Second Per Cubicmeter
    PaPerSec: display-name=Pa/s, factor-si-to-unit=1.0, offset-si-to-unit=0.0, physical-dimension=LenNeg1M1TiNeg3  # Pascal Per Second
    PaSec: display-name=Pa*s, factor-si-to-unit=1.0, offset-si-to-unit=0.0, physical-dimension=LenNeg1M1TiNeg1  # Pascal Second
    PerMille: display-name=‰, factor-si-to-unit=1000.0, offset-si-to-unit=0.0, physical-dimension=NoDimension_1  # Permille
    PerMin: display-name=1/min, factor-si-to-unit=60.0, offset-si-to-unit=0.0, physical-dimension=TiNeg1_2  # Per Minute
    PerMtr: display-name=1/m, factor-si-to-unit=1.0, offset-si-to-unit=0.0, physical-dimension=LenNeg1  # Per Meter
    PerSec: display-name=1/s, factor-si-to-unit=1.0, offset-si-to-unit=0.0, physical-dimension=TiNeg1_2  # Per Second
    PerSecSqd: display-name=1/(s^2), factor-si-to-unit=1.0, offset-si-to-unit=0.0, physical-dimension=TiNeg2  # Per Second Squared
    Perc: display-name=%, factor-si-to-unit=100.0, offset-si-to-unit=0.0, physical-dimension=NoDimension_1  # Percent
    PercPerMilliSec: display-name=%/ms, factor-si-to-unit=0.1, offset-si-to-unit=0.0, physical-dimension=TiNeg1_1  # Percent Per Millisecond
    PercPerSec: display-name=%/s, factor-si-to-unit=100.0, offset-si-to-unit=0.0, physical-dimension=TiNeg1_1  # Percent Per Second
    PicoFrd: display-name=pF, factor-si-to-unit=1.0E12, offset-si-to-unit=0.0, physical-dimension=LenNeg2MNeg1Ti4I2  # Picofarad
    PicoSec: display-name=ps, factor-si-to-unit=1.0E12, offset-si-to-unit=0.0, physical-dimension=Ti1  # Picosecond
    Ppm: display-name=ppm, factor-si-to-unit=1000000.0, offset-si-to-unit=0.0, physical-dimension=NoDimension_1  # Parts Per Million
    Rad: display-name=rad, factor-si-to-unit=6.28318530717958, offset-si-to-unit=0.0, physical-dimension=NoDimension_2  # Radian
    RadPerSec: display-name=rad/s, factor-si-to-unit=6.28318530717958, offset-si-to-unit=0.0, physical-dimension=TiNeg1_2  # Radian Per Second
    RadPerSecSqd: display-name=rad/(s^2), factor-si-to-unit=6.28318530717958, offset-si-to-unit=0.0, physical-dimension=TiNeg2  # Radian Per Second Squared
    Rpm: display-name=rpm, factor-si-to-unit=60.0, offset-si-to-unit=0.0, physical-dimension=TiNeg1_2  # Revolutions Per Minute
    RpmPerSec: display-name=rpm/s, factor-si-to-unit=60.0, offset-si-to-unit=0.0, physical-dimension=TiNeg2  # Revolutions Per Minute Per Second
    S: display-name=S, factor-si-to-unit=1.0, offset-si-to-unit=0.0, physical-dimension=LenNeg2MNeg1Ti3I2  # Siemens
    SPerMtr: display-name=S/m, factor-si-to-unit=1.0, offset-si-to-unit=0.0, physical-dimension=LenNeg3MNeg1Ti3I2  # Siemens Per Meter
    SPerMtrPerSec: display-name=S/(m*s), factor-si-to-unit=1.0, offset-si-to-unit=0.0, physical-dimension=LenNeg3MNeg1Ti2I2  # Siemens Per Meter Per Second
    Sec: display-name=s, factor-si-to-unit=1.0, offset-si-to-unit=0.0, physical-dimension=Ti1  # Second
    Tesla: display-name=T, factor-si-to-unit=1.0, offset-si-to-unit=0.0, physical-dimension=M1TiNeg2INeg1
    Tonne: display-name=t, factor-si-to-unit=0.001, offset-si-to-unit=0.0, physical-dimension=M1
    Volt: display-name=V, factor-si-to-unit=1.0, offset-si-to-unit=0.0, physical-dimension=Len2M1TiNeg3INeg1
    VoltPerMilliSec: display-name=V/ms, factor-si-to-unit=0.001, offset-si-to-unit=0.0, physical-dimension=Len2M1TiNeg4INeg1  # Volt Per Millisecond
    VoltPerMtr: display-name=V/m, factor-si-to-unit=1.0, offset-si-to-unit=0.0, physical-dimension=Len1M1TiNeg3INeg1  # Volt Per Meter
    VoltPerSec: display-name=V/s, factor-si-to-unit=1.0, offset-si-to-unit=0.0, physical-dimension=Len2M1TiNeg4INeg1  # Volt Per Second
    Watt: display-name=W, factor-si-to-unit=1.0, offset-si-to-unit=0.0, physical-dimension=Len2M1TiNeg3_1
    WattPerKelvinPerMtrSqd: display-name=W/(K*m^2), factor-si-to-unit=1.0, offset-si-to-unit=0.0, physical-dimension=M1TiNeg3TNeg1  # Watt Per Kelvin Per Squaremeter
    WattPerMtrPerKelvin: display-name=W/(m*K), factor-si-to-unit=1.0, offset-si-to-unit=0.0, physical-dimension=Len1M1TiNeg3TNeg1  # Watt Per Meter Per Kelvin
    WattPerSec: display-name=W/s, factor-si-to-unit=1.0, offset-si-to-unit=0.0, physical-dimension=Len2M1TiNeg4  # Watt Per Second
    WattSec: display-name=Ws, factor-si-to-unit=1.0, offset-si-to-unit=0.0, physical-dimension=Len2M1TiNeg2_1  # Wattsecond
    Wb: display-name=Wb, factor-si-to-unit=1.0, offset-si-to-unit=0.0, physical-dimension=Len2M1TiNeg2INeg1  # Weber
    Yr: display-name=a, factor-si-to-unit=3.16880878140289E-8, offset-si-to-unit=0.0, physical-dimension=Ti1  # Year
