AUTOSAR XML (schema 00047)
package /AUTOSAR/UpdateAndConfigurationManagement/CompositionSwComponentTypes_Blueprint
  composition sw component type UCM
    component PKGMGR: type=PKGMGR
package /AUTOSAR/UpdateAndConfigurationManagement/AdaptiveApplicationSwComponentTypes_Blueprint
  adaptive application sw component type PKGMGR
    provide port PackageManagement
package /AUTOSAR/UpdateAndConfigurationManagement/ServiceInterfaces_Blueprint
  service interface PackageManagement: is-service=true
    namespaces:
      symbol props ara
      symbol props ucm
      symbol props pkgmgr
    field CurrentStatus: type=PackageManagerStatusType, has-getter=true, has-notifier=true, has-setter=false  # The current status of UCM.
    methods:
      17 x operation, all with fire-and-forget=false:
        GetSwClusterInfo  # This method returns a list of SoftwareClusters that are in state kPresent.
          arg SwInfo: type=SwClusterInfoVectorType, direction=OUT  # List of installed SoftwareClusters that are in state kPresent.
        GetSwClusterChangeInfo  # This method returns a list pending changes to the set of SoftwareClusters on the adaptive platform. The returned list includes all SoftwareClusters that are to be added, updated or removed. The list of changes is extended in the course of processing Software Packages.
          arg SwInfo: type=SwClusterInfoVectorType, direction=OUT  # List of SoftwareClusters that are in state kAdded,kUpdated or kRemoved.
        GetSwPackages  # This method returns the Software Packages that available in UCM.
          arg Packages: type=SwPackageInfoVectorType, direction=OUT  # List of Software Packages.
        TransferStart: possible-ap-error=InsufficientMemory  # Start the transfer of a Software Package. The size of the Software Package to be transferred to UCM must be provided. UCM will generate a Transfer ID for subsequent calls to TransferData, TransferExit, ProcessSwPackage, DeleteTransfer, GetLog and SetLogLevel.
          arg size: type=uint64_t, direction=IN  # Size (in bytes) of the Software Package to be transferred.
          arg id: type=TransferIdType, direction=OUT  # Return TransferId.
        TransferData: possible-ap-error=[IncorrectBlock, IncorrectSize, InsufficientMemory, InvalidTransferId, PackageInconsistent, AuthenticationFailed, OperationNotPermitted, AuthenticationFailed, PackageInconsistent]  # Block-wise transfer of a Software Package to UCM.
          arg id: type=TransferIdType, direction=IN  # Transfer ID.
          arg data: type=ByteVectorType, direction=IN  # Data block of the Software Package.
          arg blockCounter: type=uint32_t, direction=IN  # Block counter value of the current block.
        TransferExit: possible-ap-error=[InsufficientData, PackageInconsistent, AuthenticationFailed, OldVersion, InvalidTransferId, OperationNotPermitted]  # Finish the transfer of a Software Package to UCM.
          arg id: type=TransferIdType, direction=IN  # Transfer ID of the currently running request.
        DeleteTransfer: possible-ap-error=[GeneralReject, GeneralMemoryError, InvalidTransferId, OperationNotPermitted]  # Delete a transferred Software Package.
          arg id: type=TransferIdType, direction=IN  # Transfer ID of the currently running request.
        ProcessSwPackage: possible-ap-error=[ServiceBusy, InvalidManifest, ProcessedSoftwarePackageInconsistent, InsufficientMemory, InvalidTransferId, OperationNotPermitted, ProcessSwPackageCancelled, AuthenticationFailed]  # Process a previously transferred Software Package.
          arg id: type=TransferIdType, direction=IN  # The Transfer ID of this Software Package.
        RevertProcessedSwPackages: possible-ap-error=[NothingToRevert, NotAbleToRevertPackages, OperationNotPermitted]  # Revert the changes done by processing (ProcessSwPackage) of one or several software packages.
        GetSwProcessProgress: possible-ap-error=InvalidTransferId  # Get the progress (0 - 100%) of the currently processed Software Package.
          arg id: type=TransferIdType, direction=IN  # The Transfer ID of the Software Package.
          arg progress: type=uint8_t, direction=OUT, variation-point=blueprint-condition=note=p=l-1=Variation of Progress OUT parameter.  # The progress of the current package processing (0% - 100%). 0x00 ... 0x64, 0xFF for "‘No information available"’
        Cancel: possible-ap-error=[CancelFailed, OperationNotPermitted, InvalidTransferId]  # This method aborts an ongoing processing of a Software Package.
          arg id: type=TransferIdType, direction=IN  # The Transfer ID.
        Rollback: possible-ap-error=[NothingToRollback, NotAbleToRollback, OperationNotPermitted]  # Rollback the system to the state before the packages were processed.
        Activate: possible-ap-error=[ErrorDuringActivation, ErrorNoValidProcessing, MissingDependencies, OperationNotPermitted]  # This method activates the processed components.
          arg option: type=ActivateOptionType, direction=IN  # The option of the activate.
        Finish: possible-ap-error=[GeneralReject, OperationNotPermitted]  # This method finishes the processing for the current set of processed Software Packages. It does a cleanup of all data of the processing including the sources of the Software Packages.
        SetLogLevel: possible-ap-error=InvalidTransferId  # This method sets the log level for a package.
          arg id: type=TransferIdType, direction=IN  # The Transfer ID.
          arg logLevel: type=LogLevelType, direction=IN  # The new log level to be used.
        GetLog: possible-ap-error=InvalidTransferId  # Getter method to poll for the log messages of the current Session.
          arg id: type=TransferIdType, direction=IN  # The Transfer ID.
          arg log: type=LogVectorType, direction=OUT  # The log messages.
        GetHistory  # Getter method to retrieve all actions that have been performed by UCM.
          arg timestampGE: type=uint64_t, direction=IN  # Earliest timestamp (inclusive)
          arg timestampLT: type=uint64_t, direction=IN  # Latest timestamp (exclusive)
          arg history: type=GetHistoryVectorType, direction=OUT  # The history of all actions that have been performed by UCM.
package /AUTOSAR/UpdateAndConfigurationManagement/ImplementationDataTypes_Blueprint
  20 x std cpp implementation data type:
    TransferIdType: type-reference=uint64_t  # Represents a handle identifier used to reference a particular transfer request.
      namespaces:
        symbol props ara
        symbol props ucm
        symbol props pkgmgr
    SwInfoName: category=STRING  # SoftwareCluster name.
      namespaces:
        symbol props ara
        symbol props ucm
        symbol props pkgmgr
    ByteVectorType: category=VECTOR, cpp-template-argument=uint8_t  # Byte vector representing raw data.
      namespaces:
        symbol props ara
        symbol props ucm
        symbol props pkgmgr
    SwPackageStateType: compu {0x00=kTransferring (Software package is being transferred, i.e. not completely received.), 0x01=kTransferred (Software package is completely transferred and ready to be processed.), 0x02=kProcessing (Software package is currently being processed.), 0x03=kProcessed (Software package processing finished.)}, range raw 0x00..0x03, type-reference=uint8_t  # Represents the state of a Software Package on the Platform.
      namespaces:
        symbol props ara
        symbol props ucm
        symbol props pkgmgr
    SwPackageInfoType: category=STRUCTURE  # Represents the information of a Software Package.
      namespaces:
        symbol props ara
        symbol props ucm
        symbol props pkgmgr
      5 x cpp implementation data type element:
        Name: type-reference={inplace=false, type-reference=SwInfoName}  # SoftwareCluster name
        Version: type-reference={inplace=false, type-reference=StrongRevisionLabelString}  # SoftwareCluster version
        TransferID: type-reference={inplace=false, type-reference=TransferIdType}  # TransferID of the Software Package
        Size: type-reference={inplace=false, type-reference=uint8_t}  # Software Package size (in bytes)
        State: type-reference={inplace=false, type-reference=SwPackageStateType}  # State of the Software Package
    SwPackageInfoVectorType: category=VECTOR, cpp-template-argument=SwPackageInfoType  # Represents a dynamic size array of Software Packages
      namespaces:
        symbol props ara
        symbol props ucm
        symbol props pkgmgr
    SwClusterStateType: compu {0x00=kPresent (State of a SoftwareCluster that is installed on the adaptive platform and installation has finished.), 0x01=kAdded (State of a SoftwareCluster that has been newly installed.), 0x02=kUpdated (State of a SoftwareCluster that has been updated.), 0x03=kRemoved (State of a SoftwareCluster that has been removed.)}, range raw 0x00..0x03, type-reference=uint8_t  # Represents the state of a SoftwareCluster on the adaptive platform.
      namespaces:
        symbol props ara
        symbol props ucm
        symbol props pkgmgr
    SwClusterInfoType: category=STRUCTURE  # Represents the information of a SoftwareCluster.
      namespaces:
        symbol props ara
        symbol props ucm
        symbol props pkgmgr
      cpp implementation data type element Name: type-reference={inplace=false, type-reference=SwInfoName}  # Name of the SoftwareCluster
      cpp implementation data type element Version: type-reference={inplace=false, type-reference=StrongRevisionLabelString}  # SoftwareCluster version
      cpp implementation data type element State: type-reference={inplace=false, type-reference=SwClusterStateType}  # State of the SoftwareCluster
    SwClusterInfoVectorType: category=VECTOR, cpp-template-argument=SwClusterInfoType  # Represents a dynamic size array of SoftwareClusters
      namespaces:
        symbol props ara
        symbol props ucm
        symbol props pkgmgr
    LogLevelType:  # Represents the severity of the log messages.
      compu {0x00=kOff (Logging is deactivated.), 0x01=kFatal (Only fatal messages are logged.), 0x02=kError (Only messages up to error level are logged.), 0x03=kWarning (Only messages up to warning level are logged.), 0x04=kInfo (Only messages up to info level are logged.), 0x05=kDebug (Only messages up to debug level are logged.), 0x06=kVerbose (Only messages up to verbose level are logged.)}
      range raw 0x00..0x06
      type-reference=uint8_t
      namespaces:
        symbol props ara
        symbol props ucm
        symbol props pkgmgr
    LogEntryType: category=STRUCTURE  # Represents a single log message with a log level.
      namespaces:
        symbol props ara
        symbol props ucm
        symbol props pkgmgr
      cpp implementation data type element LogLevel: type-reference={inplace=false, type-reference=LogLevelType}  # The log level of the log message.
      cpp implementation data type element Message: type-reference={inplace=false, type-reference=LogMessageType}  # The log message.
    LogVectorType: category=VECTOR, cpp-template-argument=LogEntryType  # Represents a list of log messages.
      namespaces:
        symbol props ara
        symbol props ucm
        symbol props pkgmgr
    PackageManagerStatusType:  # Represents the state of UCM.
      compu {0x00=kIdle (UCM is ready to start processing if software packages are present.), 0x01=kReady (UCM has processed one or several packages and waits for additional packages, activation or reversion of processed packages.), 0x02=kBusy (UCM is currently in the middle of processing a Software Package, i.e. a client has called ProcessSwPackage.), 0x03=kActivating (UCM is performing the dependency check and preparing the activation of the processed Software packages.), 0x04=kActivated (Software changes introduced with processed Software Packages has been activated and executed.), 0x05=kRollingBack (UCM is reverting changes introduced with processed packages.), 0x06=kRolledBack (Software changes introduced with processed Software Packages has been deactivated and original software is executed.), 0x07=kCleaningUp (Making sure that the system is in a clean state.), 0x08=kVerifying (UCM (via State Management) is checking that the processed packages have been properly restarted.)}
      range raw 0x00..0x08
      type-reference=uint8_t
      namespaces:
        symbol props ara
        symbol props ucm
        symbol props pkgmgr
    ActivateOptionType: compu {0x00=kDefault (No override, default behaviour.), 0x01=kFunctionGroupRestart (Request restart of the functional group.), 0x02=kSystemReset (Request reset of the system.)}, range raw 0x00..0x02, type-reference=uint8_t  # Represents the option parameter type of the Activate method.
      namespaces:
        symbol props ara
        symbol props ucm
        symbol props pkgmgr
    ResultType: compu {0x00=kSuccessfull (UCM’s action was successful.), 0x01=kFailed (UCM’s action failed.)}, range raw 0x00..0x01, type-reference=uint8_t  # Represents the result of UCM action.
      namespaces:
        symbol props ara
        symbol props ucm
        symbol props pkgmgr
    ActionType: compu {0x00=kUpdate (Update of a SoftwareCluster.), 0x01=kInstall (Installation of a new SoftwareCluster.), 0x02=kRemove (Removal of a SoftwareCluster.)}, range raw 0x00..0x02, type-reference=uint8_t  # Represents the UCM action.
      namespaces:
        symbol props ara
        symbol props ucm
        symbol props pkgmgr
    GetHistoryType: category=STRUCTURE  # Time refers to the activation time of the software cluster. It is represented in milliseconds of UCM’s action resolution since 01.01.1970 (UTC).
      namespaces:
        symbol props ara
        symbol props ucm
        symbol props pkgmgr
      5 x cpp implementation data type element:
        Time: type-reference={inplace=false, type-reference=uint64_t}  # Date and time of UCM’s action resolution.
        Name: type-reference={inplace=false, type-reference=SwInfoName}  # Name of the SoftwareCluster
        Version: type-reference={inplace=false, type-reference=StrongRevisionLabelString}  # Version of the SoftwareCluster
        Action: type-reference={inplace=false, type-reference=ActionType}  # What action was performed by UCM
        Resolution: type-reference={inplace=false, type-reference=ResultType}  # What action was performed by UCM
    GetHistoryVectorType: category=VECTOR, cpp-template-argument=GetHistoryType  # Represents a list of UCM actions
      namespaces:
        symbol props ara
        symbol props ucm
        symbol props pkgmgr
    StrongRevisionLabelString: category=STRING  # Represents a generic string data type
      namespaces:
        symbol props ara
        symbol props ucm
        symbol props pkgmgr
    LogMessageType: category=STRING  # Represents a string data type for the log message
      namespaces:
        symbol props ara
        symbol props ucm
        symbol props pkgmgr
package /AUTOSAR/UpdateAndConfigurationManagement/ApApplicationErrors_Blueprint
  ap application error domain UCMErrorDomain
  23 x ap application error, all with error-domain=UCMErrorDomain:
    InsufficientMemory: error-code=1  # Insufficient memory to perform operation.
    IncorrectBlock: error-code=2  # The block counter value is not as expected.
    IncorrectSize: error-code=3  # The size of the Software Package exceeds the provided size in TransferStart.
    InvalidTransferId: error-code=4  # The Transfer ID is invalid.
    OperationNotPermitted: error-code=5  # The operation is not supported in the current context.
    InsufficientData: error-code=6  # TransferExit has been called but total transferred data size does not match expected data size provided with TransferStart call.
    PackageInconsistent: error-code=7  # Package integrity check failed.
    AuthenticationFailed: error-code=8  # Software Package authentication failed.
    OldVersion: error-code=9  # Software Package version is too old.
    GeneralReject: error-code=10  # General reject.
    GeneralMemoryError: error-code=11  # A general memory error occured.
    ServiceBusy: error-code=12  # Another processing is already ongoing and therefore the current processing request has to be rejected.
    InvalidManifest: error-code=13  # Package manifest could not be read.
    NothingToRevert: error-code=14  # RevertProcessedSwPackages has been called without prior processing of a Software Package.
    NotAbleToRevertPackages: error-code=15  # RevertProcessedSwPackages failed.
    CancelFailed: error-code=16  # Cancel failed.
    NothingToRollback: error-code=17  # Rollback cannot be performed due to no rollback data available.
    NotAbleToRollback: error-code=18  # Rollback failed.
    ErrorDuringActivation: error-code=19  # Activate failed.
    ErrorNoValidProcessing: error-code=20  # Activate cannot be performed because previous processing is invalid.
    MissingDependencies: error-code=21  # Activate cannot be performed because of missing dependencies.
    ProcessSwPackageCancelled: error-code=22  # The processing operation has been interrupted by a Cancel() call.
    ProcessedSoftwarePackageInconsistent: error-code=23  # The processed Software Package integrity check has failed.
